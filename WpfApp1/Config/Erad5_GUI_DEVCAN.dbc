VERSION ""

NS_ :

BS_:

BU_: GUI MCU
VAL_TABLE_ SPI_Baudrate_Select 11 "50" 10 "40" 9 "25" 8 "20" 7 "10" 6 "8" 5 "5" 4 "4" 3 "2.5" 2 "0.5" 1 "1" 0 "2" ;
VAL_TABLE_ TLF35584_State_Value 7 "RESERVED" 6 "RESERVED" 5 "WAKE" 4 "STANDBY" 3 "SLEEP" 2 "NORMAL" 1 "INIT" 0 "NONE" ;
VAL_TABLE_ AMUX_SEL_Value 5 "Die temperature" 4 "Power device temperature" 3 "VEE" 2 "VCC" 1 "AMUXIN" 0 "DESAT" ;
VAL_TABLE_ AOUT_SELECT_Value 4 "VEE" 3 "VCC" 2 "AMUXIN" 1 "DESAT" 0 "NONE" ;
VAL_TABLE_ Write_Register_Index 4 "STATCON4" 3 "STATUS3" 2 "STATUS2" 1 "STATUS1" 0 "NONE" ;

BO_ 1558 MCU_TX_0x616_DEVCANFD: 64 MCU
 SG_ BOT_W_Die_TEMP_ADC_Data : 350|10@1+ (1,0) [0|1023] "" GUI
 SG_ BOT_W_Power_TEMP_ADC_Data : 340|10@1+ (1,0) [0|1023] "" GUI
 SG_ BOT_W_VEE_ADC_Data : 330|10@1+ (1,0) [0|1023] "" GUI
 SG_ BOT_W_VCC_ADC_Data : 320|10@1+ (1,0) [0|1023] "" GUI
 SG_ BOT_W_AMUXIN_ADC_Data : 310|10@1+ (1,0) [0|1023] "" GUI
 SG_ BOT_W_DESAT_ADC_Data : 300|10@1+ (1,0) [0|1023] "" GUI
 SG_ BOT_V_Die_TEMP_ADC_Data : 290|10@1+ (1,0) [0|1023] "" GUI
 SG_ BOT_V_Power_TEMP_ADC_Data : 280|10@1+ (1,0) [0|1023] "" GUI
 SG_ BOT_V_VEE_ADC_Data : 270|10@1+ (1,0) [0|1023] "" GUI
 SG_ BOT_V_VCC_ADC_Data : 260|10@1+ (1,0) [0|1023] "" GUI
 SG_ BOT_V_AMUXIN_ADC_Data : 250|10@1+ (1,0) [0|1023] "" GUI
 SG_ BOT_V_DESAT_ADC_Data : 240|10@1+ (1,0) [0|1023] "" GUI
 SG_ BOT_U_Die_TEMP_ADC_Data : 230|10@1+ (1,0) [0|1023] "" GUI
 SG_ BOT_U_Power_TEMP_ADC_Data : 220|10@1+ (1,0) [0|1023] "" GUI
 SG_ BOT_U_VEE_ADC_Data : 210|10@1+ (1,0) [0|1023] "" GUI
 SG_ BOT_U_VCC_ADC_Data : 200|10@1+ (1,0) [0|1023] "" GUI
 SG_ BOT_U_AMUXIN_ADC_Data : 190|10@1+ (1,0) [0|1023] "" GUI
 SG_ BOT_U_DESAT_ADC_Data : 180|10@1+ (1,0) [0|1023] "" GUI
 SG_ TOP_W_Die_TEMP_ADC_Data : 170|10@1+ (1,0) [0|1023] "" GUI
 SG_ TOP_W_Power_TEMP_ADC_Data : 160|10@1+ (1,0) [0|1023] "" GUI
 SG_ TOP_W_VEE_ADC_Data : 150|10@1+ (1,0) [0|1023] "" GUI
 SG_ TOP_W_VCC_ADC_Data : 140|10@1+ (1,0) [0|1023] "" GUI
 SG_ TOP_W_AMUXIN_ADC_Data : 130|10@1+ (1,0) [0|1023] "" GUI
 SG_ TOP_W_DESAT_ADC_Data : 120|10@1+ (1,0) [0|1023] "" GUI
 SG_ TOP_V_Die_TEMP_ADC_Data : 110|10@1+ (1,0) [0|1023] "" GUI
 SG_ TOP_V_Power_TEMP_ADC_Data : 100|10@1+ (1,0) [0|1023] "" GUI
 SG_ TOP_V_VEE_ADC_Data : 90|10@1+ (1,0) [0|1023] "" GUI
 SG_ TOP_V_VCC_ADC_Data : 80|10@1+ (1,0) [0|1023] "" GUI
 SG_ TOP_V_AMUXIN_ADC_Data : 70|10@1+ (1,0) [0|1023] "" GUI
 SG_ TOP_V_DESAT_ADC_Data : 60|10@1+ (1,0) [0|1023] "" GUI
 SG_ TOP_U_Die_TEMP_ADC_Data : 50|10@1+ (1,0) [0|1023] "" GUI
 SG_ TOP_U_Power_TEMP_ADC_Data : 40|10@1+ (1,0) [0|1023] "" GUI
 SG_ TOP_U_VEE_ADC_Data : 30|10@1+ (1,0) [0|1023] "" GUI
 SG_ TOP_U_VCC_ADC_Data : 20|10@1+ (1,0) [0|1023] "" GUI
 SG_ TOP_U_AMUXIN_ADC_Data : 10|10@1+ (1,0) [0|1023] "" GUI
 SG_ TOP_U_DESAT_ADC_Data : 0|10@1+ (1,0) [0|1023] "" GUI

BO_ 1282 MCU_RX_0x502_DEVCANFD: 32 GUI
 SG_ SPI_Baudrate_Update : 95|1@1+ (1,0) [0|1] ""  MCU
 SG_ PPAWL_SPI_Select_Baudrate : 136|4@1+ (1,0) [0|15] ""  MCU
 SG_ CANFD_5_SPI_Select_Baudrate : 132|4@1+ (1,0) [0|15] ""  MCU
 SG_ CANFD_16_SPI_Select_Baudrate : 128|4@1+ (1,0) [0|15] ""  MCU
 SG_ FLASH_SPI_Select_Baudrate : 124|4@1+ (1,0) [0|15] ""  MCU
 SG_ SBC_SPI_Select_Baudrate : 120|4@1+ (1,0) [0|15] ""  MCU
 SG_ BOT_W_GDIC_SPI_Select_Baudrate : 116|4@1+ (1,0) [0|15] ""  MCU
 SG_ BOT_V_GDIC_SPI_Select_Baudrate : 112|4@1+ (1,0) [0|15] ""  MCU
 SG_ BOT_U_GDIC_SPI_Select_Baudrate : 108|4@1+ (1,0) [0|15] ""  MCU
 SG_ TOP_W_GDIC_SPI_Select_Baudrate : 104|4@1+ (1,0) [0|15] ""  MCU
 SG_ TOP_V_GDIC_SPI_Select_Baudrate : 100|4@1+ (1,0) [0|15] ""  MCU
 SG_ TOP_U_GDIC_SPI_Select_Baudrate : 96|4@1+ (1,0) [0|15] ""  MCU
 SG_ LIN_Receive_Checksum_Type : 92|1@1+ (1,0) [0|1] ""  MCU
 SG_ LIN_Receive_Length : 88|4@1+ (1,0) [0|8] ""  MCU
 SG_ LIN_Receive_ID : 80|8@1+ (1,0) [0|255] ""  MCU
 SG_ LIN_Send_Data7 : 72|8@1+ (1,0) [0|255] ""  MCU
 SG_ LIN_Send_Data6 : 64|8@1+ (1,0) [0|255] ""  MCU
 SG_ LIN_Send_Data5 : 56|8@1+ (1,0) [0|255] ""  MCU
 SG_ LIN_Send_Data4 : 48|8@1+ (1,0) [0|255] ""  MCU
 SG_ LIN_Send_Data3 : 40|8@1+ (1,0) [0|255] ""  MCU
 SG_ LIN_Send_Data2 : 32|8@1+ (1,0) [0|255] ""  MCU
 SG_ LIN_Send_Data1 : 24|8@1+ (1,0) [0|255] ""  MCU
 SG_ LIN_Send_Data0 : 16|8@1+ (1,0) [0|255] ""  MCU
 SG_ LIN_Send_Checksum_Type : 12|1@1+ (1,0) [0|1] ""  MCU
 SG_ LIN_Send_Length : 8|4@1+ (1,0) [0|8] ""  MCU
 SG_ LIN_Send_ID : 0|8@1+ (1,0) [0|255] ""  MCU

BO_ 1281 MCU_RX_0x501_DEVCANFD: 32 GUI
 SG_ E_STOP_MAIN_MICRO_OUTPUT : 236|1@1+ (1,0) [0|1] ""  MCU
 SG_ DSAT_BOT_FLT_FB_OUTPUT : 235|1@1+ (1,0) [0|1] ""  MCU
 SG_ DSAT_TOP_FLT_FB_OUTPUT : 234|1@1+ (1,0) [0|1] ""  MCU
 SG_ UVLO_BOT_FLT_FB_OUTPUT : 233|1@1+ (1,0) [0|1] ""  MCU
 SG_ UVLO_TOP_FLT_FB_OUTPUT : 232|1@1+ (1,0) [0|1] ""  MCU
 SG_ HVDC_OV_FLT_FB_OUTPUT : 231|1@1+ (1,0) [0|1] ""  MCU
 SG_ PHASE_UVW_OC_FLT_OUTPUT : 230|1@1+ (1,0) [0|1] ""  MCU
 SG_ OC_W_FLT_OUTPUT : 229|1@1+ (1,0) [0|1] ""  MCU
 SG_ OC_V_FLT_OUTPUT : 228|1@1+ (1,0) [0|1] ""  MCU
 SG_ OC_U_FLT_OUTPUT : 227|1@1+ (1,0) [0|1] ""  MCU
 SG_ Safing_Logic_E_STOP_MAIN_MICRO_Dir_Select : 226|1@1+ (1,0) [0|1] "" MCU
 SG_ Safing_Logic_DSAT_BOT_FLT_FB_Dir_Select : 225|1@1+ (1,0) [0|1] "" MCU
 SG_ Safing_Logic_DSAT_TOP_FLT_FB_Dir_Select : 224|1@1+ (1,0) [0|1] "" MCU
 SG_ Safing_Logic_UVLO_BOT_FLT_FB_Dir_Select : 223|1@1+ (1,0) [0|1] "" MCU
 SG_ Safing_Logic_UVLO_TOP_FLT_FB_Dir_Select : 222|1@1+ (1,0) [0|1] "" MCU
 SG_ Safing_Logic_HVDC_OV_FLT_FB_Dir_Select : 221|1@1+ (1,0) [0|1] "" MCU
 SG_ Safing_Logic_PHASE_UVW_OC_FLT_Dir_Select : 220|1@1+ (1,0) [0|1] "" MCU
 SG_ Safing_Logic_OC_W_FLT_Dir_Select : 219|1@1+ (1,0) [0|1] "" MCU
 SG_ Safing_Logic_OC_V_FLT_Dir_Select : 218|1@1+ (1,0) [0|1] "" MCU
 SG_ Safing_Logic_OC_U_FLT_Dir_Select : 217|1@1+ (1,0) [0|1] "" MCU
 SG_ Safing_Logic_Pin_Dir_Update : 216|1@1+ (1,0) [0|1] "" MCU
 SG_ Safing_Logic_Test_Stop : 215|1@1+ (1,0) [0|1] "" MCU
 SG_ Safing_Logic_Test_Start : 214|1@1+ (1,0) [0|1] "" MCU
 SG_ BOT_W_Status_Write_Flag : 213|1@1+ (1,0) [0|1] "" MCU
 SG_ BOT_V_Status_Write_Flag : 212|1@1+ (1,0) [0|1] "" MCU
 SG_ BOT_U_Status_Write_Flag : 211|1@1+ (1,0) [0|1] "" MCU
 SG_ TOP_W_Status_Write_Flag : 210|1@1+ (1,0) [0|1] "" MCU
 SG_ TOP_V_Status_Write_Flag : 209|1@1+ (1,0) [0|1] "" MCU
 SG_ TOP_U_Status_Write_Flag : 208|1@1+ (1,0) [0|1] "" MCU
 SG_ BOT_W_AMUX_SEL : 200|8@1+ (1,0) [0|255] ""  MCU
 SG_ BOT_V_AMUX_SEL : 192|8@1+ (1,0) [0|255] ""  MCU
 SG_ BOT_U_AMUX_SEL : 184|8@1+ (1,0) [0|255] ""  MCU
 SG_ TOP_W_AMUX_SEL : 176|8@1+ (1,0) [0|255] ""  MCU
 SG_ TOP_V_AMUX_SEL : 168|8@1+ (1,0) [0|255] ""  MCU
 SG_ TOP_U_AMUX_SEL : 160|8@1+ (1,0) [0|255] ""  MCU
 SG_ BOT_W_AOUT_SELECT : 152|8@1+ (1,0) [0|255] ""  MCU
 SG_ BOT_V_AOUT_SELECT : 144|8@1+ (1,0) [0|255] ""  MCU
 SG_ BOT_U_AOUT_SELECT : 136|8@1+ (1,0) [0|255] ""  MCU
 SG_ TOP_W_AOUT_SELECT : 128|8@1+ (1,0) [0|255] ""  MCU
 SG_ TOP_V_AOUT_SELECT : 120|8@1+ (1,0) [0|255] ""  MCU
 SG_ TOP_U_AOUT_SELECT : 112|8@1+ (1,0) [0|255] ""  MCU
 SG_ BOT_W_Register_Write_Index : 104|8@1+ (1,0) [0|255] ""  MCU
 SG_ BOT_V_Register_Write_Index : 96|8@1+ (1,0) [0|255] ""  MCU
 SG_ BOT_U_Register_Write_Index : 88|8@1+ (1,0) [0|255] ""  MCU
 SG_ TOP_W_Register_Write_Index : 80|8@1+ (1,0) [0|255] ""  MCU
 SG_ TOP_V_Register_Write_Index : 72|8@1+ (1,0) [0|255] ""  MCU
 SG_ TOP_U_Register_Write_Index : 64|8@1+ (1,0) [0|255] ""  MCU
 SG_ BOT_W_Status_Write_Data9 : 59|1@1+ (1,0) [0|1] ""  MCU
 SG_ BOT_W_Status_Write_Data8 : 58|1@1+ (1,0) [0|1] ""  MCU
 SG_ BOT_W_Status_Write_Data7 : 57|1@1+ (1,0) [0|1] ""  MCU
 SG_ BOT_W_Status_Write_Data6 : 56|1@1+ (1,0) [0|1] ""  MCU
 SG_ BOT_W_Status_Write_Data5 : 55|1@1+ (1,0) [0|1] ""  MCU
 SG_ BOT_W_Status_Write_Data4 : 54|1@1+ (1,0) [0|1] ""  MCU
 SG_ BOT_W_Status_Write_Data3 : 53|1@1+ (1,0) [0|1] ""  MCU
 SG_ BOT_W_Status_Write_Data2 : 52|1@1+ (1,0) [0|1] ""  MCU
 SG_ BOT_W_Status_Write_Data1 : 51|1@1+ (1,0) [0|1] ""  MCU
 SG_ BOT_W_Status_Write_Data0 : 50|1@1+ (1,0) [0|1] ""  MCU
 SG_ BOT_V_Status_Write_Data9 : 49|1@1+ (1,0) [0|1] ""  MCU
 SG_ BOT_V_Status_Write_Data8 : 48|1@1+ (1,0) [0|1] ""  MCU
 SG_ BOT_V_Status_Write_Data7 : 47|1@1+ (1,0) [0|1] ""  MCU
 SG_ BOT_V_Status_Write_Data6 : 46|1@1+ (1,0) [0|1] ""  MCU
 SG_ BOT_V_Status_Write_Data5 : 45|1@1+ (1,0) [0|1] ""  MCU
 SG_ BOT_V_Status_Write_Data4 : 44|1@1+ (1,0) [0|1] ""  MCU
 SG_ BOT_V_Status_Write_Data3 : 43|1@1+ (1,0) [0|1] ""  MCU
 SG_ BOT_V_Status_Write_Data2 : 42|1@1+ (1,0) [0|1] ""  MCU
 SG_ BOT_V_Status_Write_Data1 : 41|1@1+ (1,0) [0|1] ""  MCU
 SG_ BOT_V_Status_Write_Data0 : 40|1@1+ (1,0) [0|1] ""  MCU
 SG_ BOT_U_Status_Write_Data9 : 39|1@1+ (1,0) [0|1] ""  MCU
 SG_ BOT_U_Status_Write_Data8 : 38|1@1+ (1,0) [0|1] ""  MCU
 SG_ BOT_U_Status_Write_Data7 : 37|1@1+ (1,0) [0|1] ""  MCU
 SG_ BOT_U_Status_Write_Data6 : 36|1@1+ (1,0) [0|1] ""  MCU
 SG_ BOT_U_Status_Write_Data5 : 35|1@1+ (1,0) [0|1] ""  MCU
 SG_ BOT_U_Status_Write_Data4 : 34|1@1+ (1,0) [0|1] ""  MCU
 SG_ BOT_U_Status_Write_Data3 : 33|1@1+ (1,0) [0|1] ""  MCU
 SG_ BOT_U_Status_Write_Data2 : 32|1@1+ (1,0) [0|1] ""  MCU
 SG_ BOT_U_Status_Write_Data1 : 31|1@1+ (1,0) [0|1] ""  MCU
 SG_ BOT_U_Status_Write_Data0 : 30|1@1+ (1,0) [0|1] ""  MCU
 SG_ TOP_W_Status_Write_Data9 : 29|1@1+ (1,0) [0|1] ""  MCU
 SG_ TOP_W_Status_Write_Data8 : 28|1@1+ (1,0) [0|1] ""  MCU
 SG_ TOP_W_Status_Write_Data7 : 27|1@1+ (1,0) [0|1] ""  MCU
 SG_ TOP_W_Status_Write_Data6 : 26|1@1+ (1,0) [0|1] ""  MCU
 SG_ TOP_W_Status_Write_Data5 : 25|1@1+ (1,0) [0|1] ""  MCU
 SG_ TOP_W_Status_Write_Data4 : 24|1@1+ (1,0) [0|1] ""  MCU
 SG_ TOP_W_Status_Write_Data3 : 23|1@1+ (1,0) [0|1] ""  MCU
 SG_ TOP_W_Status_Write_Data2 : 22|1@1+ (1,0) [0|1] ""  MCU
 SG_ TOP_W_Status_Write_Data1 : 21|1@1+ (1,0) [0|1] ""  MCU
 SG_ TOP_W_Status_Write_Data0 : 20|1@1+ (1,0) [0|1] ""  MCU
 SG_ TOP_V_Status_Write_Data9 : 19|1@1+ (1,0) [0|1] ""  MCU
 SG_ TOP_V_Status_Write_Data8 : 18|1@1+ (1,0) [0|1] ""  MCU
 SG_ TOP_V_Status_Write_Data7 : 17|1@1+ (1,0) [0|1] ""  MCU
 SG_ TOP_V_Status_Write_Data6 : 16|1@1+ (1,0) [0|1] ""  MCU
 SG_ TOP_V_Status_Write_Data5 : 15|1@1+ (1,0) [0|1] ""  MCU
 SG_ TOP_V_Status_Write_Data4 : 14|1@1+ (1,0) [0|1] ""  MCU
 SG_ TOP_V_Status_Write_Data3 : 13|1@1+ (1,0) [0|1] ""  MCU
 SG_ TOP_V_Status_Write_Data2 : 12|1@1+ (1,0) [0|1] ""  MCU
 SG_ TOP_V_Status_Write_Data1 : 11|1@1+ (1,0) [0|1] ""  MCU
 SG_ TOP_V_Status_Write_Data0 : 10|1@1+ (1,0) [0|1] ""  MCU
 SG_ TOP_U_Status_Write_Data9 : 9|1@1+ (1,0) [0|1] ""  MCU
 SG_ TOP_U_Status_Write_Data8 : 8|1@1+ (1,0) [0|1] ""  MCU
 SG_ TOP_U_Status_Write_Data7 : 7|1@1+ (1,0) [0|1] ""  MCU
 SG_ TOP_U_Status_Write_Data6 : 6|1@1+ (1,0) [0|1] ""  MCU
 SG_ TOP_U_Status_Write_Data5 : 5|1@1+ (1,0) [0|1] ""  MCU
 SG_ TOP_U_Status_Write_Data4 : 4|1@1+ (1,0) [0|1] ""  MCU
 SG_ TOP_U_Status_Write_Data3 : 3|1@1+ (1,0) [0|1] ""  MCU
 SG_ TOP_U_Status_Write_Data2 : 2|1@1+ (1,0) [0|1] ""  MCU
 SG_ TOP_U_Status_Write_Data1 : 1|1@1+ (1,0) [0|1] ""  MCU
 SG_ TOP_U_Status_Write_Data0 : 0|1@1+ (1,0) [0|1] ""  MCU

BO_ 1562 MCU_TX_0x61A_DEVCANFD: 64 MCU
 SG_ BOT_W_TSENSEA_Freq : 392|16@1+ (1,0) [0|65535] "Hz"  GUI
 SG_ BOT_W_TSENSEA_Duty : 376|16@1+ (0.01,0) [0|100] "%"  GUI
 SG_ BOT_V_TSENSEA_Freq : 360|16@1+ (1,0) [0|65535] "Hz"  GUI
 SG_ BOT_V_TSENSEA_Duty : 344|16@1+ (0.01,0) [0|100] "%"  GUI
 SG_ BOT_U_TSENSEA_Freq : 328|16@1+ (1,0) [0|65535] "Hz"  GUI
 SG_ BOT_U_TSENSEA_Duty : 312|16@1+ (0.01,0) [0|100] "%"  GUI
 SG_ TOP_W_TSENSEA_Freq : 296|16@1+ (1,0) [0|65535] "Hz"  GUI
 SG_ TOP_W_TSENSEA_Duty : 280|16@1+ (0.01,0) [0|100] "%"  GUI
 SG_ TOP_V_TSENSEA_Freq : 264|16@1+ (1,0) [0|65535] "Hz"  GUI
 SG_ TOP_V_TSENSEA_Duty : 248|16@1+ (0.01,0) [0|100] "%"  GUI
 SG_ TOP_U_TSENSEA_Freq : 232|16@1+ (1,0) [0|65535] "Hz"  GUI
 SG_ TOP_U_TSENSEA_Duty : 216|16@1+ (0.01,0) [0|100] "%"  GUI
 SG_ BOT_W_DISCHG_Data : 206|10@1+ (1,0) [0|1023] ""  GUI
 SG_ BOT_W_DISCHG_CRC : 88|8@1+ (1,0) [0|255] ""  GUI
 SG_ BOT_V_DISCHG_Data : 196|10@1+ (1,0) [0|1023] ""  GUI
 SG_ BOT_V_DISCHG_CRC : 80|8@1+ (1,0) [0|255] ""  GUI
 SG_ BOT_U_DISCHG_Data : 186|10@1+ (1,0) [0|1023] ""  GUI
 SG_ BOT_U_DISCHG_CRC : 72|8@1+ (1,0) [0|255] ""  GUI
 SG_ TOP_W_DISCHG_Data : 176|10@1+ (1,0) [0|1023] ""  GUI
 SG_ TOP_W_DISCHG_CRC : 64|8@1+ (1,0) [0|255] ""  GUI
 SG_ TOP_V_DISCHG_Data : 166|10@1+ (1,0) [0|1023] ""  GUI
 SG_ TOP_V_DISCHG_CRC : 56|8@1+ (1,0) [0|255] ""  GUI
 SG_ TOP_U_DISCHG_Data : 156|10@1+ (1,0) [0|1023] ""  GUI
 SG_ TOP_U_DISCHG_CRC : 48|8@1+ (1,0) [0|255] ""  GUI
 SG_ BOT_W_REQBIST_Data : 146|10@1+ (1,0) [0|1023] ""  GUI
 SG_ BOT_W_REQBIST_CRC : 40|8@1+ (1,0) [0|255] ""  GUI
 SG_ BOT_V_REQBIST_Data : 136|10@1+ (1,0) [0|1023] ""  GUI
 SG_ BOT_V_REQBIST_CRC : 32|8@1+ (1,0) [0|255] ""  GUI
 SG_ BOT_U_REQBIST_Data : 126|10@1+ (1,0) [0|1023] ""  GUI
 SG_ BOT_U_REQBIST_CRC : 24|8@1+ (1,0) [0|255] ""  GUI
 SG_ TOP_W_REQBIST_Data : 116|10@1+ (1,0) [0|1023] ""  GUI
 SG_ TOP_W_REQBIST_CRC : 16|8@1+ (1,0) [0|255] ""  GUI
 SG_ TOP_V_REQBIST_Data : 106|10@1+ (1,0) [0|1023] ""  GUI
 SG_ TOP_V_REQBIST_CRC : 8|8@1+ (1,0) [0|255] ""  GUI
 SG_ TOP_U_REQBIST_Data : 96|10@1+ (1,0) [0|1023] ""  GUI
 SG_ TOP_U_REQBIST_CRC : 0|8@1+ (1,0) [0|255] ""  GUI

BO_ 1561 MCU_TX_0x619_DEVCANFD: 64 MCU
 SG_ BOT_W_CONFIGAOUT_Data : 422|10@1+ (1,0) [0|1023] ""  GUI
 SG_ BOT_W_CONFIGAOUT_CRC : 184|8@1+ (1,0) [0|255] ""  GUI
 SG_ BOT_V_CONFIGAOUT_Data : 412|10@1+ (1,0) [0|1023] ""  GUI
 SG_ BOT_V_CONFIGAOUT_CRC : 176|8@1+ (1,0) [0|255] ""  GUI
 SG_ BOT_U_CONFIGAOUT_Data : 402|10@1+ (1,0) [0|1023] ""  GUI
 SG_ BOT_U_CONFIGAOUT_CRC : 168|8@1+ (1,0) [0|255] ""  GUI
 SG_ TOP_W_CONFIGAOUT_Data : 392|10@1+ (1,0) [0|1023] ""  GUI
 SG_ TOP_W_CONFIGAOUT_CRC : 160|8@1+ (1,0) [0|255] ""  GUI
 SG_ TOP_V_CONFIGAOUT_Data : 382|10@1+ (1,0) [0|1023] ""  GUI
 SG_ TOP_V_CONFIGAOUT_CRC : 152|8@1+ (1,0) [0|255] ""  GUI
 SG_ TOP_U_CONFIGAOUT_Data : 372|10@1+ (1,0) [0|1023] ""  GUI
 SG_ TOP_U_CONFIGAOUT_CRC : 144|8@1+ (1,0) [0|255] ""  GUI
 SG_ BOT_W_STATCON4_Data : 362|10@1+ (1,0) [0|1023] ""  GUI
 SG_ BOT_W_STATCON4_CRC : 136|8@1+ (1,0) [0|255] ""  GUI
 SG_ BOT_V_STATCON4_Data : 352|10@1+ (1,0) [0|1023] ""  GUI
 SG_ BOT_V_STATCON4_CRC : 128|8@1+ (1,0) [0|255] ""  GUI
 SG_ BOT_U_STATCON4_Data : 342|10@1+ (1,0) [0|1023] ""  GUI
 SG_ BOT_U_STATCON4_CRC : 120|8@1+ (1,0) [0|255] ""  GUI
 SG_ TOP_W_STATCON4_Data : 332|10@1+ (1,0) [0|1023] ""  GUI
 SG_ TOP_W_STATCON4_CRC : 112|8@1+ (1,0) [0|255] ""  GUI
 SG_ TOP_V_STATCON4_Data : 322|10@1+ (1,0) [0|1023] ""  GUI
 SG_ TOP_V_STATCON4_CRC : 104|8@1+ (1,0) [0|255] ""  GUI
 SG_ TOP_U_STATCON4_Data : 312|10@1+ (1,0) [0|1023] ""  GUI
 SG_ TOP_U_STATCON4_CRC : 96|8@1+ (1,0) [0|255] ""  GUI
 SG_ BOT_W_STATUS3_Data : 302|10@1+ (1,0) [0|1023] ""  GUI
 SG_ BOT_W_STATUS3_CRC : 88|8@1+ (1,0) [0|255] ""  GUI
 SG_ BOT_V_STATUS3_Data : 292|10@1+ (1,0) [0|1023] ""  GUI
 SG_ BOT_V_STATUS3_CRC : 80|8@1+ (1,0) [0|255] ""  GUI
 SG_ BOT_U_STATUS3_Data : 282|10@1+ (1,0) [0|1023] ""  GUI
 SG_ BOT_U_STATUS3_CRC : 72|8@1+ (1,0) [0|255] ""  GUI
 SG_ TOP_W_STATUS3_Data : 272|10@1+ (1,0) [0|1023] ""  GUI
 SG_ TOP_W_STATUS3_CRC : 64|8@1+ (1,0) [0|255] ""  GUI
 SG_ TOP_V_STATUS3_Data : 262|10@1+ (1,0) [0|1023] ""  GUI
 SG_ TOP_V_STATUS3_CRC : 56|8@1+ (1,0) [0|255] ""  GUI
 SG_ TOP_U_STATUS3_Data : 252|10@1+ (1,0) [0|1023] ""  GUI
 SG_ TOP_U_STATUS3_CRC : 48|8@1+ (1,0) [0|255] ""  GUI
 SG_ BOT_W_RMSK2_Data : 242|10@1+ (1,0) [0|1023] ""  GUI
 SG_ BOT_W_RMSK2_CRC : 40|8@1+ (1,0) [0|255] ""  GUI
 SG_ BOT_V_RMSK2_Data : 232|10@1+ (1,0) [0|1023] ""  GUI
 SG_ BOT_V_RMSK2_CRC : 32|8@1+ (1,0) [0|255] ""  GUI
 SG_ BOT_U_RMSK2_Data : 222|10@1+ (1,0) [0|1023] ""  GUI
 SG_ BOT_U_RMSK2_CRC : 24|8@1+ (1,0) [0|255] ""  GUI
 SG_ TOP_W_RMSK2_Data : 212|10@1+ (1,0) [0|1023] ""  GUI
 SG_ TOP_W_RMSK2_CRC : 16|8@1+ (1,0) [0|255] ""  GUI
 SG_ TOP_V_RMSK2_Data : 202|10@1+ (1,0) [0|1023] ""  GUI
 SG_ TOP_V_RMSK2_CRC : 8|8@1+ (1,0) [0|255] ""  GUI
 SG_ TOP_U_RMSK2_Data : 192|10@1+ (1,0) [0|1023] ""  GUI
 SG_ TOP_U_RMSK2_CRC : 0|8@1+ (1,0) [0|255] ""  GUI

BO_ 1560 MCU_TX_0x618_DEVCANFD: 64 MCU
 SG_ BOT_W_MSK2_Data : 422|10@1+ (1,0) [0|1023] ""  GUI
 SG_ BOT_W_MSK2_CRC : 184|8@1+ (1,0) [0|255] ""  GUI
 SG_ BOT_V_MSK2_Data : 412|10@1+ (1,0) [0|1023] ""  GUI
 SG_ BOT_V_MSK2_CRC : 176|8@1+ (1,0) [0|255] ""  GUI
 SG_ BOT_U_MSK2_Data : 402|10@1+ (1,0) [0|1023] ""  GUI
 SG_ BOT_U_MSK2_CRC : 168|8@1+ (1,0) [0|255] ""  GUI
 SG_ TOP_W_MSK2_Data : 392|10@1+ (1,0) [0|1023] ""  GUI
 SG_ TOP_W_MSK2_CRC : 160|8@1+ (1,0) [0|255] ""  GUI
 SG_ TOP_V_MSK2_Data : 382|10@1+ (1,0) [0|1023] ""  GUI
 SG_ TOP_V_MSK2_CRC : 152|8@1+ (1,0) [0|255] ""  GUI
 SG_ TOP_U_MSK2_Data : 372|10@1+ (1,0) [0|1023] ""  GUI
 SG_ TOP_U_MSK2_CRC : 144|8@1+ (1,0) [0|255] ""  GUI
 SG_ BOT_W_STATUS2_Data : 362|10@1+ (1,0) [0|1023] ""  GUI
 SG_ BOT_W_STATUS2_CRC : 136|8@1+ (1,0) [0|255] ""  GUI
 SG_ BOT_V_STATUS2_Data : 352|10@1+ (1,0) [0|1023] ""  GUI
 SG_ BOT_V_STATUS2_CRC : 128|8@1+ (1,0) [0|255] ""  GUI
 SG_ BOT_U_STATUS2_Data : 342|10@1+ (1,0) [0|1023] ""  GUI
 SG_ BOT_U_STATUS2_CRC : 120|8@1+ (1,0) [0|255] ""  GUI
 SG_ TOP_W_STATUS2_Data : 332|10@1+ (1,0) [0|1023] ""  GUI
 SG_ TOP_W_STATUS2_CRC : 112|8@1+ (1,0) [0|255] ""  GUI
 SG_ TOP_V_STATUS2_Data : 322|10@1+ (1,0) [0|1023] ""  GUI
 SG_ TOP_V_STATUS2_CRC : 104|8@1+ (1,0) [0|255] ""  GUI
 SG_ TOP_U_STATUS2_Data : 312|10@1+ (1,0) [0|1023] ""  GUI
 SG_ TOP_U_STATUS2_CRC : 96|8@1+ (1,0) [0|255] ""  GUI
 SG_ BOT_W_RMSK1_Data : 302|10@1+ (1,0) [0|1023] ""  GUI
 SG_ BOT_W_RMSK1_CRC : 88|8@1+ (1,0) [0|255] ""  GUI
 SG_ BOT_V_RMSK1_Data : 292|10@1+ (1,0) [0|1023] ""  GUI
 SG_ BOT_V_RMSK1_CRC : 80|8@1+ (1,0) [0|255] ""  GUI
 SG_ BOT_U_RMSK1_Data : 282|10@1+ (1,0) [0|1023] ""  GUI
 SG_ BOT_U_RMSK1_CRC : 72|8@1+ (1,0) [0|255] ""  GUI
 SG_ TOP_W_RMSK1_Data : 272|10@1+ (1,0) [0|1023] ""  GUI
 SG_ TOP_W_RMSK1_CRC : 64|8@1+ (1,0) [0|255] ""  GUI
 SG_ TOP_V_RMSK1_Data : 262|10@1+ (1,0) [0|1023] ""  GUI
 SG_ TOP_V_RMSK1_CRC : 56|8@1+ (1,0) [0|255] ""  GUI
 SG_ TOP_U_RMSK1_Data : 252|10@1+ (1,0) [0|1023] ""  GUI
 SG_ TOP_U_RMSK1_CRC : 48|8@1+ (1,0) [0|255] ""  GUI
 SG_ BOT_W_MSK1_Data : 242|10@1+ (1,0) [0|1023] ""  GUI
 SG_ BOT_W_MSK1_CRC : 40|8@1+ (1,0) [0|255] ""  GUI
 SG_ BOT_V_MSK1_Data : 232|10@1+ (1,0) [0|1023] ""  GUI
 SG_ BOT_V_MSK1_CRC : 32|8@1+ (1,0) [0|255] ""  GUI
 SG_ BOT_U_MSK1_Data : 222|10@1+ (1,0) [0|1023] ""  GUI
 SG_ BOT_U_MSK1_CRC : 24|8@1+ (1,0) [0|255] ""  GUI
 SG_ TOP_W_MSK1_Data : 212|10@1+ (1,0) [0|1023] ""  GUI
 SG_ TOP_W_MSK1_CRC : 16|8@1+ (1,0) [0|255] ""  GUI
 SG_ TOP_V_MSK1_Data : 202|10@1+ (1,0) [0|1023] ""  GUI
 SG_ TOP_V_MSK1_CRC : 8|8@1+ (1,0) [0|255] ""  GUI
 SG_ TOP_U_MSK1_Data : 192|10@1+ (1,0) [0|1023] ""  GUI
 SG_ TOP_U_MSK1_CRC : 0|8@1+ (1,0) [0|255] ""  GUI

BO_ 1559 MCU_TX_0x617_DEVCANFD: 64 MCU
 SG_ BOT_W_AOUT_Freq : 480|16@1+ (1,0) [0|65535] "Hz"  GUI
 SG_ BOT_W_AOUT_Duty : 464|16@1+ (0.01,0) [0|100] "%"  GUI
 SG_ TOP_W_AOUT_Freq : 448|16@1+ (1,0) [0|65535] "Hz"  GUI
 SG_ TOP_W_AOUT_Duty : 432|16@1+ (0.01,0) [0|100] "%"  GUI
 SG_ BOT_W_STATUS1_Data : 422|10@1+ (1,0) [0|1023] ""  GUI
 SG_ BOT_W_STATUS1_CRC : 184|8@1+ (1,0) [0|255] ""  GUI
 SG_ BOT_V_STATUS1_Data : 412|10@1+ (1,0) [0|1023] ""  GUI
 SG_ BOT_V_STATUS1_CRC : 176|8@1+ (1,0) [0|255] ""  GUI
 SG_ BOT_U_STATUS1_Data : 402|10@1+ (1,0) [0|1023] ""  GUI
 SG_ BOT_U_STATUS1_CRC : 168|8@1+ (1,0) [0|255] ""  GUI
 SG_ TOP_W_STATUS1_Data : 392|10@1+ (1,0) [0|1023] ""  GUI
 SG_ TOP_W_STATUS1_CRC : 160|8@1+ (1,0) [0|255] ""  GUI
 SG_ TOP_V_STATUS1_Data : 382|10@1+ (1,0) [0|1023] ""  GUI
 SG_ TOP_V_STATUS1_CRC : 152|8@1+ (1,0) [0|255] ""  GUI
 SG_ TOP_U_STATUS1_Data : 372|10@1+ (1,0) [0|1023] ""  GUI
 SG_ TOP_U_STATUS1_CRC : 144|8@1+ (1,0) [0|255] ""  GUI
 SG_ BOT_W_OTW_TH_Data : 362|10@1+ (1,0) [0|1023] ""  GUI
 SG_ BOT_W_OTW_TH_CRC : 136|8@1+ (1,0) [0|255] ""  GUI
 SG_ BOT_V_OTW_TH_Data : 352|10@1+ (1,0) [0|1023] ""  GUI
 SG_ BOT_V_OTW_TH_CRC : 128|8@1+ (1,0) [0|255] ""  GUI
 SG_ BOT_U_OTW_TH_Data : 342|10@1+ (1,0) [0|1023] ""  GUI
 SG_ BOT_U_OTW_TH_CRC : 120|8@1+ (1,0) [0|255] ""  GUI
 SG_ TOP_W_OTW_TH_Data : 332|10@1+ (1,0) [0|1023] ""  GUI
 SG_ TOP_W_OTW_TH_CRC : 112|8@1+ (1,0) [0|255] ""  GUI
 SG_ TOP_V_OTW_TH_Data : 322|10@1+ (1,0) [0|1023] ""  GUI
 SG_ TOP_V_OTW_TH_CRC : 104|8@1+ (1,0) [0|255] ""  GUI
 SG_ TOP_U_OTW_TH_Data : 312|10@1+ (1,0) [0|1023] ""  GUI
 SG_ TOP_U_OTW_TH_CRC : 96|8@1+ (1,0) [0|255] ""  GUI
 SG_ BOT_W_OT_TH_Data : 302|10@1+ (1,0) [0|1023] ""  GUI
 SG_ BOT_W_OT_TH_CRC : 88|8@1+ (1,0) [0|255] ""  GUI
 SG_ BOT_V_OT_TH_Data : 292|10@1+ (1,0) [0|1023] ""  GUI
 SG_ BOT_V_OT_TH_CRC : 80|8@1+ (1,0) [0|255] ""  GUI
 SG_ BOT_U_OT_TH_Data : 282|10@1+ (1,0) [0|1023] ""  GUI
 SG_ BOT_U_OT_TH_CRC : 72|8@1+ (1,0) [0|255] ""  GUI
 SG_ TOP_W_OT_TH_Data : 272|10@1+ (1,0) [0|1023] ""  GUI
 SG_ TOP_W_OT_TH_CRC : 64|8@1+ (1,0) [0|255] ""  GUI
 SG_ TOP_V_OT_TH_Data : 262|10@1+ (1,0) [0|1023] ""  GUI
 SG_ TOP_V_OT_TH_CRC : 56|8@1+ (1,0) [0|255] ""  GUI
 SG_ TOP_U_OT_TH_Data : 252|10@1+ (1,0) [0|1023] ""  GUI
 SG_ TOP_U_OT_TH_CRC : 48|8@1+ (1,0) [0|255] ""  GUI
 SG_ BOT_W_CONFIG7_Data : 242|10@1+ (1,0) [0|1023] ""  GUI
 SG_ BOT_W_CONFIG7_CRC : 40|8@1+ (1,0) [0|255] ""  GUI
 SG_ BOT_V_CONFIG7_Data : 232|10@1+ (1,0) [0|1023] ""  GUI
 SG_ BOT_V_CONFIG7_CRC : 32|8@1+ (1,0) [0|255] ""  GUI
 SG_ BOT_U_CONFIG7_Data : 222|10@1+ (1,0) [0|1023] ""  GUI
 SG_ BOT_U_CONFIG7_CRC : 24|8@1+ (1,0) [0|255] ""  GUI
 SG_ TOP_W_CONFIG7_Data : 212|10@1+ (1,0) [0|1023] ""  GUI
 SG_ TOP_W_CONFIG7_CRC : 16|8@1+ (1,0) [0|255] ""  GUI
 SG_ TOP_V_CONFIG7_Data : 202|10@1+ (1,0) [0|1023] ""  GUI
 SG_ TOP_V_CONFIG7_CRC : 8|8@1+ (1,0) [0|255] ""  GUI
 SG_ TOP_U_CONFIG7_Data : 192|10@1+ (1,0) [0|1023] ""  GUI
 SG_ TOP_U_CONFIG7_CRC : 0|8@1+ (1,0) [0|255] ""  GUI

BO_ 1557 MCU_TX_0x615_DEVCANFD: 64 MCU
 SG_ BOT_V_AOUT_Freq : 480|16@1+ (1,0) [0|65535] "Hz"  GUI
 SG_ BOT_V_AOUT_Duty : 464|16@1+ (0.01,0) [0|100] "%"  GUI
 SG_ TOP_V_AOUT_Freq : 448|16@1+ (1,0) [0|65535] "Hz"  GUI
 SG_ TOP_V_AOUT_Duty : 432|16@1+ (0.01,0) [0|100] "%"  GUI
 SG_ BOT_W_CONFIG6_Data : 422|10@1+ (1,0) [0|1023] ""  GUI
 SG_ BOT_W_CONFIG6_CRC : 184|8@1+ (1,0) [0|255] ""  GUI
 SG_ BOT_V_CONFIG6_Data : 412|10@1+ (1,0) [0|1023] ""  GUI
 SG_ BOT_V_CONFIG6_CRC : 176|8@1+ (1,0) [0|255] ""  GUI
 SG_ BOT_U_CONFIG6_Data : 402|10@1+ (1,0) [0|1023] ""  GUI
 SG_ BOT_U_CONFIG6_CRC : 168|8@1+ (1,0) [0|255] ""  GUI
 SG_ TOP_W_CONFIG6_Data : 392|10@1+ (1,0) [0|1023] ""  GUI
 SG_ TOP_W_CONFIG6_CRC : 160|8@1+ (1,0) [0|255] ""  GUI
 SG_ TOP_V_CONFIG6_Data : 382|10@1+ (1,0) [0|1023] ""  GUI
 SG_ TOP_V_CONFIG6_CRC : 152|8@1+ (1,0) [0|255] ""  GUI
 SG_ TOP_U_CONFIG6_Data : 372|10@1+ (1,0) [0|1023] ""  GUI
 SG_ TOP_U_CONFIG6_CRC : 144|8@1+ (1,0) [0|255] ""  GUI
 SG_ BOT_W_CONFIG5_Data : 362|10@1+ (1,0) [0|1023] ""  GUI
 SG_ BOT_W_CONFIG5_CRC : 136|8@1+ (1,0) [0|255] ""  GUI
 SG_ BOT_V_CONFIG5_Data : 352|10@1+ (1,0) [0|1023] ""  GUI
 SG_ BOT_V_CONFIG5_CRC : 128|8@1+ (1,0) [0|255] ""  GUI
 SG_ BOT_U_CONFIG5_Data : 342|10@1+ (1,0) [0|1023] ""  GUI
 SG_ BOT_U_CONFIG5_CRC : 120|8@1+ (1,0) [0|255] ""  GUI
 SG_ TOP_W_CONFIG5_Data : 332|10@1+ (1,0) [0|1023] ""  GUI
 SG_ TOP_W_CONFIG5_CRC : 112|8@1+ (1,0) [0|255] ""  GUI
 SG_ TOP_V_CONFIG5_Data : 322|10@1+ (1,0) [0|1023] ""  GUI
 SG_ TOP_V_CONFIG5_CRC : 104|8@1+ (1,0) [0|255] ""  GUI
 SG_ TOP_U_CONFIG5_Data : 312|10@1+ (1,0) [0|1023] ""  GUI
 SG_ TOP_U_CONFIG5_CRC : 96|8@1+ (1,0) [0|255] ""  GUI
 SG_ BOT_W_CONFIG4_Data : 302|10@1+ (1,0) [0|1023] ""  GUI
 SG_ BOT_W_CONFIG4_CRC : 88|8@1+ (1,0) [0|255] ""  GUI
 SG_ BOT_V_CONFIG4_Data : 292|10@1+ (1,0) [0|1023] ""  GUI
 SG_ BOT_V_CONFIG4_CRC : 80|8@1+ (1,0) [0|255] ""  GUI
 SG_ BOT_U_CONFIG4_Data : 282|10@1+ (1,0) [0|1023] ""  GUI
 SG_ BOT_U_CONFIG4_CRC : 72|8@1+ (1,0) [0|255] ""  GUI
 SG_ TOP_W_CONFIG4_Data : 272|10@1+ (1,0) [0|1023] ""  GUI
 SG_ TOP_W_CONFIG4_CRC : 64|8@1+ (1,0) [0|255] ""  GUI
 SG_ TOP_V_CONFIG4_Data : 262|10@1+ (1,0) [0|1023] ""  GUI
 SG_ TOP_V_CONFIG4_CRC : 56|8@1+ (1,0) [0|255] ""  GUI
 SG_ TOP_U_CONFIG4_Data : 252|10@1+ (1,0) [0|1023] ""  GUI
 SG_ TOP_U_CONFIG4_CRC : 48|8@1+ (1,0) [0|255] ""  GUI
 SG_ BOT_W_CONFIG3_Data : 242|10@1+ (1,0) [0|1023] ""  GUI
 SG_ BOT_W_CONFIG3_CRC : 40|8@1+ (1,0) [0|255] ""  GUI
 SG_ BOT_V_CONFIG3_Data : 232|10@1+ (1,0) [0|1023] ""  GUI
 SG_ BOT_V_CONFIG3_CRC : 32|8@1+ (1,0) [0|255] ""  GUI
 SG_ BOT_U_CONFIG3_Data : 222|10@1+ (1,0) [0|1023] ""  GUI
 SG_ BOT_U_CONFIG3_CRC : 24|8@1+ (1,0) [0|255] ""  GUI
 SG_ TOP_W_CONFIG3_Data : 212|10@1+ (1,0) [0|1023] ""  GUI
 SG_ TOP_W_CONFIG3_CRC : 16|8@1+ (1,0) [0|255] ""  GUI
 SG_ TOP_V_CONFIG3_Data : 202|10@1+ (1,0) [0|1023] ""  GUI
 SG_ TOP_V_CONFIG3_CRC : 8|8@1+ (1,0) [0|255] ""  GUI
 SG_ TOP_U_CONFIG3_Data : 192|10@1+ (1,0) [0|1023] ""  GUI
 SG_ TOP_U_CONFIG3_CRC : 0|8@1+ (1,0) [0|255] ""  GUI

BO_ 1556 MCU_TX_0x614_DEVCANFD: 64 MCU
 SG_ BOT_U_AOUT_Freq : 480|16@1+ (1,0) [0|65535] "Hz"  GUI
 SG_ BOT_U_AOUT_Duty : 464|16@1+ (0.01,0) [0|100] "%"  GUI
 SG_ TOP_U_AOUT_Freq : 448|16@1+ (1,0) [0|65535] "Hz"  GUI
 SG_ TOP_U_AOUT_Duty : 432|16@1+ (0.01,0) [0|100] "%"  GUI
 SG_ BOT_W_CONFIG2_Data : 422|10@1+ (1,0) [0|1023] ""  GUI
 SG_ BOT_W_CONFIG2_CRC : 184|8@1+ (1,0) [0|255] ""  GUI
 SG_ BOT_V_CONFIG2_Data : 412|10@1+ (1,0) [0|1023] ""  GUI
 SG_ BOT_V_CONFIG2_CRC : 176|8@1+ (1,0) [0|255] ""  GUI
 SG_ BOT_U_CONFIG2_Data : 402|10@1+ (1,0) [0|1023] ""  GUI
 SG_ BOT_U_CONFIG2_CRC : 168|8@1+ (1,0) [0|255] ""  GUI
 SG_ TOP_W_CONFIG2_Data : 392|10@1+ (1,0) [0|1023] ""  GUI
 SG_ TOP_W_CONFIG2_CRC : 160|8@1+ (1,0) [0|255] ""  GUI
 SG_ TOP_V_CONFIG2_Data : 382|10@1+ (1,0) [0|1023] ""  GUI
 SG_ TOP_V_CONFIG2_CRC : 152|8@1+ (1,0) [0|255] ""  GUI
 SG_ TOP_U_CONFIG2_Data : 372|10@1+ (1,0) [0|1023] ""  GUI
 SG_ TOP_U_CONFIG2_CRC : 144|8@1+ (1,0) [0|255] ""  GUI
 SG_ BOT_W_CONFIG1_Data : 362|10@1+ (1,0) [0|1023] ""  GUI
 SG_ BOT_W_CONFIG1_CRC : 136|8@1+ (1,0) [0|255] ""  GUI
 SG_ BOT_V_CONFIG1_Data : 352|10@1+ (1,0) [0|1023] ""  GUI
 SG_ BOT_V_CONFIG1_CRC : 128|8@1+ (1,0) [0|255] ""  GUI
 SG_ BOT_U_CONFIG1_Data : 342|10@1+ (1,0) [0|1023] ""  GUI
 SG_ BOT_U_CONFIG1_CRC : 120|8@1+ (1,0) [0|255] ""  GUI
 SG_ TOP_W_CONFIG1_Data : 332|10@1+ (1,0) [0|1023] ""  GUI
 SG_ TOP_W_CONFIG1_CRC : 112|8@1+ (1,0) [0|255] ""  GUI
 SG_ TOP_V_CONFIG1_Data : 322|10@1+ (1,0) [0|1023] ""  GUI
 SG_ TOP_V_CONFIG1_CRC : 104|8@1+ (1,0) [0|255] ""  GUI
 SG_ TOP_U_CONFIG1_Data : 312|10@1+ (1,0) [0|1023] ""  GUI
 SG_ TOP_U_CONFIG1_CRC : 96|8@1+ (1,0) [0|255] ""  GUI
 SG_ BOT_W_MODE2_Data : 302|10@1+ (1,0) [0|1023] ""  GUI
 SG_ BOT_W_MODE2_CRC : 88|8@1+ (1,0) [0|255] ""  GUI
 SG_ BOT_V_MODE2_Data : 292|10@1+ (1,0) [0|1023] ""  GUI
 SG_ BOT_V_MODE2_CRC : 80|8@1+ (1,0) [0|255] ""  GUI
 SG_ BOT_U_MODE2_Data : 282|10@1+ (1,0) [0|1023] ""  GUI
 SG_ BOT_U_MODE2_CRC : 72|8@1+ (1,0) [0|255] ""  GUI
 SG_ TOP_W_MODE2_Data : 272|10@1+ (1,0) [0|1023] ""  GUI
 SG_ TOP_W_MODE2_CRC : 64|8@1+ (1,0) [0|255] ""  GUI
 SG_ TOP_V_MODE2_Data : 262|10@1+ (1,0) [0|1023] ""  GUI
 SG_ TOP_V_MODE2_CRC : 56|8@1+ (1,0) [0|255] ""  GUI
 SG_ TOP_U_MODE2_Data : 252|10@1+ (1,0) [0|1023] ""  GUI
 SG_ TOP_U_MODE2_CRC : 48|8@1+ (1,0) [0|255] ""  GUI
 SG_ BOT_W_MODE1_Data : 242|10@1+ (1,0) [0|1023] ""  GUI
 SG_ BOT_W_MODE1_CRC : 40|8@1+ (1,0) [0|255] ""  GUI
 SG_ BOT_V_MODE1_Data : 232|10@1+ (1,0) [0|1023] ""  GUI
 SG_ BOT_V_MODE1_CRC : 32|8@1+ (1,0) [0|255] ""  GUI
 SG_ BOT_U_MODE1_Data : 222|10@1+ (1,0) [0|1023] ""  GUI
 SG_ BOT_U_MODE1_CRC : 24|8@1+ (1,0) [0|255] ""  GUI
 SG_ TOP_W_MODE1_Data : 212|10@1+ (1,0) [0|1023] ""  GUI
 SG_ TOP_W_MODE1_CRC : 16|8@1+ (1,0) [0|255] ""  GUI
 SG_ TOP_V_MODE1_Data : 202|10@1+ (1,0) [0|1023] ""  GUI
 SG_ TOP_V_MODE1_CRC : 8|8@1+ (1,0) [0|255] ""  GUI
 SG_ TOP_U_MODE1_Data : 192|10@1+ (1,0) [0|1023] ""  GUI
 SG_ TOP_U_MODE1_CRC : 0|8@1+ (1,0) [0|255] ""  GUI

BO_ 1555 MCU_TX_0x613_DEVCANFD: 64 MCU
 SG_ BOT_W_ID_Data : 450|10@1+ (1,0) [0|1023] ""  GUI
 SG_ BOT_W_ID_CRC : 392|8@1+ (1,0) [0|255] ""  GUI
 SG_ BOT_V_ID_Data : 440|10@1+ (1,0) [0|1023] ""  GUI
 SG_ BOT_V_ID_CRC : 384|8@1+ (1,0) [0|255] ""  GUI
 SG_ BOT_U_ID_Data : 430|10@1+ (1,0) [0|1023] ""  GUI
 SG_ BOT_U_ID_CRC : 376|8@1+ (1,0) [0|255] ""  GUI
 SG_ TOP_W_ID_Data : 420|10@1+ (1,0) [0|1023] ""  GUI
 SG_ TOP_W_ID_CRC : 368|8@1+ (1,0) [0|255] ""  GUI
 SG_ TOP_V_ID_Data : 410|10@1+ (1,0) [0|1023] ""  GUI
 SG_ TOP_V_ID_CRC : 360|8@1+ (1,0) [0|255] ""  GUI
 SG_ TOP_U_ID_Data : 400|10@1+ (1,0) [0|1023] ""  GUI
 SG_ TOP_U_ID_CRC : 352|8@1+ (1,0) [0|255] ""  GUI
 SG_ BOT_W_REQADC_Data : 338|10@1+ (1,0) [0|1023] ""  GUI
 SG_ BOT_W_REQADC_CRC : 280|8@1+ (1,0) [0|255] ""  GUI
 SG_ BOT_V_REQADC_Data : 328|10@1+ (1,0) [0|1023] ""  GUI
 SG_ BOT_V_REQADC_CRC : 272|8@1+ (1,0) [0|255] ""  GUI
 SG_ BOT_U_REQADC_Data : 318|10@1+ (1,0) [0|1023] ""  GUI
 SG_ BOT_U_REQADC_CRC : 264|8@1+ (1,0) [0|255] ""  GUI
 SG_ TOP_W_REQADC_Data : 308|10@1+ (1,0) [0|1023] ""  GUI
 SG_ TOP_W_REQADC_CRC : 256|8@1+ (1,0) [0|255] ""  GUI
 SG_ TOP_V_REQADC_Data : 298|10@1+ (1,0) [0|1023] ""  GUI
 SG_ TOP_V_REQADC_CRC : 248|8@1+ (1,0) [0|255] ""  GUI
 SG_ TOP_U_REQADC_Data : 288|10@1+ (1,0) [0|1023] ""  GUI
 SG_ TOP_U_REQADC_CRC : 240|8@1+ (1,0) [0|255] ""  GUI
 SG_ BOT_W_STATCON4_CMP_OUT : 238|1@1+ (1,0) [0|1] ""  GUI
 SG_ BOT_W_STATCON4_GS_ERR : 237|1@1+ (1,0) [0|1] ""  GUI
 SG_ BOT_W_STATCON4_GS_H_WS_CNF : 236|1@1+ (1,0) [0|1] ""  GUI
 SG_ BOT_W_STATCON4_GS_H_US_CNF : 235|1@1+ (1,0) [0|1] ""  GUI
 SG_ BOT_W_STATCON4_GS_L_WS_CNF : 234|1@1+ (1,0) [0|1] ""  GUI
 SG_ BOT_W_STATCON4_GS_L_US_CNF : 233|1@1+ (1,0) [0|1] ""  GUI
 SG_ BOT_W_STATCON4_GS_H_WS_ST : 232|1@1+ (1,0) [0|1] ""  GUI
 SG_ BOT_W_STATCON4_GS_H_US_ST : 231|1@1+ (1,0) [0|1] ""  GUI
 SG_ BOT_W_STATCON4_GS_L_WS_ST : 230|1@1+ (1,0) [0|1] ""  GUI
 SG_ BOT_W_STATCON4_GS_L_US_ST : 229|1@1+ (1,0) [0|1] ""  GUI
 SG_ BOT_W_STATUS3_FSISO_ST : 228|1@1+ (1,0) [0|1] ""  GUI
 SG_ BOT_W_STATUS3_FSISO : 227|1@1+ (1,0) [0|1] ""  GUI
 SG_ BOT_W_STATUS3_PWM : 226|1@1+ (1,0) [0|1] ""  GUI
 SG_ BOT_W_STATUS3_PWMALT : 225|1@1+ (1,0) [0|1] ""  GUI
 SG_ BOT_W_STATUS3_FSSTATE : 224|1@1+ (1,0) [0|1] ""  GUI
 SG_ BOT_W_STATUS3_FSENB : 223|1@1+ (1,0) [0|1] ""  GUI
 SG_ BOT_W_STATUS3_INTB : 222|1@1+ (1,0) [0|1] ""  GUI
 SG_ BOT_W_STATUS3_INTA_RTRPT : 221|1@1+ (1,0) [0|1] ""  GUI
 SG_ BOT_W_STATUS3_VRTMON : 220|1@1+ (1,0) [0|1] ""  GUI
 SG_ BOT_W_STATUS2_BIST_FAIL : 219|1@1+ (1,0) [0|1] ""  GUI
 SG_ BOT_W_STATUS2_VDD_UVOV : 218|1@1+ (1,0) [0|1] ""  GUI
 SG_ BOT_W_STATUS2_DTFLT : 217|1@1+ (1,0) [0|1] ""  GUI
 SG_ BOT_W_STATUS2_SPIERR : 216|1@1+ (1,0) [0|1] ""  GUI
 SG_ BOT_W_STATUS2_CONFCRCERR : 215|1@1+ (1,0) [0|1] ""  GUI
 SG_ BOT_W_STATUS2_RTMON_FLT : 214|1@1+ (1,0) [0|1] ""  GUI
 SG_ BOT_W_STATUS2_WDOG_FLT : 213|1@1+ (1,0) [0|1] ""  GUI
 SG_ BOT_W_STATUS2_COMERR : 212|1@1+ (1,0) [0|1] ""  GUI
 SG_ BOT_W_STATUS2_VREF_UV : 211|1@1+ (1,0) [0|1] ""  GUI
 SG_ BOT_W_STATUS2_VEE_OOR : 210|1@1+ (1,0) [0|1] ""  GUI
 SG_ BOT_W_STATUS1_VCCOV : 209|1@1+ (1,0) [0|1] ""  GUI
 SG_ BOT_W_STATUS1_VCCUV : 208|1@1+ (1,0) [0|1] ""  GUI
 SG_ BOT_W_STATUS1_POR_1 : 207|1@1+ (1,0) [0|1] ""  GUI
 SG_ BOT_W_STATUS1_OTSD_IC : 206|1@1+ (1,0) [0|1] ""  GUI
 SG_ BOT_W_STATUS1_OTSD : 205|1@1+ (1,0) [0|1] ""  GUI
 SG_ BOT_W_STATUS1_OTW : 204|1@1+ (1,0) [0|1] ""  GUI
 SG_ BOT_W_STATUS1_POR_2 : 203|1@1+ (1,0) [0|1] ""  GUI
 SG_ BOT_W_STATUS1_DESAT : 202|1@1+ (1,0) [0|1] ""  GUI
 SG_ BOT_W_STATUS1_SC : 201|1@1+ (1,0) [0|1] ""  GUI
 SG_ BOT_W_STATUS1_OC : 200|1@1+ (1,0) [0|1] ""  GUI
 SG_ BOT_V_STATCON4_CMP_OUT : 198|1@1+ (1,0) [0|1] ""  GUI
 SG_ BOT_V_STATCON4_GS_ERR : 197|1@1+ (1,0) [0|1] ""  GUI
 SG_ BOT_V_STATCON4_GS_H_WS_CNF : 196|1@1+ (1,0) [0|1] ""  GUI
 SG_ BOT_V_STATCON4_GS_H_US_CNF : 195|1@1+ (1,0) [0|1] ""  GUI
 SG_ BOT_V_STATCON4_GS_L_WS_CNF : 194|1@1+ (1,0) [0|1] ""  GUI
 SG_ BOT_V_STATCON4_GS_L_US_CNF : 193|1@1+ (1,0) [0|1] ""  GUI
 SG_ BOT_V_STATCON4_GS_H_WS_ST : 192|1@1+ (1,0) [0|1] ""  GUI
 SG_ BOT_V_STATCON4_GS_H_US_ST : 191|1@1+ (1,0) [0|1] ""  GUI
 SG_ BOT_V_STATCON4_GS_L_WS_ST : 190|1@1+ (1,0) [0|1] ""  GUI
 SG_ BOT_V_STATCON4_GS_L_US_ST : 189|1@1+ (1,0) [0|1] ""  GUI
 SG_ BOT_V_STATUS3_FSISO_ST : 188|1@1+ (1,0) [0|1] ""  GUI
 SG_ BOT_V_STATUS3_FSISO : 187|1@1+ (1,0) [0|1] ""  GUI
 SG_ BOT_V_STATUS3_PWM : 186|1@1+ (1,0) [0|1] ""  GUI
 SG_ BOT_V_STATUS3_PWMALT : 185|1@1+ (1,0) [0|1] ""  GUI
 SG_ BOT_V_STATUS3_FSSTATE : 184|1@1+ (1,0) [0|1] ""  GUI
 SG_ BOT_V_STATUS3_FSENB : 183|1@1+ (1,0) [0|1] ""  GUI
 SG_ BOT_V_STATUS3_INTB : 182|1@1+ (1,0) [0|1] ""  GUI
 SG_ BOT_V_STATUS3_INTA_RTRPT : 181|1@1+ (1,0) [0|1] ""  GUI
 SG_ BOT_V_STATUS3_VRTMON : 180|1@1+ (1,0) [0|1] ""  GUI
 SG_ BOT_V_STATUS2_BIST_FAIL : 179|1@1+ (1,0) [0|1] ""  GUI
 SG_ BOT_V_STATUS2_VDD_UVOV : 178|1@1+ (1,0) [0|1] ""  GUI
 SG_ BOT_V_STATUS2_DTFLT : 177|1@1+ (1,0) [0|1] ""  GUI
 SG_ BOT_V_STATUS2_SPIERR : 176|1@1+ (1,0) [0|1] ""  GUI
 SG_ BOT_V_STATUS2_CONFCRCERR : 175|1@1+ (1,0) [0|1] ""  GUI
 SG_ BOT_V_STATUS2_RTMON_FLT : 174|1@1+ (1,0) [0|1] ""  GUI
 SG_ BOT_V_STATUS2_WDOG_FLT : 173|1@1+ (1,0) [0|1] ""  GUI
 SG_ BOT_V_STATUS2_COMERR : 172|1@1+ (1,0) [0|1] ""  GUI
 SG_ BOT_V_STATUS2_VREF_UV : 171|1@1+ (1,0) [0|1] ""  GUI
 SG_ BOT_V_STATUS2_VEE_OOR : 170|1@1+ (1,0) [0|1] ""  GUI
 SG_ BOT_V_STATUS1_VCCOV : 169|1@1+ (1,0) [0|1] ""  GUI
 SG_ BOT_V_STATUS1_VCCUV : 168|1@1+ (1,0) [0|1] ""  GUI
 SG_ BOT_V_STATUS1_POR_1 : 167|1@1+ (1,0) [0|1] ""  GUI
 SG_ BOT_V_STATUS1_OTSD_IC : 166|1@1+ (1,0) [0|1] ""  GUI
 SG_ BOT_V_STATUS1_OTSD : 165|1@1+ (1,0) [0|1] ""  GUI
 SG_ BOT_V_STATUS1_OTW : 164|1@1+ (1,0) [0|1] ""  GUI
 SG_ BOT_V_STATUS1_POR_2 : 163|1@1+ (1,0) [0|1] ""  GUI
 SG_ BOT_V_STATUS1_DESAT : 162|1@1+ (1,0) [0|1] ""  GUI
 SG_ BOT_V_STATUS1_SC : 161|1@1+ (1,0) [0|1] ""  GUI
 SG_ BOT_V_STATUS1_OC : 160|1@1+ (1,0) [0|1] ""  GUI
 SG_ BOT_U_STATCON4_CMP_OUT : 158|1@1+ (1,0) [0|1] ""  GUI
 SG_ BOT_U_STATCON4_GS_ERR : 157|1@1+ (1,0) [0|1] ""  GUI
 SG_ BOT_U_STATCON4_GS_H_WS_CNF : 156|1@1+ (1,0) [0|1] ""  GUI
 SG_ BOT_U_STATCON4_GS_H_US_CNF : 155|1@1+ (1,0) [0|1] ""  GUI
 SG_ BOT_U_STATCON4_GS_L_WS_CNF : 154|1@1+ (1,0) [0|1] ""  GUI
 SG_ BOT_U_STATCON4_GS_L_US_CNF : 153|1@1+ (1,0) [0|1] ""  GUI
 SG_ BOT_U_STATCON4_GS_H_WS_ST : 152|1@1+ (1,0) [0|1] ""  GUI
 SG_ BOT_U_STATCON4_GS_H_US_ST : 151|1@1+ (1,0) [0|1] ""  GUI
 SG_ BOT_U_STATCON4_GS_L_WS_ST : 150|1@1+ (1,0) [0|1] ""  GUI
 SG_ BOT_U_STATCON4_GS_L_US_ST : 149|1@1+ (1,0) [0|1] ""  GUI
 SG_ BOT_U_STATUS3_FSISO_ST : 148|1@1+ (1,0) [0|1] ""  GUI
 SG_ BOT_U_STATUS3_FSISO : 147|1@1+ (1,0) [0|1] ""  GUI
 SG_ BOT_U_STATUS3_PWM : 146|1@1+ (1,0) [0|1] ""  GUI
 SG_ BOT_U_STATUS3_PWMALT : 145|1@1+ (1,0) [0|1] ""  GUI
 SG_ BOT_U_STATUS3_FSSTATE : 144|1@1+ (1,0) [0|1] ""  GUI
 SG_ BOT_U_STATUS3_FSENB : 143|1@1+ (1,0) [0|1] ""  GUI
 SG_ BOT_U_STATUS3_INTB : 142|1@1+ (1,0) [0|1] ""  GUI
 SG_ BOT_U_STATUS3_INTA_RTRPT : 141|1@1+ (1,0) [0|1] ""  GUI
 SG_ BOT_U_STATUS3_VRTMON : 140|1@1+ (1,0) [0|1] ""  GUI
 SG_ BOT_U_STATUS2_BIST_FAIL : 139|1@1+ (1,0) [0|1] ""  GUI
 SG_ BOT_U_STATUS2_VDD_UVOV : 138|1@1+ (1,0) [0|1] ""  GUI
 SG_ BOT_U_STATUS2_DTFLT : 137|1@1+ (1,0) [0|1] ""  GUI
 SG_ BOT_U_STATUS2_SPIERR : 136|1@1+ (1,0) [0|1] ""  GUI
 SG_ BOT_U_STATUS2_CONFCRCERR : 135|1@1+ (1,0) [0|1] ""  GUI
 SG_ BOT_U_STATUS2_RTMON_FLT : 134|1@1+ (1,0) [0|1] ""  GUI
 SG_ BOT_U_STATUS2_WDOG_FLT : 133|1@1+ (1,0) [0|1] ""  GUI
 SG_ BOT_U_STATUS2_COMERR : 132|1@1+ (1,0) [0|1] ""  GUI
 SG_ BOT_U_STATUS2_VREF_UV : 131|1@1+ (1,0) [0|1] ""  GUI
 SG_ BOT_U_STATUS2_VEE_OOR : 130|1@1+ (1,0) [0|1] ""  GUI
 SG_ BOT_U_STATUS1_VCCOV : 129|1@1+ (1,0) [0|1] ""  GUI
 SG_ BOT_U_STATUS1_VCCUV : 128|1@1+ (1,0) [0|1] ""  GUI
 SG_ BOT_U_STATUS1_POR_1 : 127|1@1+ (1,0) [0|1] ""  GUI
 SG_ BOT_U_STATUS1_OTSD_IC : 126|1@1+ (1,0) [0|1] ""  GUI
 SG_ BOT_U_STATUS1_OTSD : 125|1@1+ (1,0) [0|1] ""  GUI
 SG_ BOT_U_STATUS1_OTW : 124|1@1+ (1,0) [0|1] ""  GUI
 SG_ BOT_U_STATUS1_POR_2 : 123|1@1+ (1,0) [0|1] ""  GUI
 SG_ BOT_U_STATUS1_DESAT : 122|1@1+ (1,0) [0|1] ""  GUI
 SG_ BOT_U_STATUS1_SC : 121|1@1+ (1,0) [0|1] ""  GUI
 SG_ BOT_U_STATUS1_OC : 120|1@1+ (1,0) [0|1] ""  GUI
 SG_ TOP_W_STATCON4_CMP_OUT : 118|1@1+ (1,0) [0|1] ""  GUI
 SG_ TOP_W_STATCON4_GS_ERR : 117|1@1+ (1,0) [0|1] ""  GUI
 SG_ TOP_W_STATCON4_GS_H_WS_CNF : 116|1@1+ (1,0) [0|1] ""  GUI
 SG_ TOP_W_STATCON4_GS_H_US_CNF : 115|1@1+ (1,0) [0|1] ""  GUI
 SG_ TOP_W_STATCON4_GS_L_WS_CNF : 114|1@1+ (1,0) [0|1] ""  GUI
 SG_ TOP_W_STATCON4_GS_L_US_CNF : 113|1@1+ (1,0) [0|1] ""  GUI
 SG_ TOP_W_STATCON4_GS_H_WS_ST : 112|1@1+ (1,0) [0|1] ""  GUI
 SG_ TOP_W_STATCON4_GS_H_US_ST : 111|1@1+ (1,0) [0|1] ""  GUI
 SG_ TOP_W_STATCON4_GS_L_WS_ST : 110|1@1+ (1,0) [0|1] ""  GUI
 SG_ TOP_W_STATCON4_GS_L_US_ST : 109|1@1+ (1,0) [0|1] ""  GUI
 SG_ TOP_W_STATUS3_FSISO_ST : 108|1@1+ (1,0) [0|1] ""  GUI
 SG_ TOP_W_STATUS3_FSISO : 107|1@1+ (1,0) [0|1] ""  GUI
 SG_ TOP_W_STATUS3_PWM : 106|1@1+ (1,0) [0|1] ""  GUI
 SG_ TOP_W_STATUS3_PWMALT : 105|1@1+ (1,0) [0|1] ""  GUI
 SG_ TOP_W_STATUS3_FSSTATE : 104|1@1+ (1,0) [0|1] ""  GUI
 SG_ TOP_W_STATUS3_FSENB : 103|1@1+ (1,0) [0|1] ""  GUI
 SG_ TOP_W_STATUS3_INTB : 102|1@1+ (1,0) [0|1] ""  GUI
 SG_ TOP_W_STATUS3_INTA_RTRPT : 101|1@1+ (1,0) [0|1] ""  GUI
 SG_ TOP_W_STATUS3_VRTMON : 100|1@1+ (1,0) [0|1] ""  GUI
 SG_ TOP_W_STATUS2_BIST_FAIL : 99|1@1+ (1,0) [0|1] ""  GUI
 SG_ TOP_W_STATUS2_VDD_UVOV : 98|1@1+ (1,0) [0|1] ""  GUI
 SG_ TOP_W_STATUS2_DTFLT : 97|1@1+ (1,0) [0|1] ""  GUI
 SG_ TOP_W_STATUS2_SPIERR : 96|1@1+ (1,0) [0|1] ""  GUI
 SG_ TOP_W_STATUS2_CONFCRCERR : 95|1@1+ (1,0) [0|1] ""  GUI
 SG_ TOP_W_STATUS2_RTMON_FLT : 94|1@1+ (1,0) [0|1] ""  GUI
 SG_ TOP_W_STATUS2_WDOG_FLT : 93|1@1+ (1,0) [0|1] ""  GUI
 SG_ TOP_W_STATUS2_COMERR : 92|1@1+ (1,0) [0|1] ""  GUI
 SG_ TOP_W_STATUS2_VREF_UV : 91|1@1+ (1,0) [0|1] ""  GUI
 SG_ TOP_W_STATUS2_VEE_OOR : 90|1@1+ (1,0) [0|1] ""  GUI
 SG_ TOP_W_STATUS1_VCCOV : 89|1@1+ (1,0) [0|1] ""  GUI
 SG_ TOP_W_STATUS1_VCCUV : 88|1@1+ (1,0) [0|1] ""  GUI
 SG_ TOP_W_STATUS1_POR_1 : 87|1@1+ (1,0) [0|1] ""  GUI
 SG_ TOP_W_STATUS1_OTSD_IC : 86|1@1+ (1,0) [0|1] ""  GUI
 SG_ TOP_W_STATUS1_OTSD : 85|1@1+ (1,0) [0|1] ""  GUI
 SG_ TOP_W_STATUS1_OTW : 84|1@1+ (1,0) [0|1] ""  GUI
 SG_ TOP_W_STATUS1_POR_2 : 83|1@1+ (1,0) [0|1] ""  GUI
 SG_ TOP_W_STATUS1_DESAT : 82|1@1+ (1,0) [0|1] ""  GUI
 SG_ TOP_W_STATUS1_SC : 81|1@1+ (1,0) [0|1] ""  GUI
 SG_ TOP_W_STATUS1_OC : 80|1@1+ (1,0) [0|1] ""  GUI
 SG_ TOP_V_STATCON4_GS_L_WS_ST : 70|1@1+ (1,0) [0|1] ""  GUI
 SG_ TOP_V_STATCON4_GS_L_WS_CNF : 74|1@1+ (1,0) [0|1] ""  GUI
 SG_ TOP_V_STATCON4_GS_L_US_ST : 69|1@1+ (1,0) [0|1] ""  GUI
 SG_ TOP_V_STATCON4_GS_L_US_CNF : 73|1@1+ (1,0) [0|1] ""  GUI
 SG_ TOP_V_STATCON4_GS_H_WS_ST : 72|1@1+ (1,0) [0|1] ""  GUI
 SG_ TOP_V_STATCON4_GS_H_WS_CNF : 76|1@1+ (1,0) [0|1] ""  GUI
 SG_ TOP_V_STATCON4_GS_H_US_ST : 71|1@1+ (1,0) [0|1] ""  GUI
 SG_ TOP_V_STATCON4_GS_H_US_CNF : 75|1@1+ (1,0) [0|1] ""  GUI
 SG_ TOP_V_STATCON4_GS_ERR : 77|1@1+ (1,0) [0|1] ""  GUI
 SG_ TOP_V_STATCON4_CMP_OUT : 78|1@1+ (1,0) [0|1] ""  GUI
 SG_ TOP_V_STATUS3_VRTMON : 60|1@1+ (1,0) [0|1] ""  GUI
 SG_ TOP_V_STATUS3_PWM : 66|1@1+ (1,0) [0|1] ""  GUI
 SG_ TOP_V_STATUS3_PWMALT : 65|1@1+ (1,0) [0|1] ""  GUI
 SG_ TOP_V_STATUS3_INTB : 62|1@1+ (1,0) [0|1] ""  GUI
 SG_ TOP_V_STATUS3_INTA_RTRPT : 61|1@1+ (1,0) [0|1] ""  GUI
 SG_ TOP_V_STATUS3_FSSTATE : 64|1@1+ (1,0) [0|1] ""  GUI
 SG_ TOP_V_STATUS3_FSISO_ST : 68|1@1+ (1,0) [0|1] ""  GUI
 SG_ TOP_V_STATUS3_FSISO : 67|1@1+ (1,0) [0|1] ""  GUI
 SG_ TOP_V_STATUS3_FSENB : 63|1@1+ (1,0) [0|1] ""  GUI
 SG_ TOP_V_STATUS2_WDOG_FLT : 53|1@1+ (1,0) [0|1] ""  GUI
 SG_ TOP_V_STATUS2_VREF_UV : 51|1@1+ (1,0) [0|1] ""  GUI
 SG_ TOP_V_STATUS2_VEE_OOR : 50|1@1+ (1,0) [0|1] ""  GUI
 SG_ TOP_V_STATUS2_VDD_UVOV : 58|1@1+ (1,0) [0|1] ""  GUI
 SG_ TOP_V_STATUS2_SPIERR : 56|1@1+ (1,0) [0|1] ""  GUI
 SG_ TOP_V_STATUS2_RTMON_FLT : 54|1@1+ (1,0) [0|1] ""  GUI
 SG_ TOP_V_STATUS2_DTFLT : 57|1@1+ (1,0) [0|1] ""  GUI
 SG_ TOP_V_STATUS2_CONFCRCERR : 55|1@1+ (1,0) [0|1] ""  GUI
 SG_ TOP_V_STATUS2_COMERR : 52|1@1+ (1,0) [0|1] ""  GUI
 SG_ TOP_V_STATUS2_BIST_FAIL : 59|1@1+ (1,0) [0|1] ""  GUI
 SG_ TOP_V_STATUS1_VCCUV : 48|1@1+ (1,0) [0|1] ""  GUI
 SG_ TOP_V_STATUS1_VCCOV : 49|1@1+ (1,0) [0|1] ""  GUI
 SG_ TOP_V_STATUS1_SC : 41|1@1+ (1,0) [0|1] ""  GUI
 SG_ TOP_V_STATUS1_POR_2 : 43|1@1+ (1,0) [0|1] ""  GUI
 SG_ TOP_V_STATUS1_POR_1 : 47|1@1+ (1,0) [0|1] ""  GUI
 SG_ TOP_V_STATUS1_OTW : 44|1@1+ (1,0) [0|1] ""  GUI
 SG_ TOP_V_STATUS1_OTSD_IC : 46|1@1+ (1,0) [0|1] ""  GUI
 SG_ TOP_V_STATUS1_OTSD : 45|1@1+ (1,0) [0|1] ""  GUI
 SG_ TOP_V_STATUS1_DESAT : 42|1@1+ (1,0) [0|1] ""  GUI
 SG_ TOP_V_STATUS1_OC : 40|1@1+ (1,0) [0|1] ""  GUI
 SG_ TOP_U_STATCON4_CMP_OUT : 38|1@1+ (1,0) [0|1] ""  GUI
 SG_ TOP_U_STATCON4_GS_ERR : 37|1@1+ (1,0) [0|1] ""  GUI
 SG_ TOP_U_STATCON4_GS_H_WS_CNF : 36|1@1+ (1,0) [0|1] ""  GUI
 SG_ TOP_U_STATCON4_GS_H_US_CNF : 35|1@1+ (1,0) [0|1] ""  GUI
 SG_ TOP_U_STATCON4_GS_L_WS_CNF : 34|1@1+ (1,0) [0|1] ""  GUI
 SG_ TOP_U_STATCON4_GS_L_US_CNF : 33|1@1+ (1,0) [0|1] ""  GUI
 SG_ TOP_U_STATCON4_GS_H_WS_ST : 32|1@1+ (1,0) [0|1] ""  GUI
 SG_ TOP_U_STATCON4_GS_H_US_ST : 31|1@1+ (1,0) [0|1] ""  GUI
 SG_ TOP_U_STATCON4_GS_L_WS_ST : 30|1@1+ (1,0) [0|1] ""  GUI
 SG_ TOP_U_STATCON4_GS_L_US_ST : 29|1@1+ (1,0) [0|1] ""  GUI
 SG_ TOP_U_STATUS3_FSISO_ST : 28|1@1+ (1,0) [0|1] ""  GUI
 SG_ TOP_U_STATUS3_FSISO : 27|1@1+ (1,0) [0|1] ""  GUI
 SG_ TOP_U_STATUS3_PWM : 26|1@1+ (1,0) [0|1] ""  GUI
 SG_ TOP_U_STATUS3_PWMALT : 25|1@1+ (1,0) [0|1] ""  GUI
 SG_ TOP_U_STATUS3_FSSTATE : 24|1@1+ (1,0) [0|1] ""  GUI
 SG_ TOP_U_STATUS3_FSENB : 23|1@1+ (1,0) [0|1] ""  GUI
 SG_ TOP_U_STATUS3_INTB : 22|1@1+ (1,0) [0|1] ""  GUI
 SG_ TOP_U_STATUS3_INTA_RTRPT : 21|1@1+ (1,0) [0|1] ""  GUI
 SG_ TOP_U_STATUS3_VRTMON : 20|1@1+ (1,0) [0|1] ""  GUI
 SG_ TOP_U_STATUS2_BIST_FAIL : 19|1@1+ (1,0) [0|1] ""  GUI
 SG_ TOP_U_STATUS2_VDD_UVOV : 18|1@1+ (1,0) [0|1] ""  GUI
 SG_ TOP_U_STATUS2_DTFLT : 17|1@1+ (1,0) [0|1] ""  GUI
 SG_ TOP_U_STATUS2_SPIERR : 16|1@1+ (1,0) [0|1] ""  GUI
 SG_ TOP_U_STATUS2_CONFCRCERR : 15|1@1+ (1,0) [0|1] ""  GUI
 SG_ TOP_U_STATUS2_RTMON_FLT : 14|1@1+ (1,0) [0|1] ""  GUI
 SG_ TOP_U_STATUS2_WDOG_FLT : 13|1@1+ (1,0) [0|1] ""  GUI
 SG_ TOP_U_STATUS2_COMERR : 12|1@1+ (1,0) [0|1] ""  GUI
 SG_ TOP_U_STATUS2_VREF_UV : 11|1@1+ (1,0) [0|1] ""  GUI
 SG_ TOP_U_STATUS2_VEE_OOR : 10|1@1+ (1,0) [0|1] ""  GUI
 SG_ TOP_U_STATUS1_VCCOV : 9|1@1+ (1,0) [0|1] ""  GUI
 SG_ TOP_U_STATUS1_VCCUV : 8|1@1+ (1,0) [0|1] ""  GUI
 SG_ TOP_U_STATUS1_POR_1 : 7|1@1+ (1,0) [0|1] ""  GUI
 SG_ TOP_U_STATUS1_OTSD_IC : 6|1@1+ (1,0) [0|1] ""  GUI
 SG_ TOP_U_STATUS1_OTSD : 5|1@1+ (1,0) [0|1] ""  GUI
 SG_ TOP_U_STATUS1_OTW : 4|1@1+ (1,0) [0|1] ""  GUI
 SG_ TOP_U_STATUS1_POR_2 : 3|1@1+ (1,0) [0|1] ""  GUI
 SG_ TOP_U_STATUS1_DESAT : 2|1@1+ (1,0) [0|1] ""  GUI
 SG_ TOP_U_STATUS1_SC : 1|1@1+ (1,0) [0|1] ""  GUI
 SG_ TOP_U_STATUS1_OC : 0|1@1+ (1,0) [0|1] ""  GUI

BO_ 1554 MCU_TX_0x612_DEVCANFD: 64 MCU
 SG_ PWM_U_BOT_FB_BU_Freq : 392|16@1+ (1,0) [0|65535] "Hz"  GUI
 SG_ PWM_U_BOT_FB_BU_Duty : 376|16@1+ (0.01,0) [0|100] "%"  GUI
 SG_ PWM_V_BOT_FB_BU_Freq : 360|16@1+ (1,0) [0|65535] "Hz"  GUI
 SG_ PWM_V_BOT_FB_BU_Duty : 344|16@1+ (0.01,0) [0|100] "%"  GUI
 SG_ PWM_W_BOT_FB_BU_Freq : 328|16@1+ (1,0) [0|65535] "Hz"  GUI
 SG_ PWM_W_BOT_FB_BU_Duty : 312|16@1+ (0.01,0) [0|100] "%"  GUI
 SG_ PWM_U_TOP_FB_BU_Freq : 296|16@1+ (1,0) [0|65535] "Hz"  GUI
 SG_ PWM_U_TOP_FB_BU_Duty : 280|16@1+ (0.01,0) [0|100] "%"  GUI
 SG_ PWM_V_TOP_FB_BU_Freq : 264|16@1+ (1,0) [0|65535] "Hz"  GUI
 SG_ PWM_V_TOP_FB_BU_Duty : 248|16@1+ (0.01,0) [0|100] "%"  GUI
 SG_ PWM_W_TOP_FB_BU_Freq : 232|16@1+ (1,0) [0|65535] "Hz"  GUI
 SG_ PWM_W_TOP_FB_BU_Duty : 216|16@1+ (0.01,0) [0|100] "%"  GUI
 SG_ HVIL_5_PI_Freq : 200|16@1+ (1,0) [0|65535] "Hz"  GUI
 SG_ HVIL_5_PI_Duty : 184|16@1+ (0.01,0) [0|100] "%"  GUI
 SG_ HVIL_4_PI_Freq : 168|16@1+ (1,0) [0|65535] "Hz"  GUI
 SG_ HVIL_4_PI_Duty : 152|16@1+ (0.01,0) [0|100] "%"  GUI
 SG_ HVIL_3_PI_Freq : 136|16@1+ (1,0) [0|65535] "Hz"  GUI
 SG_ HVIL_3_PI_Duty : 120|16@1+ (0.01,0) [0|100] "%"  GUI
 SG_ HVIL_2_PI_Freq : 104|16@1+ (1,0) [0|65535] "Hz"  GUI
 SG_ HVIL_2_PI_Duty : 88|16@1+ (0.01,0) [0|100] "%"  GUI
 SG_ HVIL_1_PI_Freq : 72|16@1+ (1,0) [0|65535] "Hz"  GUI
 SG_ HVIL_1_PI_Duty : 56|16@1+ (0.01,0) [0|100] "%"  GUI
 SG_ LOW_ACT_DISCHARGE_State : 52|1@1+ (1,0) [0|1] ""  GUI
 SG_ KP_ALIVE_MP_State : 51|1@1+ (1,0) [0|1] ""  GUI
 SG_ LOW_MTR_SPEED_STAT_State : 50|1@1+ (1,0) [0|1] ""  GUI
 SG_ LOW_3PS_MAIN_MICRO_State : 49|1@1+ (1,0) [0|1] ""  GUI
 SG_ MTR_TEMP_SEL_State : 48|1@1+ (1,0) [0|1] ""  GUI
 SG_ INST_TRIGGER_MAIN_MICRO_State : 47|1@1+ (1,0) [0|1] ""  GUI
 SG_ LOW_HVOV_PHOC_LATCH_CLR_State : 46|1@1+ (1,0) [0|1] ""  GUI
 SG_ OIL_PMP_RLY_CTRL_State : 45|1@1+ (1,0) [0|1] ""  GUI
 SG_ SBC_WD_TRIG_State : 44|1@1+ (1,0) [0|1] ""  GUI
 SG_ eLOCKER_EN_State : 43|1@1+ (1,0) [0|1] ""  GUI
 SG_ HVIL_RTN_SW_State : 42|1@1+ (1,0) [0|1] ""  GUI
 SG_ PWM_EN_State : 41|1@1+ (1,0) [0|1] ""  GUI
 SG_ LOW_RST_PPAWL_MTR_OC_FLT_State : 40|1@1+ (1,0) [0|1] ""  GUI
 SG_ PPAWL_MTR_EN_State : 39|1@1+ (1,0) [0|1] ""  GUI
 SG_ PPAWL_MTR_CTRL2_State : 38|1@1+ (1,0) [0|1] ""  GUI
 SG_ GS_ENL_U_State : 37|1@1+ (1,0) [0|1] ""  GUI
 SG_ GS_ENL_V_State : 36|1@1+ (1,0) [0|1] ""  GUI
 SG_ GS_ENL_W_State : 35|1@1+ (1,0) [0|1] ""  GUI
 SG_ GS_ENH_U_State : 34|1@1+ (1,0) [0|1] ""  GUI
 SG_ GS_ENH_V_State : 33|1@1+ (1,0) [0|1] ""  GUI
 SG_ GS_ENH_W_State : 32|1@1+ (1,0) [0|1] ""  GUI
 SG_ eLOCKER_LS_VSENSE : 25|1@1+ (1,0) [0|1] ""  GUI
 SG_ LOW_FSENB_FB : 24|1@1+ (1,0) [0|1] ""  GUI
 SG_ FSSTATE_BOT_FB : 23|1@1+ (1,0) [0|1] ""  GUI
 SG_ FSSTATE_TOP_FB : 22|1@1+ (1,0) [0|1] ""  GUI
 SG_ IGN_FB : 21|1@1+ (1,0) [0|1] ""  GUI
 SG_ ETK_WAKEUP : 20|1@1+ (1,0) [0|1] ""  GUI
 SG_ LOW_OUT_EN : 19|1@1+ (1,0) [0|1] ""  GUI
 SG_ LOW_BOOT_EN_SW : 18|1@1+ (1,0) [0|1] ""  GUI
 SG_ LOW_E_STOP_MAIN_MICRO : 17|1@1+ (1,0) [0|1] ""  GUI
 SG_ FORCE_UPPERS_ON_FB : 16|1@1+ (1,0) [0|1] ""  GUI
 SG_ FORCE_LOWERS_ON_FB : 15|1@1+ (1,0) [0|1] ""  GUI
 SG_ LOW_RES_AMPLIFIER_FLT : 14|1@1+ (1,0) [0|1] ""  GUI
 SG_ OIL_PMP_RLY_FB : 13|1@1+ (1,0) [0|1] ""  GUI
 SG_ LOW_PWM_BUFFER_FB : 12|1@1+ (1,0) [0|1] ""  GUI
 SG_ LOW_PPAWL_FLT : 11|1@1+ (1,0) [0|1] ""  GUI
 SG_ LOW_PPAWL_MTR_OC_LATCH : 10|1@1+ (1,0) [0|1] ""  GUI
 SG_ CRASH_IN_MAIN_MICRO : 9|1@1+ (1,0) [0|1] ""  GUI
 SG_ LOW_DSAT_TOP_FLT_FB : 8|1@1+ (1,0) [0|1] ""  GUI
 SG_ LOW_UVLO_TOP_FLT_FB : 7|1@1+ (1,0) [0|1] ""  GUI
 SG_ LOW_DSAT_BOT_FLT_FB : 6|1@1+ (1,0) [0|1] ""  GUI
 SG_ LOW_UVLO_BOT_FLT_FB : 5|1@1+ (1,0) [0|1] ""  GUI
 SG_ LOW_PHASE_UVW_OC_FLT_FB : 4|1@1+ (1,0) [0|1] ""  GUI
 SG_ LOW_HVDC_OV_FLT_FB : 3|1@1+ (1,0) [0|1] ""  GUI
 SG_ LOW_OC_W_FLT : 2|1@1+ (1,0) [0|1] ""  GUI
 SG_ LOW_OC_V_FLT : 1|1@1+ (1,0) [0|1] ""  GUI
 SG_ LOW_OC_U_FLT : 0|1@1+ (1,0) [0|1] ""  GUI

BO_ 1283 MCU_RX_0x503_DEVCANFD: 32 GUI
 SG_ TLF35584_ERR_Disable : 175|1@1+ (1,0) [0|1] "" Vector__XXX
 SG_ CAN_INH_Update : 174|1@1+ (1,0) [0|1] "" Vector__XXX
 SG_ UVW_PWM_Dead_Time : 4|4@1+ (1,0) [0|15] "us" Vector__XXX
 SG_ TLF35584_Tran_State : 12|4@1+ (1,0) [0|15] ""  MCU
 SG_ TLF35584_State_Update : 11|1@1+ (1,0) [0|1] ""  MCU
 SG_ PPAWL_Frame_Time : 237|16@1+ (1,0) [0|65535] "ms"  MCU
 SG_ eLOCKER_Time : 221|16@1+ (1,0) [0|65535] "ms"  MCU
 SG_ eLOCKER_PWM_Freq : 205|16@1+ (1,0) [0|65535] "Hz"  MCU
 SG_ eLOCKER_PWM_Duty : 189|16@1+ (0.01,0) [0|100] "%"  MCU
 SG_ eLOCKER_PWM_Seq_Start : 188|1@1+ (1,0) [0|1] ""  MCU
 SG_ eLOCKER_PWM_Stop : 187|1@1+ (1,0) [0|1] ""  MCU
 SG_ eLOCKER_PWM_Update : 186|1@1+ (1,0) [0|1] ""  MCU
 SG_ PPAWL_Current_Limit_Update : 185|1@1+ (1,0) [0|1] ""  MCU
 SG_ PPAWL_PWM_Update : 184|1@1+ (1,0) [0|1] ""  MCU
 SG_ PPAWL_Current_Limit : 176|8@1+ (0.1,0) [0|255] ""  MCU
 SG_ FD16_INH_DISABLE : 173|1@1+ (1,0) [0|1] ""  MCU
 SG_ FD5_INH_DISABLE : 172|1@1+ (1,0) [0|1] ""  MCU
 SG_ DIS_SBC_WWD_TRIG : 171|1@1+ (1,0) [0|1] ""  MCU
 SG_ SEND_BAD_ANSWER : 170|1@1+ (1,0) [0|1] ""  MCU
 SG_ UVWPWM_Duty_Freq_Update : 169|1@1+ (1,0) [0|1] ""  MCU
 SG_ PWM_Duty_Freq_Update : 168|1@1+ (1,0) [0|1] ""  MCU
 SG_ PWM_W_Duty : 152|16@1+ (0.01,0) [0|100] "Hz"  MCU
 SG_ PWM_V_Duty : 136|16@1+ (0.01,0) [0|100] "Hz"  MCU
 SG_ PWM_U_Duty : 120|16@1+ (0.01,0) [0|100] "Hz"  MCU
 SG_ UVW_PWM_Freq : 104|16@1+ (1,0) [0|65535] "Hz"  MCU
 SG_ HVIL_PWM_SEND_Freq : 88|16@1+ (1,0) [0|0] "Hz"  MCU
 SG_ HVIL_PWM_SEND_Duty : 72|16@1+ (0.01,0) [0|100] "%"  MCU
 SG_ PPAWL_MTR_CTRL1_Freq : 56|16@1+ (1,0) [0|65535] "Hz"  MCU
 SG_ PPAWL_MTR_CTRL1_Duty : 40|16@1+ (0.01,0) [0|100] "%"  MCU
 SG_ PinOut_Update : 10|1@1+ (1,0) [0|1] ""  MCU
 SG_ UVW_PWM_Polarity : 9|1@1+ (1,0) [0|1] ""  MCU
 SG_ Reset_Motor_Faults : 8|1@1+ (1,0) [0|1] ""  MCU
 SG_ LOW_ACT_DISCHARGE : 36|1@1+ (1,0) [0|1] ""  MCU
 SG_ KP_ALIVE_MP : 35|1@1+ (1,0) [0|1] ""  MCU
 SG_ LOW_MTR_SPEED_STAT : 26|1@1+ (1,0) [0|1] ""  MCU
 SG_ LOW_3PS_MAIN_MICRO : 33|1@1+ (1,0) [0|1] ""  MCU
 SG_ MTR_TEMP_SEL : 32|1@1+ (1,0) [0|1] ""  MCU
 SG_ INST_TRIGGER_MAIN_MICRO : 31|1@1+ (1,0) [0|1] ""  MCU
 SG_ LOW_HVOV_PHOC_LATCH_CLR : 30|1@1+ (1,0) [0|1] ""  MCU
 SG_ OIL_PMP_RLY_CTRL : 29|1@1+ (1,0) [0|1] ""  MCU
 SG_ SBC_WD_TRIG : 28|1@1+ (1,0) [0|1] ""  MCU
 SG_ eLOCKER_EN : 27|1@1+ (1,0) [0|1] ""  MCU
 SG_ HVIL_RTN_SW : 34|1@1+ (1,0) [0|1] ""  MCU
 SG_ PWM_EN : 25|1@1+ (1,0) [0|1] ""  MCU
 SG_ LOW_RST_PPAWL_MTR_OC_FLT : 24|1@1- (1,0) [0|1] ""  MCU
 SG_ PPAWL_MTR_EN : 23|1@1+ (1,0) [0|1] ""  MCU
 SG_ PPAWL_MTR_CTRL2 : 22|1@1- (1,0) [0|1] ""  MCU
 SG_ GS_ENL_U : 21|1@1+ (1,0) [0|1] ""  MCU
 SG_ GS_ENL_V : 20|1@1+ (1,0) [0|1] ""  MCU
 SG_ GS_ENL_W : 19|1@1+ (1,0) [0|1] ""  MCU
 SG_ GS_ENH_U : 18|1@1- (1,0) [0|1] ""  MCU
 SG_ GS_ENH_V : 17|1@1+ (1,0) [0|1] ""  MCU
 SG_ GS_ENH_W : 16|1@1+ (1,0) [0|1] ""  MCU
 SG_ LOW_NXP_ACT_DISCH : 3|1@1+ (1,0) [0|1] ""  MCU
 SG_ LOW_F_RESET_NXP : 2|1@1+ (1,0) [0|0] ""  MCU
 SG_ SPD_HW_3PS_I_O : 1|1@1+ (1,0) [0|1] ""  MCU
 SG_ INST_TRIGGER : 0|1@1+ (1,0) [0|1] ""  MCU

BO_ 1553 MCU_TX_0x611_DEVCANFD: 64 MCU
 SG_ E_STOP_MAIN_MICRO_Dir : 241|1@1+ (1,0) [0|1] ""  GUI
 SG_ DSAT_BOT_FLT_FB_Dir : 240|1@1+ (1,0) [0|1] ""  GUI
 SG_ DSAT_TOP_FLT_FB_Dir : 239|1@1+ (1,0) [0|1] ""  GUI
 SG_ UVLO_BOT_FLT_FB_Dir : 238|1@1+ (1,0) [0|1] ""  GUI
 SG_ UVLO_TOP_FLT_FB_Dir : 237|1@1+ (1,0) [0|1] ""  GUI
 SG_ HVDC_OV_FLT_FB_Dir : 236|1@1+ (1,0) [0|1] ""  GUI
 SG_ PHASE_UVW_OC_FLT_Dir : 235|1@1+ (1,0) [0|1] ""  GUI
 SG_ OC_W_FLT_Dir : 234|1@1+ (1,0) [0|1] ""  GUI
 SG_ OC_V_FLT_Dir : 233|1@1+ (1,0) [0|1] ""  GUI
 SG_ OC_U_FLT_Dir : 232|1@1+ (1,0) [0|1] ""  GUI
 SG_ Safing_Logic_Test_Frame_PHASE_UVW_OC_FLT : 231|1@1+ (1,0) [0|1] ""  GUI
 SG_ Safing_Logic_Test_Frame_OUT_EN : 230|1@1+ (1,0) [0|1] ""  GUI
 SG_ Safing_Logic_Test_Frame_FSENB : 229|1@1+ (1,0) [0|1] ""  GUI
 SG_ Safing_Logic_Test_Frame_FSSTATE_TOP : 228|1@1+ (1,0) [0|1] ""  GUI
 SG_ Safing_Logic_Test_Frame_FSSTATE_BOT : 227|1@1+ (1,0) [0|1] ""  GUI
 SG_ Safing_Logic_Test_Frame_PWM_BUFFER : 226|1@1+ (1,0) [0|1] ""  GUI
 SG_ Safing_Logic_Test_Frame_FORCE_LOWERS_ON : 225|1@1+ (1,0) [0|1] ""  GUI
 SG_ Safing_Logic_Test_Frame_FORCE_UPPERS_ON : 224|1@1+ (1,0) [0|1] ""  GUI
 SG_ Safing_Logic_Test_Frame_Row : 216|8@1+ (1,0) [0|255] ""  GUI
 SG_ Safing_Logic_Test_Frame_Index : 208|8@1+ (1,0) [0|255] ""  GUI
 SG_ Safing_Logic_Test_Frame_Header : 200|8@1+ (1,0) [0|255] ""  GUI
 SG_ Safing_Logic_Test_Error_info : 192|8@1+ (1,0) [0|255] ""  GUI
 SG_ Safing_Logic_Test_Error_RowCnt : 184|8@1+ (1,0) [0|255] ""  GUI
 SG_ Safing_Logic_Test_Current_Row : 176|8@1+ (1,0) [0|255] ""  GUI
 SG_ Safing_Logic_Test_Status : 168|8@1+ (1,0) [0|255] ""  GUI
 SG_ LIN_Receive_Data7 : 160|8@1+ (1,0) [0|255] "%"  GUI
 SG_ LIN_Receive_Data6 : 152|8@1+ (1,0) [0|255] "%"  GUI
 SG_ LIN_Receive_Data5 : 144|8@1+ (1,0) [0|255] "%"  GUI
 SG_ LIN_Receive_Data4 : 136|8@1+ (1,0) [0|255] "%"  GUI
 SG_ LIN_Receive_Data3 : 128|8@1+ (1,0) [0|255] "%"  GUI
 SG_ LIN_Receive_Data2 : 120|8@1+ (1,0) [0|255] "%"  GUI
 SG_ LIN_Receive_Data1 : 112|8@1+ (1,0) [0|255] "%"  GUI
 SG_ LIN_Receive_Data0 : 104|8@1+ (1,0) [0|255] "%"  GUI
 SG_ SPEED_FW_Duty : 88|16@1+ (0.01,0) [0|65535] "%"  GUI
 SG_ CRT_V_SPEED_Duty : 72|16@1+ (0.01,0) [0|65535] "%"  GUI
 SG_ LOW_NXP_ACT_DISCH_State : 67|1@1+ (1,0) [0|1] ""  GUI
 SG_ LOW_F_RESET_NXP_State : 66|1@1+ (1,0) [0|0] ""  GUI
 SG_ SPD_HW_3PS_I_O_State : 65|1@1+ (1,0) [0|1] ""  GUI
 SG_ INST_TRIGGER_State : 64|1@1+ (1,0) [0|1] ""  GUI
 SG_ SPEED_FW_Freq : 48|16@1+ (1,0) [0|65535] "Hz"  GUI
 SG_ CRT_V_SPEED_Freq : 32|16@1+ (1,0) [0|65535] "Hz"  GUI
 SG_ HVDC_SENSE1_NXP_AI : 18|12@1+ (1,0) [0|4095] ""  GUI
 SG_ VI_5V_SAFING_AI : 6|12@1+ (1,0) [0|4095] ""  GUI
 SG_ LOW_SAFESTATE2_NXP : 5|1@1+ (1,0) [0|1] ""  GUI
 SG_ LOW_SAFESTATE_NXP : 4|1@1+ (1,0) [0|1] ""  GUI
 SG_ CRASH_IN_NXP : 3|1@1+ (1,0) [0|1] ""  GUI
 SG_ LOW_HVDC_OV_FLT : 2|1@1+ (1,0) [0|1] ""  GUI
 SG_ RXD_CAN : 1|1@1+ (1,0) [0|1] ""  GUI
 SG_ LOW_SAFESTATE1_NXP : 0|1@1+ (1,0) [0|1] ""  GUI

BO_ 1552 MCU_TX_0x610_DEVCANFD: 64 MCU
 SG_ PPAWL_SPI_Current_Baudrate : 468|4@1+ (1,0) [0|15] ""  GUI
 SG_ CANFD_5_SPI_Current_Baudrate : 464|4@1+ (1,0) [0|15] ""  GUI
 SG_ CANFD_16_SPI_Current_Baudrate : 460|4@1+ (1,0) [0|15] ""  GUI
 SG_ FLASH_SPI_Current_Baudrate : 456|4@1+ (1,0) [0|15] ""  GUI
 SG_ SBC_SPI_Current_Baudrate : 452|4@1+ (1,0) [0|15] ""  GUI
 SG_ BOT_W_GDIC_SPI_Current_Baudrate : 448|4@1+ (1,0) [0|15] ""  GUI
 SG_ BOT_V_GDIC_SPI_Current_Baudrate : 444|4@1+ (1,0) [0|15] ""  GUI
 SG_ BOT_U_GDIC_SPI_Current_Baudrate : 440|4@1+ (1,0) [0|15] ""  GUI
 SG_ TOP_W_GDIC_SPI_Current_Baudrate : 436|4@1+ (1,0) [0|15] ""  GUI
 SG_ TOP_V_GDIC_SPI_Current_Baudrate : 432|4@1+ (1,0) [0|15] ""  GUI
 SG_ TOP_U_GDIC_SPI_Current_Baudrate : 428|4@1+ (1,0) [0|15] ""  GUI
 SG_ TLF35584_Current_State : 424|4@1+ (1,0) [0|15] ""  GUI
 SG_ PPAWL_ENGMT_SNSR_WED_Freq : 408|16@1+ (1,0) [0|65535] "Hz"  GUI
 SG_ PPAWL_ENGMT_SNSR_WED_Duty : 392|16@1+ (0.01,0) [0|100] "%"  GUI
 SG_ DRV8705_CSA_CTRL_Read_Data : 384|8@1+ (1,0) [0|255] ""  GUI
 SG_ DRV8705_UVOV_CTRL_Read_Data : 376|8@1+ (1,0) [0|255] ""  GUI
 SG_ DRV8705_OLSC_CTRL_Read_Data : 368|8@1+ (1,0) [0|255] ""  GUI
 SG_ DRV8705_VDS_CTRL_2_Read_Data : 360|8@1+ (1,0) [0|255] ""  GUI
 SG_ DRV8705_VDS_CTRL_1_Read_Data : 352|8@1+ (1,0) [0|255] ""  GUI
 SG_ DRV8705_DRV_CTRL_3_Read_Data : 344|8@1+ (1,0) [0|255] ""  GUI
 SG_ DRV8705_DRV_CTRL_2_Read_Data : 336|8@1+ (1,0) [0|255] ""  GUI
 SG_ DRV8705_DRV_CTRL_1_Read_Data : 328|8@1+ (1,0) [0|255] ""  GUI
 SG_ DRV8705_BRG_CTRL_Read_Data : 320|8@1+ (1,0) [0|255] ""  GUI
 SG_ DRV8705_IC_CTRL_Read_Data : 312|8@1+ (1,0) [0|255] ""  GUI
 SG_ DRV8705_IC_STAT_2_Read_Data : 304|8@1+ (1,0) [0|255] ""  GUI
 SG_ DRV8705_VGS_VDS_STAT_Read_Data : 296|8@1+ (1,0) [0|255] ""  GUI
 SG_ DRV8705_IC_STAT_1_Read_Data : 288|8@1+ (1,0) [0|255] ""  GUI
 SG_ PPAWL_MTR_WED_POS_uC_SENT_Data5 : 284|4@1+ (1,0) [0|15] ""  GUI
 SG_ PPAWL_MTR_WED_POS_uC_SENT_Data4 : 280|4@1+ (1,0) [0|15] ""  GUI
 SG_ PPAWL_MTR_WED_POS_uC_SENT_Data3 : 276|4@1+ (1,0) [0|15] ""  GUI
 SG_ PPAWL_MTR_WED_POS_uC_SENT_Data2 : 272|4@1+ (1,0) [0|15] ""  GUI
 SG_ PPAWL_MTR_WED_POS_uC_SENT_Data1 : 268|4@1+ (1,0) [0|15] ""  GUI
 SG_ PPAWL_MTR_WED_POS_uC_SENT_Data0 : 264|4@1+ (1,0) [0|15] ""  GUI
 SG_ POS1_eLOCKER_uC_SENT_Data5 : 260|4@1+ (1,0) [0|15] ""  GUI
 SG_ POS1_eLOCKER_uC_SENT_Data4 : 256|4@1+ (1,0) [0|15] ""  GUI
 SG_ POS1_eLOCKER_uC_SENT_Data3 : 252|4@1+ (1,0) [0|15] ""  GUI
 SG_ POS1_eLOCKER_uC_SENT_Data2 : 248|4@1+ (1,0) [0|15] ""  GUI
 SG_ POS1_eLOCKER_uC_SENT_Data1 : 244|4@1+ (1,0) [0|15] ""  GUI
 SG_ POS1_eLOCKER_uC_SENT_Data0 : 240|4@1+ (1,0) [0|15] ""  GUI
 SG_ eLOCKER_LS_VSENSE_Duty : 224|16@1+ (0.01,0) [0|100] "%"  GUI
 SG_ eLOCKER_LS_VSENSE_Freq : 208|16@1+ (1,0) [0|65535] "Hz"  GUI
 SG_ EXC_HI_DIAG_FREQ_Duty : 144|16@1+ (0.01,0) [0|100] "%"  GUI
 SG_ EXC_HI_DIAG_FREQ_Freq : 160|16@1+ (1,0) [0|65535] "Hz"  GUI
 SG_ EXC_LO_DIAG_FREQ_Duty : 112|16@1+ (0.01,0) [0|100] "%"  GUI
 SG_ EXC_LO_DIAG_FREQ_Freq : 128|16@1+ (1,0) [0|65535] "Hz"  GUI
 SG_ MotClb_Spd_rpm_Flt : 176|16@1+ (1,-17000) [-17000|30000] "RPM"  GUI
 SG_ Rotor_Position : 192|13@1+ (0.1,0) [0|360] "°"  GUI
 SG_ RED_DSADC_RES_COS : 96|16@1+ (1,-32768) [-32768|32767] ""  GUI
 SG_ RED_DSADC_RES_SIN : 80|16@1+ (1,-32768) [-32768|32767] ""  GUI
 SG_ DSADC_RES_COS : 64|16@1+ (1,-32768) [-32768|32767] ""  GUI
 SG_ DSADC_RES_SIN : 48|16@1+ (1,-32768) [-32768|32767] ""  GUI
 SG_ EXC_LO_DIAG_AI : 36|12@1+ (1,0) [0|4095] ""  GUI
 SG_ EXC_HI_DIAG_AI : 24|12@1+ (1,0) [0|4095] ""  GUI
 SG_ COS_LO_DIAG_AI : 12|12@1+ (1,0) [0|4095] ""  GUI
 SG_ SIN_LO_DIAG_AI : 0|12@1+ (1,0) [0|4095] ""  GUI

BO_ 1563 MCU_TX_0x61B_DEVCANFD: 64 MCU
 SG_ eLOCKER_LS_ISENSE_AI : 432|12@1+ (1,0) [0|4095] ""  GUI
 SG_ eLOCKER_HS_VSENSE_AI : 456|12@1+ (1,0) [0|4095] ""  GUI
 SG_ eLOCKER_HS_ISENSE_AI : 444|12@1+ (1,0) [0|4095] ""  GUI
 SG_ eLOCKER_LS_VSENSE_AI : 468|12@1+ (1,0) [0|4095] ""  GUI
 SG_ PPAWL_MTR_CURRENT_SENSE_AI : 420|12@1+ (1,0) [0|4095] ""  GUI
 SG_ PPAWL_MTR_PWR_AI : 408|12@1+ (1,0) [0|4095] ""  GUI
 SG_ ACT_DIS_FET_HEALTH_AI : 396|12@1+ (1,0) [0|4095] ""  GUI
 SG_ VI_5V_COMM_AI : 384|12@1+ (1,0) [0|4095] ""  GUI
 SG_ AC_BB_TEMP_AI : 372|12@1+ (1,0) [0|4095] ""  GUI
 SG_ DC_BB_TEMP_AI : 360|12@1+ (1,0) [0|4095] ""  GUI
 SG_ GDB_TEMP_AI : 348|12@1+ (1,0) [0|4095] ""  GUI
 SG_ VI_5VA_AI : 336|12@1+ (1,0) [0|4095] ""  GUI
 SG_ HV_ISOLATION_NEG_AI : 324|12@1+ (1,0) [0|4095] ""  GUI
 SG_ HV_ISOLATION_POS_AI : 312|12@1+ (1,0) [0|4095] ""  GUI
 SG_ VI_15V_SAFETY_BOT_AI : 300|12@1+ (1,0) [0|4095] ""  GUI
 SG_ VI_15V_SAFETY_TOP_AI : 288|12@1+ (1,0) [0|4095] ""  GUI
 SG_ VI_5V_OUT_AI : 276|12@1+ (1,0) [0|4095] ""  GUI
 SG_ VI_5V_CURRENT_SENSE_AI : 264|12@1+ (1,0) [0|4095] ""  GUI
 SG_ VBATT2_AI : 252|12@1+ (1,0) [0|4095] ""  GUI
 SG_ VI_5V_GDIC_TOP_AI : 240|12@1+ (1,0) [0|4095] ""  GUI
 SG_ VBATT1_AI : 228|12@1+ (1,0) [0|4095] ""  GUI
 SG_ MTR_TEMP_AI : 216|12@1+ (1,0) [0|4095] ""  GUI
 SG_ VI_18V_FLYBACK_EPS_AI : 204|12@1+ (1,0) [0|4095] ""  GUI
 SG_ VI_5V_GDIC_BOT_AI : 192|12@1+ (1,0) [0|4095] ""  GUI
 SG_ VI_16V6_AI : 180|12@1+ (1,0) [0|4095] ""  GUI
 SG_ VI_1V3_AI : 168|12@1+ (1,0) [0|4095] ""  GUI
 SG_ VI_3V3_FLASH_AI : 156|12@1+ (1,0) [0|4095] ""  GUI
 SG_ AD_Temp_Coolant : 144|12@1+ (1,0) [0|4095] ""  GUI
 SG_ EMC_TEMP_AI : 132|12@1+ (1,0) [0|4095] ""  GUI
 SG_ CB_PCB_TEMP_AI : 120|12@1+ (1,0) [0|4095] ""  GUI
 SG_ VI_2V5_AI : 108|12@1+ (1,0) [0|4095] ""  GUI
 SG_ VI_5V_AI : 96|12@1+ (1,0) [0|4095] ""  GUI
 SG_ HVDC_CURRENT_SENSE_AI : 84|12@1+ (1,0) [0|4095] ""  GUI
 SG_ RED_W_CURRENT_SENSE_AI : 72|12@1+ (1,0) [0|4095] ""  GUI
 SG_ RED_V_CURRENT_SENSE_AI : 60|12@1+ (1,0) [0|4095] ""  GUI
 SG_ RED_U_CURRENT_SENSE_AI : 48|12@1+ (1,0) [0|4095] ""  GUI
 SG_ HVDC_SENSE_MAIN_MICRO_AI : 36|12@1+ (1,0) [0|4095] ""  GUI
 SG_ W_CURRENT_SENSE_AI : 24|12@1+ (1,0) [0|4095] ""  GUI
 SG_ V_CURRENT_SENSE_AI : 12|12@1+ (1,0) [0|4095] ""  GUI
 SG_ U_CURRENT_SENSE_AI : 0|12@1+ (1,0) [0|4095] ""  GUI

CM_ SG_ 1558 BOT_W_Die_TEMP_ADC_Data "Page:GDIC3162_ADC";
CM_ SG_ 1558 BOT_W_Power_TEMP_ADC_Data "Page:GDIC3162_ADC";
CM_ SG_ 1558 BOT_W_VEE_ADC_Data "Page:GDIC3162_ADC";
CM_ SG_ 1558 BOT_W_VCC_ADC_Data "Page:GDIC3162_ADC";
CM_ SG_ 1558 BOT_W_AMUXIN_ADC_Data "Page:GDIC3162_ADC";
CM_ SG_ 1558 BOT_W_DESAT_ADC_Data "Page:GDIC3162_ADC";
CM_ SG_ 1558 BOT_V_Die_TEMP_ADC_Data "Page:GDIC3162_ADC";
CM_ SG_ 1558 BOT_V_Power_TEMP_ADC_Data "Page:GDIC3162_ADC";
CM_ SG_ 1558 BOT_V_VEE_ADC_Data "Page:GDIC3162_ADC";
CM_ SG_ 1558 BOT_V_VCC_ADC_Data "Page:GDIC3162_ADC";
CM_ SG_ 1558 BOT_V_AMUXIN_ADC_Data "Page:GDIC3162_ADC";
CM_ SG_ 1558 BOT_V_DESAT_ADC_Data "Page:GDIC3162_ADC";
CM_ SG_ 1558 BOT_U_Die_TEMP_ADC_Data "Page:GDIC3162_ADC";
CM_ SG_ 1558 BOT_U_Power_TEMP_ADC_Data "Page:GDIC3162_ADC";
CM_ SG_ 1558 BOT_U_VEE_ADC_Data "Page:GDIC3162_ADC";
CM_ SG_ 1558 BOT_U_VCC_ADC_Data "Page:GDIC3162_ADC";
CM_ SG_ 1558 BOT_U_AMUXIN_ADC_Data "Page:GDIC3162_ADC";
CM_ SG_ 1558 BOT_U_DESAT_ADC_Data "Page:GDIC3162_ADC";
CM_ SG_ 1558 TOP_W_Die_TEMP_ADC_Data "Page:GDIC3162_ADC";
CM_ SG_ 1558 TOP_W_Power_TEMP_ADC_Data "Page:GDIC3162_ADC";
CM_ SG_ 1558 TOP_W_VEE_ADC_Data "Page:GDIC3162_ADC";
CM_ SG_ 1558 TOP_W_VCC_ADC_Data "Page:GDIC3162_ADC";
CM_ SG_ 1558 TOP_W_AMUXIN_ADC_Data "Page:GDIC3162_ADC";
CM_ SG_ 1558 TOP_W_DESAT_ADC_Data "Page:GDIC3162_ADC";
CM_ SG_ 1558 TOP_V_Die_TEMP_ADC_Data "Page:GDIC3162_ADC";
CM_ SG_ 1558 TOP_V_Power_TEMP_ADC_Data "Page:GDIC3162_ADC";
CM_ SG_ 1558 TOP_V_VEE_ADC_Data "Page:GDIC3162_ADC";
CM_ SG_ 1558 TOP_V_VCC_ADC_Data "Page:GDIC3162_ADC";
CM_ SG_ 1558 TOP_V_AMUXIN_ADC_Data "Page:GDIC3162_ADC";
CM_ SG_ 1558 TOP_V_DESAT_ADC_Data "Page:GDIC3162_ADC";
CM_ SG_ 1558 TOP_U_Die_TEMP_ADC_Data "Page:GDIC3162_ADC";
CM_ SG_ 1558 TOP_U_Power_TEMP_ADC_Data "Page:GDIC3162_ADC";
CM_ SG_ 1558 TOP_U_VEE_ADC_Data "Page:GDIC3162_ADC";
CM_ SG_ 1558 TOP_U_VCC_ADC_Data "Page:GDIC3162_ADC";
CM_ SG_ 1558 TOP_U_AMUXIN_ADC_Data "Page:GDIC3162_ADC";
CM_ SG_ 1558 TOP_U_DESAT_ADC_Data "Page:GDIC3162_ADC";
CM_ SG_ 1282 SPI_Baudrate_Update "Page:SPI";
CM_ SG_ 1282 PPAWL_SPI_Select_Baudrate "Page:SPI";
CM_ SG_ 1282 CANFD_5_SPI_Select_Baudrate "Page:SPI";
CM_ SG_ 1282 CANFD_16_SPI_Select_Baudrate "Page:SPI";
CM_ SG_ 1282 FLASH_SPI_Select_Baudrate "Page:SPI";
CM_ SG_ 1282 SBC_SPI_Select_Baudrate "Page:SPI";
CM_ SG_ 1282 BOT_W_GDIC_SPI_Select_Baudrate "Page:SPI";
CM_ SG_ 1282 BOT_V_GDIC_SPI_Select_Baudrate "Page:SPI";
CM_ SG_ 1282 BOT_U_GDIC_SPI_Select_Baudrate "Page:SPI";
CM_ SG_ 1282 TOP_W_GDIC_SPI_Select_Baudrate "Page:SPI";
CM_ SG_ 1282 TOP_V_GDIC_SPI_Select_Baudrate "Page:SPI";
CM_ SG_ 1282 TOP_U_GDIC_SPI_Select_Baudrate "Page:SPI";
CM_ SG_ 1282 LIN_Receive_Checksum_Type "Page:LIN";
CM_ SG_ 1282 LIN_Receive_Length "Page:LIN";
CM_ SG_ 1282 LIN_Receive_ID "Page:LIN";
CM_ SG_ 1282 LIN_Send_Data7 "Page:LIN";
CM_ SG_ 1282 LIN_Send_Data6 "Page:LIN";
CM_ SG_ 1282 LIN_Send_Data5 "Page:LIN";
CM_ SG_ 1282 LIN_Send_Data4 "Page:LIN";
CM_ SG_ 1282 LIN_Send_Data3 "Page:LIN";
CM_ SG_ 1282 LIN_Send_Data2 "Page:LIN";
CM_ SG_ 1282 LIN_Send_Data1 "Page:LIN";
CM_ SG_ 1282 LIN_Send_Data0 "Page:LIN";
CM_ SG_ 1282 LIN_Send_Checksum_Type "Page:LIN";
CM_ SG_ 1282 LIN_Send_Length "Page:LIN";
CM_ SG_ 1282 LIN_Send_ID "Page:LIN";
CM_ SG_ 1281 E_STOP_MAIN_MICRO_OUTPUT "Page:Safing_Logic";
CM_ SG_ 1281 DSAT_BOT_FLT_FB_OUTPUT "Page:Safing_Logic";
CM_ SG_ 1281 DSAT_TOP_FLT_FB_OUTPUT "Page:Safing_Logic";
CM_ SG_ 1281 UVLO_BOT_FLT_FB_OUTPUT "Page:Safing_Logic";
CM_ SG_ 1281 UVLO_TOP_FLT_FB_OUTPUT "Page:Safing_Logic";
CM_ SG_ 1281 HVDC_OV_FLT_FB_OUTPUT "Page:Safing_Logic";
CM_ SG_ 1281 PHASE_UVW_OC_FLT_OUTPUT "Page:Safing_Logic";
CM_ SG_ 1281 OC_W_FLT_OUTPUT "Page:Safing_Logic";
CM_ SG_ 1281 OC_V_FLT_OUTPUT "Page:Safing_Logic";
CM_ SG_ 1281 OC_U_FLT_OUTPUT "Page:Safing_Logic";
CM_ SG_ 1281 Safing_Logic_E_STOP_MAIN_MICRO_Dir_Select "Page:Safing_Logic";
CM_ SG_ 1281 Safing_Logic_DSAT_BOT_FLT_FB_Dir_Select "Page:Safing_Logic";
CM_ SG_ 1281 Safing_Logic_DSAT_TOP_FLT_FB_Dir_Select "Page:Safing_Logic";
CM_ SG_ 1281 Safing_Logic_UVLO_BOT_FLT_FB_Dir_Select "Page:Safing_Logic";
CM_ SG_ 1281 Safing_Logic_UVLO_TOP_FLT_FB_Dir_Select "Page:Safing_Logic";
CM_ SG_ 1281 Safing_Logic_HVDC_OV_FLT_FB_Dir_Select "Page:Safing_Logic";
CM_ SG_ 1281 Safing_Logic_PHASE_UVW_OC_FLT_Dir_Select "Page:Safing_Logic";
CM_ SG_ 1281 Safing_Logic_OC_W_FLT_Dir_Select "Page:Safing_Logic";
CM_ SG_ 1281 Safing_Logic_OC_V_FLT_Dir_Select "Page:Safing_Logic";
CM_ SG_ 1281 Safing_Logic_OC_U_FLT_Dir_Select "Page:Safing_Logic";
CM_ SG_ 1281 Safing_Logic_Pin_Dir_Update "Page:Safing_Logic";
CM_ SG_ 1281 Safing_Logic_Test_Stop "Page:Safing_Logic";
CM_ SG_ 1281 Safing_Logic_Test_Start "Page:Safing_Logic";
CM_ SG_ 1281 BOT_W_Status_Write_Flag "Page:GDIC3162_Status";
CM_ SG_ 1281 BOT_V_Status_Write_Flag "Page:GDIC3162_Status";
CM_ SG_ 1281 BOT_U_Status_Write_Flag "Page:GDIC3162_Status";
CM_ SG_ 1281 TOP_W_Status_Write_Flag "Page:GDIC3162_Status";
CM_ SG_ 1281 TOP_V_Status_Write_Flag "Page:GDIC3162_Status";
CM_ SG_ 1281 TOP_U_Status_Write_Flag "Page:GDIC3162_Status";
CM_ SG_ 1281 BOT_W_AMUX_SEL "Page:GDIC3162_ADC";
CM_ SG_ 1281 BOT_V_AMUX_SEL "Page:GDIC3162_ADC";
CM_ SG_ 1281 BOT_U_AMUX_SEL "Page:GDIC3162_ADC";
CM_ SG_ 1281 TOP_W_AMUX_SEL "Page:GDIC3162_ADC";
CM_ SG_ 1281 TOP_V_AMUX_SEL "Page:GDIC3162_ADC";
CM_ SG_ 1281 TOP_U_AMUX_SEL "Page:GDIC3162_ADC";
CM_ SG_ 1281 BOT_W_AOUT_SELECT "Page:GDIC3162_AOUT";
CM_ SG_ 1281 BOT_V_AOUT_SELECT "Page:GDIC3162_AOUT";
CM_ SG_ 1281 BOT_U_AOUT_SELECT "Page:GDIC3162_AOUT";
CM_ SG_ 1281 TOP_W_AOUT_SELECT "Page:GDIC3162_AOUT";
CM_ SG_ 1281 TOP_V_AOUT_SELECT "Page:GDIC3162_AOUT";
CM_ SG_ 1281 TOP_U_AOUT_SELECT "Page:GDIC3162_AOUT";
CM_ SG_ 1281 BOT_W_Register_Write_Index "Page:GDIC3162_Status";
CM_ SG_ 1281 BOT_V_Register_Write_Index "Page:GDIC3162_Status";
CM_ SG_ 1281 BOT_U_Register_Write_Index "Page:GDIC3162_Status";
CM_ SG_ 1281 TOP_W_Register_Write_Index "Page:GDIC3162_Status";
CM_ SG_ 1281 TOP_V_Register_Write_Index "Page:GDIC3162_Status";
CM_ SG_ 1281 TOP_U_Register_Write_Index "Page:GDIC3162_Status";
CM_ SG_ 1281 BOT_W_Status_Write_Data9 "Page:GDIC3162_Status";
CM_ SG_ 1281 BOT_W_Status_Write_Data8 "Page:GDIC3162_Status";
CM_ SG_ 1281 BOT_W_Status_Write_Data7 "Page:GDIC3162_Status";
CM_ SG_ 1281 BOT_W_Status_Write_Data6 "Page:GDIC3162_Status";
CM_ SG_ 1281 BOT_W_Status_Write_Data5 "Page:GDIC3162_Status";
CM_ SG_ 1281 BOT_W_Status_Write_Data4 "Page:GDIC3162_Status";
CM_ SG_ 1281 BOT_W_Status_Write_Data3 "Page:GDIC3162_Status";
CM_ SG_ 1281 BOT_W_Status_Write_Data2 "Page:GDIC3162_Status";
CM_ SG_ 1281 BOT_W_Status_Write_Data1 "Page:GDIC3162_Status";
CM_ SG_ 1281 BOT_W_Status_Write_Data0 "Page:GDIC3162_Status";
CM_ SG_ 1281 BOT_V_Status_Write_Data9 "Page:GDIC3162_Status";
CM_ SG_ 1281 BOT_V_Status_Write_Data8 "Page:GDIC3162_Status";
CM_ SG_ 1281 BOT_V_Status_Write_Data7 "Page:GDIC3162_Status";
CM_ SG_ 1281 BOT_V_Status_Write_Data6 "Page:GDIC3162_Status";
CM_ SG_ 1281 BOT_V_Status_Write_Data5 "Page:GDIC3162_Status";
CM_ SG_ 1281 BOT_V_Status_Write_Data4 "Page:GDIC3162_Status";
CM_ SG_ 1281 BOT_V_Status_Write_Data3 "Page:GDIC3162_Status";
CM_ SG_ 1281 BOT_V_Status_Write_Data2 "Page:GDIC3162_Status";
CM_ SG_ 1281 BOT_V_Status_Write_Data1 "Page:GDIC3162_Status";
CM_ SG_ 1281 BOT_V_Status_Write_Data0 "Page:GDIC3162_Status";
CM_ SG_ 1281 BOT_U_Status_Write_Data9 "Page:GDIC3162_Status";
CM_ SG_ 1281 BOT_U_Status_Write_Data8 "Page:GDIC3162_Status";
CM_ SG_ 1281 BOT_U_Status_Write_Data7 "Page:GDIC3162_Status";
CM_ SG_ 1281 BOT_U_Status_Write_Data6 "Page:GDIC3162_Status";
CM_ SG_ 1281 BOT_U_Status_Write_Data5 "Page:GDIC3162_Status";
CM_ SG_ 1281 BOT_U_Status_Write_Data4 "Page:GDIC3162_Status";
CM_ SG_ 1281 BOT_U_Status_Write_Data3 "Page:GDIC3162_Status";
CM_ SG_ 1281 BOT_U_Status_Write_Data2 "Page:GDIC3162_Status";
CM_ SG_ 1281 BOT_U_Status_Write_Data1 "Page:GDIC3162_Status";
CM_ SG_ 1281 BOT_U_Status_Write_Data0 "Page:GDIC3162_Status";
CM_ SG_ 1281 TOP_W_Status_Write_Data9 "Page:GDIC3162_Status";
CM_ SG_ 1281 TOP_W_Status_Write_Data8 "Page:GDIC3162_Status";
CM_ SG_ 1281 TOP_W_Status_Write_Data7 "Page:GDIC3162_Status";
CM_ SG_ 1281 TOP_W_Status_Write_Data6 "Page:GDIC3162_Status";
CM_ SG_ 1281 TOP_W_Status_Write_Data5 "Page:GDIC3162_Status";
CM_ SG_ 1281 TOP_W_Status_Write_Data4 "Page:GDIC3162_Status";
CM_ SG_ 1281 TOP_W_Status_Write_Data3 "Page:GDIC3162_Status";
CM_ SG_ 1281 TOP_W_Status_Write_Data2 "Page:GDIC3162_Status";
CM_ SG_ 1281 TOP_W_Status_Write_Data1 "Page:GDIC3162_Status";
CM_ SG_ 1281 TOP_W_Status_Write_Data0 "Page:GDIC3162_Status";
CM_ SG_ 1281 TOP_V_Status_Write_Data9 "Page:GDIC3162_Status";
CM_ SG_ 1281 TOP_V_Status_Write_Data8 "Page:GDIC3162_Status";
CM_ SG_ 1281 TOP_V_Status_Write_Data7 "Page:GDIC3162_Status";
CM_ SG_ 1281 TOP_V_Status_Write_Data6 "Page:GDIC3162_Status";
CM_ SG_ 1281 TOP_V_Status_Write_Data5 "Page:GDIC3162_Status";
CM_ SG_ 1281 TOP_V_Status_Write_Data4 "Page:GDIC3162_Status";
CM_ SG_ 1281 TOP_V_Status_Write_Data3 "Page:GDIC3162_Status";
CM_ SG_ 1281 TOP_V_Status_Write_Data2 "Page:GDIC3162_Status";
CM_ SG_ 1281 TOP_V_Status_Write_Data1 "Page:GDIC3162_Status";
CM_ SG_ 1281 TOP_V_Status_Write_Data0 "Page:GDIC3162_Status";
CM_ SG_ 1281 TOP_U_Status_Write_Data9 "Page:GDIC3162_Status";
CM_ SG_ 1281 TOP_U_Status_Write_Data8 "Page:GDIC3162_Status";
CM_ SG_ 1281 TOP_U_Status_Write_Data7 "Page:GDIC3162_Status";
CM_ SG_ 1281 TOP_U_Status_Write_Data6 "Page:GDIC3162_Status";
CM_ SG_ 1281 TOP_U_Status_Write_Data5 "Page:GDIC3162_Status";
CM_ SG_ 1281 TOP_U_Status_Write_Data4 "Page:GDIC3162_Status";
CM_ SG_ 1281 TOP_U_Status_Write_Data3 "Page:GDIC3162_Status";
CM_ SG_ 1281 TOP_U_Status_Write_Data2 "Page:GDIC3162_Status";
CM_ SG_ 1281 TOP_U_Status_Write_Data1 "Page:GDIC3162_Status";
CM_ SG_ 1281 TOP_U_Status_Write_Data0 "Page:GDIC3162_Status";
CM_ SG_ 1562 BOT_W_TSENSEA_Freq "Page:GDIC3162_AOUT";
CM_ SG_ 1562 BOT_W_TSENSEA_Duty "Page:GDIC3162_AOUT";
CM_ SG_ 1562 BOT_V_TSENSEA_Freq "Page:GDIC3162_AOUT";
CM_ SG_ 1562 BOT_V_TSENSEA_Duty "Page:GDIC3162_AOUT";
CM_ SG_ 1562 BOT_U_TSENSEA_Freq "Page:GDIC3162_AOUT";
CM_ SG_ 1562 BOT_U_TSENSEA_Duty "Page:GDIC3162_AOUT";
CM_ SG_ 1562 TOP_W_TSENSEA_Freq "Page:GDIC3162_AOUT";
CM_ SG_ 1562 TOP_W_TSENSEA_Duty "Page:GDIC3162_AOUT";
CM_ SG_ 1562 TOP_V_TSENSEA_Freq "Page:GDIC3162_AOUT";
CM_ SG_ 1562 TOP_V_TSENSEA_Duty "Page:GDIC3162_AOUT";
CM_ SG_ 1562 TOP_U_TSENSEA_Freq "Page:GDIC3162_AOUT";
CM_ SG_ 1562 TOP_U_TSENSEA_Duty "Page:GDIC3162_AOUT";
CM_ SG_ 1562 BOT_W_DISCHG_Data "Page:GDIC3162_Registers Address:0x17";
CM_ SG_ 1562 BOT_W_DISCHG_CRC "Page:GDIC3162_Registers Address:0x17";
CM_ SG_ 1562 BOT_V_DISCHG_Data "Page:GDIC3162_Registers Address:0x17";
CM_ SG_ 1562 BOT_V_DISCHG_CRC "Page:GDIC3162_Registers Address:0x17";
CM_ SG_ 1562 BOT_U_DISCHG_Data "Page:GDIC3162_Registers Address:0x17";
CM_ SG_ 1562 BOT_U_DISCHG_CRC "Page:GDIC3162_Registers Address:0x17";
CM_ SG_ 1562 TOP_W_DISCHG_Data "Page:GDIC3162_Registers Address:0x17";
CM_ SG_ 1562 TOP_W_DISCHG_CRC "Page:GDIC3162_Registers Address:0x17";
CM_ SG_ 1562 TOP_V_DISCHG_Data "Page:GDIC3162_Registers Address:0x17";
CM_ SG_ 1562 TOP_V_DISCHG_CRC "Page:GDIC3162_Registers Address:0x17";
CM_ SG_ 1562 TOP_U_DISCHG_Data "Page:GDIC3162_Registers Address:0x17";
CM_ SG_ 1562 TOP_U_DISCHG_CRC "Page:GDIC3162_Registers Address:0x17";
CM_ SG_ 1562 BOT_W_REQBIST_Data "Page:GDIC3162_Registers Address:0x14";
CM_ SG_ 1562 BOT_W_REQBIST_CRC "Page:GDIC3162_Registers Address:0x14";
CM_ SG_ 1562 BOT_V_REQBIST_Data "Page:GDIC3162_Registers Address:0x14";
CM_ SG_ 1562 BOT_V_REQBIST_CRC "Page:GDIC3162_Registers Address:0x14";
CM_ SG_ 1562 BOT_U_REQBIST_Data "Page:GDIC3162_Registers Address:0x14";
CM_ SG_ 1562 BOT_U_REQBIST_CRC "Page:GDIC3162_Registers Address:0x14";
CM_ SG_ 1562 TOP_W_REQBIST_Data "Page:GDIC3162_Registers Address:0x14";
CM_ SG_ 1562 TOP_W_REQBIST_CRC "Page:GDIC3162_Registers Address:0x14";
CM_ SG_ 1562 TOP_V_REQBIST_Data "Page:GDIC3162_Registers Address:0x14";
CM_ SG_ 1562 TOP_V_REQBIST_CRC "Page:GDIC3162_Registers Address:0x14";
CM_ SG_ 1562 TOP_U_REQBIST_Data "Page:GDIC3162_Registers Address:0x14";
CM_ SG_ 1562 TOP_U_REQBIST_CRC "Page:GDIC3162_Registers Address:0x14";
CM_ SG_ 1561 BOT_W_CONFIGAOUT_Data "Page:GDIC3162_Registers Address:0x13";
CM_ SG_ 1561 BOT_W_CONFIGAOUT_CRC "Page:GDIC3162_Registers Address:0x13";
CM_ SG_ 1561 BOT_V_CONFIGAOUT_Data "Page:GDIC3162_Registers Address:0x13";
CM_ SG_ 1561 BOT_V_CONFIGAOUT_CRC "Page:GDIC3162_Registers Address:0x13";
CM_ SG_ 1561 BOT_U_CONFIGAOUT_Data "Page:GDIC3162_Registers Address:0x13";
CM_ SG_ 1561 BOT_U_CONFIGAOUT_CRC "Page:GDIC3162_Registers Address:0x13";
CM_ SG_ 1561 TOP_W_CONFIGAOUT_Data "Page:GDIC3162_Registers Address:0x13";
CM_ SG_ 1561 TOP_W_CONFIGAOUT_CRC "Page:GDIC3162_Registers Address:0x13";
CM_ SG_ 1561 TOP_V_CONFIGAOUT_Data "Page:GDIC3162_Registers Address:0x13";
CM_ SG_ 1561 TOP_V_CONFIGAOUT_CRC "Page:GDIC3162_Registers Address:0x13";
CM_ SG_ 1561 TOP_U_CONFIGAOUT_Data "Page:GDIC3162_Registers Address:0x13";
CM_ SG_ 1561 TOP_U_CONFIGAOUT_CRC "Page:GDIC3162_Registers Address:0x13";
CM_ SG_ 1561 BOT_W_STATCON4_Data "Page:GDIC3162_Registers Address:0x12";
CM_ SG_ 1561 BOT_W_STATCON4_CRC "Page:GDIC3162_Registers Address:0x12";
CM_ SG_ 1561 BOT_V_STATCON4_Data "Page:GDIC3162_Registers Address:0x12";
CM_ SG_ 1561 BOT_V_STATCON4_CRC "Page:GDIC3162_Registers Address:0x12";
CM_ SG_ 1561 BOT_U_STATCON4_Data "Page:GDIC3162_Registers Address:0x12";
CM_ SG_ 1561 BOT_U_STATCON4_CRC "Page:GDIC3162_Registers Address:0x12";
CM_ SG_ 1561 TOP_W_STATCON4_Data "Page:GDIC3162_Registers Address:0x12";
CM_ SG_ 1561 TOP_W_STATCON4_CRC "Page:GDIC3162_Registers Address:0x12";
CM_ SG_ 1561 TOP_V_STATCON4_Data "Page:GDIC3162_Registers Address:0x12";
CM_ SG_ 1561 TOP_V_STATCON4_CRC "Page:GDIC3162_Registers Address:0x12";
CM_ SG_ 1561 TOP_U_STATCON4_Data "Page:GDIC3162_Registers Address:0x12";
CM_ SG_ 1561 TOP_U_STATCON4_CRC "Page:GDIC3162_Registers Address:0x12";
CM_ SG_ 1561 BOT_W_STATUS3_Data "Page:GDIC3162_Registers Address:0x11";
CM_ SG_ 1561 BOT_W_STATUS3_CRC "Page:GDIC3162_Registers Address:0x11";
CM_ SG_ 1561 BOT_V_STATUS3_Data "Page:GDIC3162_Registers Address:0x11";
CM_ SG_ 1561 BOT_V_STATUS3_CRC "Page:GDIC3162_Registers Address:0x11";
CM_ SG_ 1561 BOT_U_STATUS3_Data "Page:GDIC3162_Registers Address:0x11";
CM_ SG_ 1561 BOT_U_STATUS3_CRC "Page:GDIC3162_Registers Address:0x11";
CM_ SG_ 1561 TOP_W_STATUS3_Data "Page:GDIC3162_Registers Address:0x11";
CM_ SG_ 1561 TOP_W_STATUS3_CRC "Page:GDIC3162_Registers Address:0x11";
CM_ SG_ 1561 TOP_V_STATUS3_Data "Page:GDIC3162_Registers Address:0x11";
CM_ SG_ 1561 TOP_V_STATUS3_CRC "Page:GDIC3162_Registers Address:0x11";
CM_ SG_ 1561 TOP_U_STATUS3_Data "Page:GDIC3162_Registers Address:0x11";
CM_ SG_ 1561 TOP_U_STATUS3_CRC "Page:GDIC3162_Registers Address:0x11";
CM_ SG_ 1561 BOT_W_RMSK2_Data "Page:GDIC3162_Registers Address:0x10";
CM_ SG_ 1561 BOT_W_RMSK2_CRC "Page:GDIC3162_Registers Address:0x10";
CM_ SG_ 1561 BOT_V_RMSK2_Data "Page:GDIC3162_Registers Address:0x10";
CM_ SG_ 1561 BOT_V_RMSK2_CRC "Page:GDIC3162_Registers Address:0x10";
CM_ SG_ 1561 BOT_U_RMSK2_Data "Page:GDIC3162_Registers Address:0x10";
CM_ SG_ 1561 BOT_U_RMSK2_CRC "Page:GDIC3162_Registers Address:0x10";
CM_ SG_ 1561 TOP_W_RMSK2_Data "Page:GDIC3162_Registers Address:0x10";
CM_ SG_ 1561 TOP_W_RMSK2_CRC "Page:GDIC3162_Registers Address:0x10";
CM_ SG_ 1561 TOP_V_RMSK2_Data "Page:GDIC3162_Registers Address:0x10";
CM_ SG_ 1561 TOP_V_RMSK2_CRC "Page:GDIC3162_Registers Address:0x10";
CM_ SG_ 1561 TOP_U_RMSK2_Data "Page:GDIC3162_Registers Address:0x10";
CM_ SG_ 1561 TOP_U_RMSK2_CRC "Page:GDIC3162_Registers Address:0x10";
CM_ SG_ 1560 BOT_W_MSK2_Data "Page:GDIC3162_Registers Address:0x0F";
CM_ SG_ 1560 BOT_W_MSK2_CRC "Page:GDIC3162_Registers Address:0x0F";
CM_ SG_ 1560 BOT_V_MSK2_Data "Page:GDIC3162_Registers Address:0x0F";
CM_ SG_ 1560 BOT_V_MSK2_CRC "Page:GDIC3162_Registers Address:0x0F";
CM_ SG_ 1560 BOT_U_MSK2_Data "Page:GDIC3162_Registers Address:0x0F";
CM_ SG_ 1560 BOT_U_MSK2_CRC "Page:GDIC3162_Registers Address:0x0F";
CM_ SG_ 1560 TOP_W_MSK2_Data "Page:GDIC3162_Registers Address:0x0F";
CM_ SG_ 1560 TOP_W_MSK2_CRC "Page:GDIC3162_Registers Address:0x0F";
CM_ SG_ 1560 TOP_V_MSK2_Data "Page:GDIC3162_Registers Address:0x0F";
CM_ SG_ 1560 TOP_V_MSK2_CRC "Page:GDIC3162_Registers Address:0x0F";
CM_ SG_ 1560 TOP_U_MSK2_Data "Page:GDIC3162_Registers Address:0x0F";
CM_ SG_ 1560 TOP_U_MSK2_CRC "Page:GDIC3162_Registers Address:0x0F";
CM_ SG_ 1560 BOT_W_STATUS2_Data "Page:GDIC3162_Registers Address:0x0E";
CM_ SG_ 1560 BOT_W_STATUS2_CRC "Page:GDIC3162_Registers Address:0x0E";
CM_ SG_ 1560 BOT_V_STATUS2_Data "Page:GDIC3162_Registers Address:0x0E";
CM_ SG_ 1560 BOT_V_STATUS2_CRC "Page:GDIC3162_Registers Address:0x0E";
CM_ SG_ 1560 BOT_U_STATUS2_Data "Page:GDIC3162_Registers Address:0x0E";
CM_ SG_ 1560 BOT_U_STATUS2_CRC "Page:GDIC3162_Registers Address:0x0E";
CM_ SG_ 1560 TOP_W_STATUS2_Data "Page:GDIC3162_Registers Address:0x0E";
CM_ SG_ 1560 TOP_W_STATUS2_CRC "Page:GDIC3162_Registers Address:0x0E";
CM_ SG_ 1560 TOP_V_STATUS2_Data "Page:GDIC3162_Registers Address:0x0E";
CM_ SG_ 1560 TOP_V_STATUS2_CRC "Page:GDIC3162_Registers Address:0x0E";
CM_ SG_ 1560 TOP_U_STATUS2_Data "Page:GDIC3162_Registers Address:0x0E";
CM_ SG_ 1560 TOP_U_STATUS2_CRC "Page:GDIC3162_Registers Address:0x0E";
CM_ SG_ 1560 BOT_W_RMSK1_Data "Page:GDIC3162_Registers Address:0x0D";
CM_ SG_ 1560 BOT_W_RMSK1_CRC "Page:GDIC3162_Registers Address:0x0D";
CM_ SG_ 1560 BOT_V_RMSK1_Data "Page:GDIC3162_Registers Address:0x0D";
CM_ SG_ 1560 BOT_V_RMSK1_CRC "Page:GDIC3162_Registers Address:0x0D";
CM_ SG_ 1560 BOT_U_RMSK1_Data "Page:GDIC3162_Registers Address:0x0D";
CM_ SG_ 1560 BOT_U_RMSK1_CRC "Page:GDIC3162_Registers Address:0x0D";
CM_ SG_ 1560 TOP_W_RMSK1_Data "Page:GDIC3162_Registers Address:0x0D";
CM_ SG_ 1560 TOP_W_RMSK1_CRC "Page:GDIC3162_Registers Address:0x0D";
CM_ SG_ 1560 TOP_V_RMSK1_Data "Page:GDIC3162_Registers Address:0x0D";
CM_ SG_ 1560 TOP_V_RMSK1_CRC "Page:GDIC3162_Registers Address:0x0D";
CM_ SG_ 1560 TOP_U_RMSK1_Data "Page:GDIC3162_Registers Address:0x0D";
CM_ SG_ 1560 TOP_U_RMSK1_CRC "Page:GDIC3162_Registers Address:0x0D";
CM_ SG_ 1560 BOT_W_MSK1_Data "Page:GDIC3162_Registers Address:0x0C";
CM_ SG_ 1560 BOT_W_MSK1_CRC "Page:GDIC3162_Registers Address:0x0C";
CM_ SG_ 1560 BOT_V_MSK1_Data "Page:GDIC3162_Registers Address:0x0C";
CM_ SG_ 1560 BOT_V_MSK1_CRC "Page:GDIC3162_Registers Address:0x0C";
CM_ SG_ 1560 BOT_U_MSK1_Data "Page:GDIC3162_Registers Address:0x0C";
CM_ SG_ 1560 BOT_U_MSK1_CRC "Page:GDIC3162_Registers Address:0x0C";
CM_ SG_ 1560 TOP_W_MSK1_Data "Page:GDIC3162_Registers Address:0x0C";
CM_ SG_ 1560 TOP_W_MSK1_CRC "Page:GDIC3162_Registers Address:0x0C";
CM_ SG_ 1560 TOP_V_MSK1_Data "Page:GDIC3162_Registers Address:0x0C";
CM_ SG_ 1560 TOP_V_MSK1_CRC "Page:GDIC3162_Registers Address:0x0C";
CM_ SG_ 1560 TOP_U_MSK1_Data "Page:GDIC3162_Registers Address:0x0C";
CM_ SG_ 1560 TOP_U_MSK1_CRC "Page:GDIC3162_Registers Address:0x0C";
CM_ SG_ 1559 BOT_W_AOUT_Freq "Page:GDIC3162_AOUT";
CM_ SG_ 1559 BOT_W_AOUT_Duty "Page:GDIC3162_AOUT";
CM_ SG_ 1559 TOP_W_AOUT_Freq "Page:GDIC3162_AOUT";
CM_ SG_ 1559 TOP_W_AOUT_Duty "Page:GDIC3162_AOUT";
CM_ SG_ 1559 BOT_W_STATUS1_Data "Page:GDIC3162_Registers Address:0x0B";
CM_ SG_ 1559 BOT_W_STATUS1_CRC "Page:GDIC3162_Registers Address:0x0B";
CM_ SG_ 1559 BOT_V_STATUS1_Data "Page:GDIC3162_Registers Address:0x0B";
CM_ SG_ 1559 BOT_V_STATUS1_CRC "Page:GDIC3162_Registers Address:0x0B";
CM_ SG_ 1559 BOT_U_STATUS1_Data "Page:GDIC3162_Registers Address:0x0B";
CM_ SG_ 1559 BOT_U_STATUS1_CRC "Page:GDIC3162_Registers Address:0x0B";
CM_ SG_ 1559 TOP_W_STATUS1_Data "Page:GDIC3162_Registers Address:0x0B";
CM_ SG_ 1559 TOP_W_STATUS1_CRC "Page:GDIC3162_Registers Address:0x0B";
CM_ SG_ 1559 TOP_V_STATUS1_Data "Page:GDIC3162_Registers Address:0x0B";
CM_ SG_ 1559 TOP_V_STATUS1_CRC "Page:GDIC3162_Registers Address:0x0B";
CM_ SG_ 1559 TOP_U_STATUS1_Data "Page:GDIC3162_Registers Address:0x0B";
CM_ SG_ 1559 TOP_U_STATUS1_CRC "Page:GDIC3162_Registers Address:0x0B";
CM_ SG_ 1559 BOT_W_OTW_TH_Data "Page:GDIC3162_Registers Address:0x0A";
CM_ SG_ 1559 BOT_W_OTW_TH_CRC "Page:GDIC3162_Registers Address:0x0A";
CM_ SG_ 1559 BOT_V_OTW_TH_Data "Page:GDIC3162_Registers Address:0x0A";
CM_ SG_ 1559 BOT_V_OTW_TH_CRC "Page:GDIC3162_Registers Address:0x0A";
CM_ SG_ 1559 BOT_U_OTW_TH_Data "Page:GDIC3162_Registers Address:0x0A";
CM_ SG_ 1559 BOT_U_OTW_TH_CRC "Page:GDIC3162_Registers Address:0x0A";
CM_ SG_ 1559 TOP_W_OTW_TH_Data "Page:GDIC3162_Registers Address:0x0A";
CM_ SG_ 1559 TOP_W_OTW_TH_CRC "Page:GDIC3162_Registers Address:0x0A";
CM_ SG_ 1559 TOP_V_OTW_TH_Data "Page:GDIC3162_Registers Address:0x0A";
CM_ SG_ 1559 TOP_V_OTW_TH_CRC "Page:GDIC3162_Registers Address:0x0A";
CM_ SG_ 1559 TOP_U_OTW_TH_Data "Page:GDIC3162_Registers Address:0x0A";
CM_ SG_ 1559 TOP_U_OTW_TH_CRC "Page:GDIC3162_Registers Address:0x0A";
CM_ SG_ 1559 BOT_W_OT_TH_Data "Page:GDIC3162_Registers Address:0x09";
CM_ SG_ 1559 BOT_W_OT_TH_CRC "Page:GDIC3162_Registers Address:0x09";
CM_ SG_ 1559 BOT_V_OT_TH_Data "Page:GDIC3162_Registers Address:0x09";
CM_ SG_ 1559 BOT_V_OT_TH_CRC "Page:GDIC3162_Registers Address:0x09";
CM_ SG_ 1559 BOT_U_OT_TH_Data "Page:GDIC3162_Registers Address:0x09";
CM_ SG_ 1559 BOT_U_OT_TH_CRC "Page:GDIC3162_Registers Address:0x09";
CM_ SG_ 1559 TOP_W_OT_TH_Data "Page:GDIC3162_Registers Address:0x09";
CM_ SG_ 1559 TOP_W_OT_TH_CRC "Page:GDIC3162_Registers Address:0x09";
CM_ SG_ 1559 TOP_V_OT_TH_Data "Page:GDIC3162_Registers Address:0x09";
CM_ SG_ 1559 TOP_V_OT_TH_CRC "Page:GDIC3162_Registers Address:0x09";
CM_ SG_ 1559 TOP_U_OT_TH_Data "Page:GDIC3162_Registers Address:0x09";
CM_ SG_ 1559 TOP_U_OT_TH_CRC "Page:GDIC3162_Registers Address:0x09";
CM_ SG_ 1559 BOT_W_CONFIG7_Data "Page:GDIC3162_Registers Address:0x08";
CM_ SG_ 1559 BOT_W_CONFIG7_CRC "Page:GDIC3162_Registers Address:0x08";
CM_ SG_ 1559 BOT_V_CONFIG7_Data "Page:GDIC3162_Registers Address:0x08";
CM_ SG_ 1559 BOT_V_CONFIG7_CRC "Page:GDIC3162_Registers Address:0x08";
CM_ SG_ 1559 BOT_U_CONFIG7_Data "Page:GDIC3162_Registers Address:0x08";
CM_ SG_ 1559 BOT_U_CONFIG7_CRC "Page:GDIC3162_Registers Address:0x08";
CM_ SG_ 1559 TOP_W_CONFIG7_Data "Page:GDIC3162_Registers Address:0x08";
CM_ SG_ 1559 TOP_W_CONFIG7_CRC "Page:GDIC3162_Registers Address:0x08";
CM_ SG_ 1559 TOP_V_CONFIG7_Data "Page:GDIC3162_Registers Address:0x08";
CM_ SG_ 1559 TOP_V_CONFIG7_CRC "Page:GDIC3162_Registers Address:0x08";
CM_ SG_ 1559 TOP_U_CONFIG7_Data "Page:GDIC3162_Registers Address:0x08";
CM_ SG_ 1559 TOP_U_CONFIG7_CRC "Page:GDIC3162_Registers Address:0x08";
CM_ SG_ 1557 BOT_V_AOUT_Freq "Page:GDIC3162_AOUT";
CM_ SG_ 1557 BOT_V_AOUT_Duty "Page:GDIC3162_AOUT";
CM_ SG_ 1557 TOP_V_AOUT_Freq "Page:GDIC3162_AOUT";
CM_ SG_ 1557 TOP_V_AOUT_Duty "Page:GDIC3162_AOUT";
CM_ SG_ 1557 BOT_W_CONFIG6_Data "Page:GDIC3162_Registers Address:0x07";
CM_ SG_ 1557 BOT_W_CONFIG6_CRC "Page:GDIC3162_Registers Address:0x07";
CM_ SG_ 1557 BOT_V_CONFIG6_Data "Page:GDIC3162_Registers Address:0x07";
CM_ SG_ 1557 BOT_V_CONFIG6_CRC "Page:GDIC3162_Registers Address:0x07";
CM_ SG_ 1557 BOT_U_CONFIG6_Data "Page:GDIC3162_Registers Address:0x07";
CM_ SG_ 1557 BOT_U_CONFIG6_CRC "Page:GDIC3162_Registers Address:0x07";
CM_ SG_ 1557 TOP_W_CONFIG6_Data "Page:GDIC3162_Registers Address:0x07";
CM_ SG_ 1557 TOP_W_CONFIG6_CRC "Page:GDIC3162_Registers Address:0x07";
CM_ SG_ 1557 TOP_V_CONFIG6_Data "Page:GDIC3162_Registers Address:0x07";
CM_ SG_ 1557 TOP_V_CONFIG6_CRC "Page:GDIC3162_Registers Address:0x07";
CM_ SG_ 1557 TOP_U_CONFIG6_Data "Page:GDIC3162_Registers Address:0x07";
CM_ SG_ 1557 TOP_U_CONFIG6_CRC "Page:GDIC3162_Registers Address:0x07";
CM_ SG_ 1557 BOT_W_CONFIG5_Data "Page:GDIC3162_Registers Address:0x06";
CM_ SG_ 1557 BOT_W_CONFIG5_CRC "Page:GDIC3162_Registers Address:0x06";
CM_ SG_ 1557 BOT_V_CONFIG5_Data "Page:GDIC3162_Registers Address:0x06";
CM_ SG_ 1557 BOT_V_CONFIG5_CRC "Page:GDIC3162_Registers Address:0x06";
CM_ SG_ 1557 BOT_U_CONFIG5_Data "Page:GDIC3162_Registers Address:0x06";
CM_ SG_ 1557 BOT_U_CONFIG5_CRC "Page:GDIC3162_Registers Address:0x06";
CM_ SG_ 1557 TOP_W_CONFIG5_Data "Page:GDIC3162_Registers Address:0x06";
CM_ SG_ 1557 TOP_W_CONFIG5_CRC "Page:GDIC3162_Registers Address:0x06";
CM_ SG_ 1557 TOP_V_CONFIG5_Data "Page:GDIC3162_Registers Address:0x06";
CM_ SG_ 1557 TOP_V_CONFIG5_CRC "Page:GDIC3162_Registers Address:0x06";
CM_ SG_ 1557 TOP_U_CONFIG5_Data "Page:GDIC3162_Registers Address:0x06";
CM_ SG_ 1557 TOP_U_CONFIG5_CRC "Page:GDIC3162_Registers Address:0x06";
CM_ SG_ 1557 BOT_W_CONFIG4_Data "Page:GDIC3162_Registers Address:0x05";
CM_ SG_ 1557 BOT_W_CONFIG4_CRC "Page:GDIC3162_Registers Address:0x05";
CM_ SG_ 1557 BOT_V_CONFIG4_Data "Page:GDIC3162_Registers Address:0x05";
CM_ SG_ 1557 BOT_V_CONFIG4_CRC "Page:GDIC3162_Registers Address:0x05";
CM_ SG_ 1557 BOT_U_CONFIG4_Data "Page:GDIC3162_Registers Address:0x05";
CM_ SG_ 1557 BOT_U_CONFIG4_CRC "Page:GDIC3162_Registers Address:0x05";
CM_ SG_ 1557 TOP_W_CONFIG4_Data "Page:GDIC3162_Registers Address:0x05";
CM_ SG_ 1557 TOP_W_CONFIG4_CRC "Page:GDIC3162_Registers Address:0x05";
CM_ SG_ 1557 TOP_V_CONFIG4_Data "Page:GDIC3162_Registers Address:0x05";
CM_ SG_ 1557 TOP_V_CONFIG4_CRC "Page:GDIC3162_Registers Address:0x05";
CM_ SG_ 1557 TOP_U_CONFIG4_Data "Page:GDIC3162_Registers Address:0x05";
CM_ SG_ 1557 TOP_U_CONFIG4_CRC "Page:GDIC3162_Registers Address:0x05";
CM_ SG_ 1557 BOT_W_CONFIG3_Data "Page:GDIC3162_Registers Address:0x04";
CM_ SG_ 1557 BOT_W_CONFIG3_CRC "Page:GDIC3162_Registers Address:0x04";
CM_ SG_ 1557 BOT_V_CONFIG3_Data "Page:GDIC3162_Registers Address:0x04";
CM_ SG_ 1557 BOT_V_CONFIG3_CRC "Page:GDIC3162_Registers Address:0x04";
CM_ SG_ 1557 BOT_U_CONFIG3_Data "Page:GDIC3162_Registers Address:0x04";
CM_ SG_ 1557 BOT_U_CONFIG3_CRC "Page:GDIC3162_Registers Address:0x04";
CM_ SG_ 1557 TOP_W_CONFIG3_Data "Page:GDIC3162_Registers Address:0x04";
CM_ SG_ 1557 TOP_W_CONFIG3_CRC "Page:GDIC3162_Registers Address:0x04";
CM_ SG_ 1557 TOP_V_CONFIG3_Data "Page:GDIC3162_Registers Address:0x04";
CM_ SG_ 1557 TOP_V_CONFIG3_CRC "Page:GDIC3162_Registers Address:0x04";
CM_ SG_ 1557 TOP_U_CONFIG3_Data "Page:GDIC3162_Registers Address:0x04";
CM_ SG_ 1557 TOP_U_CONFIG3_CRC "Page:GDIC3162_Registers Address:0x04";
CM_ SG_ 1556 BOT_U_AOUT_Freq "Page:GDIC3162_AOUT";
CM_ SG_ 1556 BOT_U_AOUT_Duty "Page:GDIC3162_AOUT";
CM_ SG_ 1556 TOP_U_AOUT_Freq "Page:GDIC3162_AOUT";
CM_ SG_ 1556 TOP_U_AOUT_Duty "Page:GDIC3162_AOUT";
CM_ SG_ 1556 BOT_W_CONFIG2_Data "Page:GDIC3162_Registers Address:0x03";
CM_ SG_ 1556 BOT_W_CONFIG2_CRC "Page:GDIC3162_Registers Address:0x03";
CM_ SG_ 1556 BOT_V_CONFIG2_Data "Page:GDIC3162_Registers Address:0x03";
CM_ SG_ 1556 BOT_V_CONFIG2_CRC "Page:GDIC3162_Registers Address:0x03";
CM_ SG_ 1556 BOT_U_CONFIG2_Data "Page:GDIC3162_Registers Address:0x03";
CM_ SG_ 1556 BOT_U_CONFIG2_CRC "Page:GDIC3162_Registers Address:0x03";
CM_ SG_ 1556 TOP_W_CONFIG2_Data "Page:GDIC3162_Registers Address:0x03";
CM_ SG_ 1556 TOP_W_CONFIG2_CRC "Page:GDIC3162_Registers Address:0x03";
CM_ SG_ 1556 TOP_V_CONFIG2_Data "Page:GDIC3162_Registers Address:0x03";
CM_ SG_ 1556 TOP_V_CONFIG2_CRC "Page:GDIC3162_Registers Address:0x03";
CM_ SG_ 1556 TOP_U_CONFIG2_Data "Page:GDIC3162_Registers Address:0x03";
CM_ SG_ 1556 TOP_U_CONFIG2_CRC "Page:GDIC3162_Registers Address:0x03";
CM_ SG_ 1556 BOT_W_CONFIG1_Data "Page:GDIC3162_Registers Address:0x02";
CM_ SG_ 1556 BOT_W_CONFIG1_CRC "Page:GDIC3162_Registers Address:0x02";
CM_ SG_ 1556 BOT_V_CONFIG1_Data "Page:GDIC3162_Registers Address:0x02";
CM_ SG_ 1556 BOT_V_CONFIG1_CRC "Page:GDIC3162_Registers Address:0x02";
CM_ SG_ 1556 BOT_U_CONFIG1_Data "Page:GDIC3162_Registers Address:0x02";
CM_ SG_ 1556 BOT_U_CONFIG1_CRC "Page:GDIC3162_Registers Address:0x02";
CM_ SG_ 1556 TOP_W_CONFIG1_Data "Page:GDIC3162_Registers Address:0x02";
CM_ SG_ 1556 TOP_W_CONFIG1_CRC "Page:GDIC3162_Registers Address:0x02";
CM_ SG_ 1556 TOP_V_CONFIG1_Data "Page:GDIC3162_Registers Address:0x02";
CM_ SG_ 1556 TOP_V_CONFIG1_CRC "Page:GDIC3162_Registers Address:0x02";
CM_ SG_ 1556 TOP_U_CONFIG1_Data "Page:GDIC3162_Registers Address:0x02";
CM_ SG_ 1556 TOP_U_CONFIG1_CRC "Page:GDIC3162_Registers Address:0x02";
CM_ SG_ 1556 BOT_W_MODE2_Data "Page:GDIC3162_Registers Address:0x01";
CM_ SG_ 1556 BOT_W_MODE2_CRC "Page:GDIC3162_Registers Address:0x01";
CM_ SG_ 1556 BOT_V_MODE2_Data "Page:GDIC3162_Registers Address:0x01";
CM_ SG_ 1556 BOT_V_MODE2_CRC "Page:GDIC3162_Registers Address:0x01";
CM_ SG_ 1556 BOT_U_MODE2_Data "Page:GDIC3162_Registers Address:0x01";
CM_ SG_ 1556 BOT_U_MODE2_CRC "Page:GDIC3162_Registers Address:0x01";
CM_ SG_ 1556 TOP_W_MODE2_Data "Page:GDIC3162_Registers Address:0x01";
CM_ SG_ 1556 TOP_W_MODE2_CRC "Page:GDIC3162_Registers Address:0x01";
CM_ SG_ 1556 TOP_V_MODE2_Data "Page:GDIC3162_Registers Address:0x01";
CM_ SG_ 1556 TOP_V_MODE2_CRC "Page:GDIC3162_Registers Address:0x01";
CM_ SG_ 1556 TOP_U_MODE2_Data "Page:GDIC3162_Registers Address:0x01";
CM_ SG_ 1556 TOP_U_MODE2_CRC "Page:GDIC3162_Registers Address:0x01";
CM_ SG_ 1556 BOT_W_MODE1_Data "Page:GDIC3162_Registers Address:0x00";
CM_ SG_ 1556 BOT_W_MODE1_CRC "Page:GDIC3162_Registers Address:0x00";
CM_ SG_ 1556 BOT_V_MODE1_Data "Page:GDIC3162_Registers Address:0x00";
CM_ SG_ 1556 BOT_V_MODE1_CRC "Page:GDIC3162_Registers Address:0x00";
CM_ SG_ 1556 BOT_U_MODE1_Data "Page:GDIC3162_Registers Address:0x00";
CM_ SG_ 1556 BOT_U_MODE1_CRC "Page:GDIC3162_Registers Address:0x00";
CM_ SG_ 1556 TOP_W_MODE1_Data "Page:GDIC3162_Registers Address:0x00";
CM_ SG_ 1556 TOP_W_MODE1_CRC "Page:GDIC3162_Registers Address:0x00";
CM_ SG_ 1556 TOP_V_MODE1_Data "Page:GDIC3162_Registers Address:0x00";
CM_ SG_ 1556 TOP_V_MODE1_CRC "Page:GDIC3162_Registers Address:0x00";
CM_ SG_ 1556 TOP_U_MODE1_Data "Page:GDIC3162_Registers Address:0x00";
CM_ SG_ 1556 TOP_U_MODE1_CRC "Page:GDIC3162_Registers Address:0x00";
CM_ SG_ 1555 BOT_W_ID_Data "Page:GDIC3162_Registers Address:0x15";
CM_ SG_ 1555 BOT_W_ID_CRC "Page:GDIC3162_Registers Address:0x15";
CM_ SG_ 1555 BOT_V_ID_Data "Page:GDIC3162_Registers Address:0x15";
CM_ SG_ 1555 BOT_V_ID_CRC "Page:GDIC3162_Registers Address:0x15";
CM_ SG_ 1555 BOT_U_ID_Data "Page:GDIC3162_Registers Address:0x15";
CM_ SG_ 1555 BOT_U_ID_CRC "Page:GDIC3162_Registers Address:0x15";
CM_ SG_ 1555 TOP_W_ID_Data "Page:GDIC3162_Registers Address:0x15";
CM_ SG_ 1555 TOP_W_ID_CRC "Page:GDIC3162_Registers Address:0x15";
CM_ SG_ 1555 TOP_V_ID_Data "Page:GDIC3162_Registers Address:0x15";
CM_ SG_ 1555 TOP_V_ID_CRC "Page:GDIC3162_Registers Address:0x15";
CM_ SG_ 1555 TOP_U_ID_Data "Page:GDIC3162_Registers Address:0x15";
CM_ SG_ 1555 TOP_U_ID_CRC "Page:GDIC3162_Registers Address:0x15";
CM_ SG_ 1555 BOT_W_REQADC_Data "Page:GDIC3162_ADC,GDIC3162_Registers Address:0x13";
CM_ SG_ 1555 BOT_W_REQADC_CRC "Page:GDIC3162_Registers Address:0x13";
CM_ SG_ 1555 BOT_V_REQADC_Data "Page:GDIC3162_ADC,GDIC3162_Registers Address:0x13";
CM_ SG_ 1555 BOT_V_REQADC_CRC "Page:GDIC3162_Registers Address:0x13";
CM_ SG_ 1555 BOT_U_REQADC_Data "Page:GDIC3162_ADC,GDIC3162_Registers Address:0x13";
CM_ SG_ 1555 BOT_U_REQADC_CRC "Page:GDIC3162_Registers Address:0x13";
CM_ SG_ 1555 TOP_W_REQADC_Data "Page:GDIC3162_ADC,GDIC3162_Registers Address:0x13";
CM_ SG_ 1555 TOP_W_REQADC_CRC "Page:GDIC3162_Registers Address:0x13";
CM_ SG_ 1555 TOP_V_REQADC_Data "Page:GDIC3162_ADC,GDIC3162_Registers Address:0x13";
CM_ SG_ 1555 TOP_V_REQADC_CRC "Page:GDIC3162_Registers Address:0x13";
CM_ SG_ 1555 TOP_U_REQADC_Data "Page:GDIC3162_ADC,GDIC3162_Registers Address:0x13";
CM_ SG_ 1555 TOP_U_REQADC_CRC "Page:GDIC3162_Registers Address:0x13";
CM_ SG_ 1555 BOT_W_STATCON4_CMP_OUT "Page:GDIC3162_Status";
CM_ SG_ 1555 BOT_W_STATCON4_GS_ERR "Page:GDIC3162_Status";
CM_ SG_ 1555 BOT_W_STATCON4_GS_H_WS_CNF "Page:GDIC3162_Status";
CM_ SG_ 1555 BOT_W_STATCON4_GS_H_US_CNF "Page:GDIC3162_Status";
CM_ SG_ 1555 BOT_W_STATCON4_GS_L_WS_CNF "Page:GDIC3162_Status";
CM_ SG_ 1555 BOT_W_STATCON4_GS_L_US_CNF "Page:GDIC3162_Status";
CM_ SG_ 1555 BOT_W_STATCON4_GS_H_WS_ST "Page:GDIC3162_Status";
CM_ SG_ 1555 BOT_W_STATCON4_GS_H_US_ST "Page:GDIC3162_Status";
CM_ SG_ 1555 BOT_W_STATCON4_GS_L_WS_ST "Page:GDIC3162_Status";
CM_ SG_ 1555 BOT_W_STATCON4_GS_L_US_ST "Page:GDIC3162_Status";
CM_ SG_ 1555 BOT_W_STATUS3_FSISO_ST "Page:GDIC3162_Status";
CM_ SG_ 1555 BOT_W_STATUS3_FSISO "Page:GDIC3162_Status";
CM_ SG_ 1555 BOT_W_STATUS3_PWM "Page:GDIC3162_Status";
CM_ SG_ 1555 BOT_W_STATUS3_PWMALT "Page:GDIC3162_Status";
CM_ SG_ 1555 BOT_W_STATUS3_FSSTATE "Page:GDIC3162_Status";
CM_ SG_ 1555 BOT_W_STATUS3_FSENB "Page:GDIC3162_Status";
CM_ SG_ 1555 BOT_W_STATUS3_INTB "Page:GDIC3162_Status";
CM_ SG_ 1555 BOT_W_STATUS3_INTA_RTRPT "Page:GDIC3162_Status";
CM_ SG_ 1555 BOT_W_STATUS3_VRTMON "Page:GDIC3162_Status";
CM_ SG_ 1555 BOT_W_STATUS2_BIST_FAIL "Page:GDIC3162_Status";
CM_ SG_ 1555 BOT_W_STATUS2_VDD_UVOV "Page:GDIC3162_Status";
CM_ SG_ 1555 BOT_W_STATUS2_DTFLT "Page:GDIC3162_Status";
CM_ SG_ 1555 BOT_W_STATUS2_SPIERR "Page:GDIC3162_Status";
CM_ SG_ 1555 BOT_W_STATUS2_CONFCRCERR "Page:GDIC3162_Status";
CM_ SG_ 1555 BOT_W_STATUS2_RTMON_FLT "Page:GDIC3162_Status";
CM_ SG_ 1555 BOT_W_STATUS2_WDOG_FLT "Page:GDIC3162_Status";
CM_ SG_ 1555 BOT_W_STATUS2_COMERR "Page:GDIC3162_Status";
CM_ SG_ 1555 BOT_W_STATUS2_VREF_UV "Page:GDIC3162_Status";
CM_ SG_ 1555 BOT_W_STATUS2_VEE_OOR "Page:GDIC3162_Status";
CM_ SG_ 1555 BOT_W_STATUS1_VCCOV "Page:GDIC3162_Status";
CM_ SG_ 1555 BOT_W_STATUS1_VCCUV "Page:GDIC3162_Status";
CM_ SG_ 1555 BOT_W_STATUS1_POR_1 "Page:GDIC3162_Status";
CM_ SG_ 1555 BOT_W_STATUS1_OTSD_IC "Page:GDIC3162_Status";
CM_ SG_ 1555 BOT_W_STATUS1_OTSD "Page:GDIC3162_Status";
CM_ SG_ 1555 BOT_W_STATUS1_OTW "Page:GDIC3162_Status";
CM_ SG_ 1555 BOT_W_STATUS1_POR_2 "Page:GDIC3162_Status";
CM_ SG_ 1555 BOT_W_STATUS1_DESAT "Page:GDIC3162_Status";
CM_ SG_ 1555 BOT_W_STATUS1_SC "Page:GDIC3162_Status";
CM_ SG_ 1555 BOT_W_STATUS1_OC "Page:GDIC3162_Status";
CM_ SG_ 1555 BOT_V_STATCON4_CMP_OUT "Page:GDIC3162_Status";
CM_ SG_ 1555 BOT_V_STATCON4_GS_ERR "Page:GDIC3162_Status";
CM_ SG_ 1555 BOT_V_STATCON4_GS_H_WS_CNF "Page:GDIC3162_Status";
CM_ SG_ 1555 BOT_V_STATCON4_GS_H_US_CNF "Page:GDIC3162_Status";
CM_ SG_ 1555 BOT_V_STATCON4_GS_L_WS_CNF "Page:GDIC3162_Status";
CM_ SG_ 1555 BOT_V_STATCON4_GS_L_US_CNF "Page:GDIC3162_Status";
CM_ SG_ 1555 BOT_V_STATCON4_GS_H_WS_ST "Page:GDIC3162_Status";
CM_ SG_ 1555 BOT_V_STATCON4_GS_H_US_ST "Page:GDIC3162_Status";
CM_ SG_ 1555 BOT_V_STATCON4_GS_L_WS_ST "Page:GDIC3162_Status";
CM_ SG_ 1555 BOT_V_STATCON4_GS_L_US_ST "Page:GDIC3162_Status";
CM_ SG_ 1555 BOT_V_STATUS3_FSISO_ST "Page:GDIC3162_Status";
CM_ SG_ 1555 BOT_V_STATUS3_FSISO "Page:GDIC3162_Status";
CM_ SG_ 1555 BOT_V_STATUS3_PWM "Page:GDIC3162_Status";
CM_ SG_ 1555 BOT_V_STATUS3_PWMALT "Page:GDIC3162_Status";
CM_ SG_ 1555 BOT_V_STATUS3_FSSTATE "Page:GDIC3162_Status";
CM_ SG_ 1555 BOT_V_STATUS3_FSENB "Page:GDIC3162_Status";
CM_ SG_ 1555 BOT_V_STATUS3_INTB "Page:GDIC3162_Status";
CM_ SG_ 1555 BOT_V_STATUS3_INTA_RTRPT "Page:GDIC3162_Status";
CM_ SG_ 1555 BOT_V_STATUS3_VRTMON "Page:GDIC3162_Status";
CM_ SG_ 1555 BOT_V_STATUS2_BIST_FAIL "Page:GDIC3162_Status";
CM_ SG_ 1555 BOT_V_STATUS2_VDD_UVOV "Page:GDIC3162_Status";
CM_ SG_ 1555 BOT_V_STATUS2_DTFLT "Page:GDIC3162_Status";
CM_ SG_ 1555 BOT_V_STATUS2_SPIERR "Page:GDIC3162_Status";
CM_ SG_ 1555 BOT_V_STATUS2_CONFCRCERR "Page:GDIC3162_Status";
CM_ SG_ 1555 BOT_V_STATUS2_RTMON_FLT "Page:GDIC3162_Status";
CM_ SG_ 1555 BOT_V_STATUS2_WDOG_FLT "Page:GDIC3162_Status";
CM_ SG_ 1555 BOT_V_STATUS2_COMERR "Page:GDIC3162_Status";
CM_ SG_ 1555 BOT_V_STATUS2_VREF_UV "Page:GDIC3162_Status";
CM_ SG_ 1555 BOT_V_STATUS2_VEE_OOR "Page:GDIC3162_Status";
CM_ SG_ 1555 BOT_V_STATUS1_VCCOV "Page:GDIC3162_Status";
CM_ SG_ 1555 BOT_V_STATUS1_VCCUV "Page:GDIC3162_Status";
CM_ SG_ 1555 BOT_V_STATUS1_POR_1 "Page:GDIC3162_Status";
CM_ SG_ 1555 BOT_V_STATUS1_OTSD_IC "Page:GDIC3162_Status";
CM_ SG_ 1555 BOT_V_STATUS1_OTSD "Page:GDIC3162_Status";
CM_ SG_ 1555 BOT_V_STATUS1_OTW "Page:GDIC3162_Status";
CM_ SG_ 1555 BOT_V_STATUS1_POR_2 "Page:GDIC3162_Status";
CM_ SG_ 1555 BOT_V_STATUS1_DESAT "Page:GDIC3162_Status";
CM_ SG_ 1555 BOT_V_STATUS1_SC "Page:GDIC3162_Status";
CM_ SG_ 1555 BOT_V_STATUS1_OC "Page:GDIC3162_Status";
CM_ SG_ 1555 BOT_U_STATCON4_CMP_OUT "Page:GDIC3162_Status";
CM_ SG_ 1555 BOT_U_STATCON4_GS_ERR "Page:GDIC3162_Status";
CM_ SG_ 1555 BOT_U_STATCON4_GS_H_WS_CNF "Page:GDIC3162_Status";
CM_ SG_ 1555 BOT_U_STATCON4_GS_H_US_CNF "Page:GDIC3162_Status";
CM_ SG_ 1555 BOT_U_STATCON4_GS_L_WS_CNF "Page:GDIC3162_Status";
CM_ SG_ 1555 BOT_U_STATCON4_GS_L_US_CNF "Page:GDIC3162_Status";
CM_ SG_ 1555 BOT_U_STATCON4_GS_H_WS_ST "Page:GDIC3162_Status";
CM_ SG_ 1555 BOT_U_STATCON4_GS_H_US_ST "Page:GDIC3162_Status";
CM_ SG_ 1555 BOT_U_STATCON4_GS_L_WS_ST "Page:GDIC3162_Status";
CM_ SG_ 1555 BOT_U_STATCON4_GS_L_US_ST "Page:GDIC3162_Status";
CM_ SG_ 1555 BOT_U_STATUS3_FSISO_ST "Page:GDIC3162_Status";
CM_ SG_ 1555 BOT_U_STATUS3_FSISO "Page:GDIC3162_Status";
CM_ SG_ 1555 BOT_U_STATUS3_PWM "Page:GDIC3162_Status";
CM_ SG_ 1555 BOT_U_STATUS3_PWMALT "Page:GDIC3162_Status";
CM_ SG_ 1555 BOT_U_STATUS3_FSSTATE "Page:GDIC3162_Status";
CM_ SG_ 1555 BOT_U_STATUS3_FSENB "Page:GDIC3162_Status";
CM_ SG_ 1555 BOT_U_STATUS3_INTB "Page:GDIC3162_Status";
CM_ SG_ 1555 BOT_U_STATUS3_INTA_RTRPT "Page:GDIC3162_Status";
CM_ SG_ 1555 BOT_U_STATUS3_VRTMON "Page:GDIC3162_Status";
CM_ SG_ 1555 BOT_U_STATUS2_BIST_FAIL "Page:GDIC3162_Status";
CM_ SG_ 1555 BOT_U_STATUS2_VDD_UVOV "Page:GDIC3162_Status";
CM_ SG_ 1555 BOT_U_STATUS2_DTFLT "Page:GDIC3162_Status";
CM_ SG_ 1555 BOT_U_STATUS2_SPIERR "Page:GDIC3162_Status";
CM_ SG_ 1555 BOT_U_STATUS2_CONFCRCERR "Page:GDIC3162_Status";
CM_ SG_ 1555 BOT_U_STATUS2_RTMON_FLT "Page:GDIC3162_Status";
CM_ SG_ 1555 BOT_U_STATUS2_WDOG_FLT "Page:GDIC3162_Status";
CM_ SG_ 1555 BOT_U_STATUS2_COMERR "Page:GDIC3162_Status";
CM_ SG_ 1555 BOT_U_STATUS2_VREF_UV "Page:GDIC3162_Status";
CM_ SG_ 1555 BOT_U_STATUS2_VEE_OOR "Page:GDIC3162_Status";
CM_ SG_ 1555 BOT_U_STATUS1_VCCOV "Page:GDIC3162_Status";
CM_ SG_ 1555 BOT_U_STATUS1_VCCUV "Page:GDIC3162_Status";
CM_ SG_ 1555 BOT_U_STATUS1_POR_1 "Page:GDIC3162_Status";
CM_ SG_ 1555 BOT_U_STATUS1_OTSD_IC "Page:GDIC3162_Status";
CM_ SG_ 1555 BOT_U_STATUS1_OTSD "Page:GDIC3162_Status";
CM_ SG_ 1555 BOT_U_STATUS1_OTW "Page:GDIC3162_Status";
CM_ SG_ 1555 BOT_U_STATUS1_POR_2 "Page:GDIC3162_Status";
CM_ SG_ 1555 BOT_U_STATUS1_DESAT "Page:GDIC3162_Status";
CM_ SG_ 1555 BOT_U_STATUS1_SC "Page:GDIC3162_Status";
CM_ SG_ 1555 BOT_U_STATUS1_OC "Page:GDIC3162_Status";
CM_ SG_ 1555 TOP_W_STATCON4_CMP_OUT "Page:GDIC3162_Status";
CM_ SG_ 1555 TOP_W_STATCON4_GS_ERR "Page:GDIC3162_Status";
CM_ SG_ 1555 TOP_W_STATCON4_GS_H_WS_CNF "Page:GDIC3162_Status";
CM_ SG_ 1555 TOP_W_STATCON4_GS_H_US_CNF "Page:GDIC3162_Status";
CM_ SG_ 1555 TOP_W_STATCON4_GS_L_WS_CNF "Page:GDIC3162_Status";
CM_ SG_ 1555 TOP_W_STATCON4_GS_L_US_CNF "Page:GDIC3162_Status";
CM_ SG_ 1555 TOP_W_STATCON4_GS_H_WS_ST "Page:GDIC3162_Status";
CM_ SG_ 1555 TOP_W_STATCON4_GS_H_US_ST "Page:GDIC3162_Status";
CM_ SG_ 1555 TOP_W_STATCON4_GS_L_WS_ST "Page:GDIC3162_Status";
CM_ SG_ 1555 TOP_W_STATCON4_GS_L_US_ST "Page:GDIC3162_Status";
CM_ SG_ 1555 TOP_W_STATUS3_FSISO_ST "Page:GDIC3162_Status";
CM_ SG_ 1555 TOP_W_STATUS3_FSISO "Page:GDIC3162_Status";
CM_ SG_ 1555 TOP_W_STATUS3_PWM "Page:GDIC3162_Status";
CM_ SG_ 1555 TOP_W_STATUS3_PWMALT "Page:GDIC3162_Status";
CM_ SG_ 1555 TOP_W_STATUS3_FSSTATE "Page:GDIC3162_Status";
CM_ SG_ 1555 TOP_W_STATUS3_FSENB "Page:GDIC3162_Status";
CM_ SG_ 1555 TOP_W_STATUS3_INTB "Page:GDIC3162_Status";
CM_ SG_ 1555 TOP_W_STATUS3_INTA_RTRPT "Page:GDIC3162_Status";
CM_ SG_ 1555 TOP_W_STATUS3_VRTMON "Page:GDIC3162_Status";
CM_ SG_ 1555 TOP_W_STATUS2_BIST_FAIL "Page:GDIC3162_Status";
CM_ SG_ 1555 TOP_W_STATUS2_VDD_UVOV "Page:GDIC3162_Status";
CM_ SG_ 1555 TOP_W_STATUS2_DTFLT "Page:GDIC3162_Status";
CM_ SG_ 1555 TOP_W_STATUS2_SPIERR "Page:GDIC3162_Status";
CM_ SG_ 1555 TOP_W_STATUS2_CONFCRCERR "Page:GDIC3162_Status";
CM_ SG_ 1555 TOP_W_STATUS2_RTMON_FLT "Page:GDIC3162_Status";
CM_ SG_ 1555 TOP_W_STATUS2_WDOG_FLT "Page:GDIC3162_Status";
CM_ SG_ 1555 TOP_W_STATUS2_COMERR "Page:GDIC3162_Status";
CM_ SG_ 1555 TOP_W_STATUS2_VREF_UV "Page:GDIC3162_Status";
CM_ SG_ 1555 TOP_W_STATUS2_VEE_OOR "Page:GDIC3162_Status";
CM_ SG_ 1555 TOP_W_STATUS1_VCCOV "Page:GDIC3162_Status";
CM_ SG_ 1555 TOP_W_STATUS1_VCCUV "Page:GDIC3162_Status";
CM_ SG_ 1555 TOP_W_STATUS1_POR_1 "Page:GDIC3162_Status";
CM_ SG_ 1555 TOP_W_STATUS1_OTSD_IC "Page:GDIC3162_Status";
CM_ SG_ 1555 TOP_W_STATUS1_OTSD "Page:GDIC3162_Status";
CM_ SG_ 1555 TOP_W_STATUS1_OTW "Page:GDIC3162_Status";
CM_ SG_ 1555 TOP_W_STATUS1_POR_2 "Page:GDIC3162_Status";
CM_ SG_ 1555 TOP_W_STATUS1_DESAT "Page:GDIC3162_Status";
CM_ SG_ 1555 TOP_W_STATUS1_SC "Page:GDIC3162_Status";
CM_ SG_ 1555 TOP_W_STATUS1_OC "Page:GDIC3162_Status";
CM_ SG_ 1555 TOP_V_STATCON4_GS_L_WS_ST "Page:GDIC3162_Status";
CM_ SG_ 1555 TOP_V_STATCON4_GS_L_WS_CNF "Page:GDIC3162_Status";
CM_ SG_ 1555 TOP_V_STATCON4_GS_L_US_ST "Page:GDIC3162_Status";
CM_ SG_ 1555 TOP_V_STATCON4_GS_L_US_CNF "Page:GDIC3162_Status";
CM_ SG_ 1555 TOP_V_STATCON4_GS_H_WS_ST "Page:GDIC3162_Status";
CM_ SG_ 1555 TOP_V_STATCON4_GS_H_WS_CNF "Page:GDIC3162_Status";
CM_ SG_ 1555 TOP_V_STATCON4_GS_H_US_ST "Page:GDIC3162_Status";
CM_ SG_ 1555 TOP_V_STATCON4_GS_H_US_CNF "Page:GDIC3162_Status";
CM_ SG_ 1555 TOP_V_STATCON4_GS_ERR "Page:GDIC3162_Status";
CM_ SG_ 1555 TOP_V_STATCON4_CMP_OUT "Page:GDIC3162_Status";
CM_ SG_ 1555 TOP_V_STATUS3_VRTMON "Page:GDIC3162_Status";
CM_ SG_ 1555 TOP_V_STATUS3_PWM "Page:GDIC3162_Status";
CM_ SG_ 1555 TOP_V_STATUS3_PWMALT "Page:GDIC3162_Status";
CM_ SG_ 1555 TOP_V_STATUS3_INTB "Page:GDIC3162_Status";
CM_ SG_ 1555 TOP_V_STATUS3_INTA_RTRPT "Page:GDIC3162_Status";
CM_ SG_ 1555 TOP_V_STATUS3_FSSTATE "Page:GDIC3162_Status";
CM_ SG_ 1555 TOP_V_STATUS3_FSISO_ST "Page:GDIC3162_Status";
CM_ SG_ 1555 TOP_V_STATUS3_FSISO "Page:GDIC3162_Status";
CM_ SG_ 1555 TOP_V_STATUS3_FSENB "Page:GDIC3162_Status";
CM_ SG_ 1555 TOP_V_STATUS2_WDOG_FLT "Page:GDIC3162_Status";
CM_ SG_ 1555 TOP_V_STATUS2_VREF_UV "Page:GDIC3162_Status";
CM_ SG_ 1555 TOP_V_STATUS2_VEE_OOR "Page:GDIC3162_Status";
CM_ SG_ 1555 TOP_V_STATUS2_VDD_UVOV "Page:GDIC3162_Status";
CM_ SG_ 1555 TOP_V_STATUS2_SPIERR "Page:GDIC3162_Status";
CM_ SG_ 1555 TOP_V_STATUS2_RTMON_FLT "Page:GDIC3162_Status";
CM_ SG_ 1555 TOP_V_STATUS2_DTFLT "Page:GDIC3162_Status";
CM_ SG_ 1555 TOP_V_STATUS2_CONFCRCERR "Page:GDIC3162_Status";
CM_ SG_ 1555 TOP_V_STATUS2_COMERR "Page:GDIC3162_Status";
CM_ SG_ 1555 TOP_V_STATUS2_BIST_FAIL "Page:GDIC3162_Status";
CM_ SG_ 1555 TOP_V_STATUS1_VCCUV "Page:GDIC3162_Status";
CM_ SG_ 1555 TOP_V_STATUS1_VCCOV "Page:GDIC3162_Status";
CM_ SG_ 1555 TOP_V_STATUS1_SC "Page:GDIC3162_Status";
CM_ SG_ 1555 TOP_V_STATUS1_POR_2 "Page:GDIC3162_Status";
CM_ SG_ 1555 TOP_V_STATUS1_POR_1 "Page:GDIC3162_Status";
CM_ SG_ 1555 TOP_V_STATUS1_OTW "Page:GDIC3162_Status";
CM_ SG_ 1555 TOP_V_STATUS1_OTSD_IC "Page:GDIC3162_Status";
CM_ SG_ 1555 TOP_V_STATUS1_OTSD "Page:GDIC3162_Status";
CM_ SG_ 1555 TOP_V_STATUS1_DESAT "Page:GDIC3162_Status";
CM_ SG_ 1555 TOP_V_STATUS1_OC "Page:GDIC3162_Status";
CM_ SG_ 1555 TOP_U_STATCON4_CMP_OUT "Page:GDIC3162_Status";
CM_ SG_ 1555 TOP_U_STATCON4_GS_ERR "Page:GDIC3162_Status";
CM_ SG_ 1555 TOP_U_STATCON4_GS_H_WS_CNF "Page:GDIC3162_Status";
CM_ SG_ 1555 TOP_U_STATCON4_GS_H_US_CNF "Page:GDIC3162_Status";
CM_ SG_ 1555 TOP_U_STATCON4_GS_L_WS_CNF "Page:GDIC3162_Status";
CM_ SG_ 1555 TOP_U_STATCON4_GS_L_US_CNF "Page:GDIC3162_Status";
CM_ SG_ 1555 TOP_U_STATCON4_GS_H_WS_ST "Page:GDIC3162_Status";
CM_ SG_ 1555 TOP_U_STATCON4_GS_H_US_ST "Page:GDIC3162_Status";
CM_ SG_ 1555 TOP_U_STATCON4_GS_L_WS_ST "Page:GDIC3162_Status";
CM_ SG_ 1555 TOP_U_STATCON4_GS_L_US_ST "Page:GDIC3162_Status";
CM_ SG_ 1555 TOP_U_STATUS3_FSISO_ST "Page:GDIC3162_Status";
CM_ SG_ 1555 TOP_U_STATUS3_FSISO "Page:GDIC3162_Status";
CM_ SG_ 1555 TOP_U_STATUS3_PWM "Page:GDIC3162_Status";
CM_ SG_ 1555 TOP_U_STATUS3_PWMALT "Page:GDIC3162_Status";
CM_ SG_ 1555 TOP_U_STATUS3_FSSTATE "Page:GDIC3162_Status";
CM_ SG_ 1555 TOP_U_STATUS3_FSENB "Page:GDIC3162_Status";
CM_ SG_ 1555 TOP_U_STATUS3_INTB "Page:GDIC3162_Status";
CM_ SG_ 1555 TOP_U_STATUS3_INTA_RTRPT "Page:GDIC3162_Status";
CM_ SG_ 1555 TOP_U_STATUS3_VRTMON "Page:GDIC3162_Status";
CM_ SG_ 1555 TOP_U_STATUS2_BIST_FAIL "Page:GDIC3162_Status";
CM_ SG_ 1555 TOP_U_STATUS2_VDD_UVOV "Page:GDIC3162_Status";
CM_ SG_ 1555 TOP_U_STATUS2_DTFLT "Page:GDIC3162_Status";
CM_ SG_ 1555 TOP_U_STATUS2_SPIERR "Page:GDIC3162_Status";
CM_ SG_ 1555 TOP_U_STATUS2_CONFCRCERR "Page:GDIC3162_Status";
CM_ SG_ 1555 TOP_U_STATUS2_RTMON_FLT "Page:GDIC3162_Status";
CM_ SG_ 1555 TOP_U_STATUS2_WDOG_FLT "Page:GDIC3162_Status";
CM_ SG_ 1555 TOP_U_STATUS2_COMERR "Page:GDIC3162_Status";
CM_ SG_ 1555 TOP_U_STATUS2_VREF_UV "Page:GDIC3162_Status";
CM_ SG_ 1555 TOP_U_STATUS2_VEE_OOR "Page:GDIC3162_Status";
CM_ SG_ 1555 TOP_U_STATUS1_VCCOV "Page:GDIC3162_Status";
CM_ SG_ 1555 TOP_U_STATUS1_VCCUV "Page:GDIC3162_Status";
CM_ SG_ 1555 TOP_U_STATUS1_POR_1 "Page:GDIC3162_Status";
CM_ SG_ 1555 TOP_U_STATUS1_OTSD_IC "Page:GDIC3162_Status";
CM_ SG_ 1555 TOP_U_STATUS1_OTSD "Page:GDIC3162_Status";
CM_ SG_ 1555 TOP_U_STATUS1_OTW "Page:GDIC3162_Status";
CM_ SG_ 1555 TOP_U_STATUS1_POR_2 "Page:GDIC3162_Status";
CM_ SG_ 1555 TOP_U_STATUS1_DESAT "Page:GDIC3162_Status";
CM_ SG_ 1555 TOP_U_STATUS1_SC "Page:GDIC3162_Status";
CM_ SG_ 1555 TOP_U_STATUS1_OC "Page:GDIC3162_Status";
CM_ SG_ 1554 PWM_U_BOT_FB_BU_Freq "Page:Pulse_IN";
CM_ SG_ 1554 PWM_U_BOT_FB_BU_Duty "Page:Pulse_IN";
CM_ SG_ 1554 PWM_V_BOT_FB_BU_Freq "Page:Pulse_IN";
CM_ SG_ 1554 PWM_V_BOT_FB_BU_Duty "Page:Pulse_IN";
CM_ SG_ 1554 PWM_W_BOT_FB_BU_Freq "Page:Pulse_IN";
CM_ SG_ 1554 PWM_W_BOT_FB_BU_Duty "Page:Pulse_IN";
CM_ SG_ 1554 PWM_U_TOP_FB_BU_Freq "Page:Pulse_IN";
CM_ SG_ 1554 PWM_U_TOP_FB_BU_Duty "Page:Pulse_IN";
CM_ SG_ 1554 PWM_V_TOP_FB_BU_Freq "Page:Pulse_IN";
CM_ SG_ 1554 PWM_V_TOP_FB_BU_Duty "Page:Pulse_IN";
CM_ SG_ 1554 PWM_W_TOP_FB_BU_Freq "Page:Pulse_IN";
CM_ SG_ 1554 PWM_W_TOP_FB_BU_Duty "Page:Pulse_IN";
CM_ SG_ 1554 HVIL_5_PI_Freq "Page:Pulse_IN";
CM_ SG_ 1554 HVIL_5_PI_Duty "Page:Pulse_IN";
CM_ SG_ 1554 HVIL_4_PI_Freq "Page:Pulse_IN";
CM_ SG_ 1554 HVIL_4_PI_Duty "Page:Pulse_IN";
CM_ SG_ 1554 HVIL_3_PI_Freq "Page:Pulse_IN";
CM_ SG_ 1554 HVIL_3_PI_Duty "Page:Pulse_IN";
CM_ SG_ 1554 HVIL_2_PI_Freq "Page:Pulse_IN";
CM_ SG_ 1554 HVIL_2_PI_Duty "Page:Pulse_IN";
CM_ SG_ 1554 HVIL_1_PI_Freq "Page:Pulse_IN";
CM_ SG_ 1554 HVIL_1_PI_Duty "Page:Pulse_IN";
CM_ SG_ 1554 LOW_ACT_DISCHARGE_State "Pin_Number:Y19 Page:Discretes";
CM_ SG_ 1554 KP_ALIVE_MP_State "Pin_Number:K20 Page:Discretes";
CM_ SG_ 1554 LOW_MTR_SPEED_STAT_State "Pin_Number:F19 Page:Discretes,Safing_Logic";
CM_ SG_ 1554 LOW_3PS_MAIN_MICRO_State "Pin_Number:G20 Page:Discretes,Safing_Logic";
CM_ SG_ 1554 MTR_TEMP_SEL_State "Pin_Number:B20 Page:Discretes";
CM_ SG_ 1554 INST_TRIGGER_MAIN_MICRO_State "Pin_Number:E7 Page:Discretes";
CM_ SG_ 1554 LOW_HVOV_PHOC_LATCH_CLR_State "Pin_Number:A3 Page:Discretes,Safing_Logic";
CM_ SG_ 1554 OIL_PMP_RLY_CTRL_State "Pin_Number:A9 Page:Discretes";
CM_ SG_ 1554 SBC_WD_TRIG_State "Pin_Number:J17 Page:Discretes";
CM_ SG_ 1554 eLOCKER_EN_State "Pin_Number:D12 Page:Discretes,E-Locker";
CM_ SG_ 1554 HVIL_RTN_SW_State "Pin_Number:F5 Page:Discretes";
CM_ SG_ 1554 PWM_EN_State "Pin_Number:B10 Page:Discretes,Safing_Logic";
CM_ SG_ 1554 LOW_RST_PPAWL_MTR_OC_FLT_State "Pin_Number:K17 Page:Discretes,PPAWL";
CM_ SG_ 1554 PPAWL_MTR_EN_State "Pin_Number:D13 Page:Discretes,PPAWL";
CM_ SG_ 1554 PPAWL_MTR_CTRL2_State "Pin_Number:A8 Page:Discretes,PPAWL";
CM_ SG_ 1554 GS_ENL_U_State "Pin_Number:G19 Page:Discretes";
CM_ SG_ 1554 GS_ENL_V_State "Pin_Number:D10 Page:Discretes";
CM_ SG_ 1554 GS_ENL_W_State "Pin_Number:R16 Page:Discretes";
CM_ SG_ 1554 GS_ENH_U_State "Pin_Number:Y18 Page:Discretes";
CM_ SG_ 1554 GS_ENH_V_State "Pin_Number:N17 Page:Discretes";
CM_ SG_ 1554 GS_ENH_W_State "Pin_Number:T19 Page:Discretes";
CM_ SG_ 1554 eLOCKER_LS_VSENSE "Pin_Number:R17 Page:E-Locker";
CM_ SG_ 1554 LOW_FSENB_FB "Pin_Number:U13 Page:Discretes,Safing_Logic";
CM_ SG_ 1554 FSSTATE_BOT_FB "Pin_Number:U15 Page:Discretes,Safing_Logic";
CM_ SG_ 1554 FSSTATE_TOP_FB "Pin_Number:P16 Page:Discretes,Safing_Logic";
CM_ SG_ 1554 IGN_FB "Pin_Number:J19 Page:Discretes";
CM_ SG_ 1554 ETK_WAKEUP "Pin_Number:A13 Page:Discretes";
CM_ SG_ 1554 LOW_OUT_EN "Pin_Number:B13 Page:Discretes,Safing_Logic";
CM_ SG_ 1554 LOW_BOOT_EN_SW "Pin_Number:A4 Page:Discretes";
CM_ SG_ 1554 LOW_E_STOP_MAIN_MICRO "Pin_Number:G1 Page:Discretes,Safing_Logic";
CM_ SG_ 1554 FORCE_UPPERS_ON_FB "Pin_Number:N5 Page:Discretes,Safing_Logic";
CM_ SG_ 1554 FORCE_LOWERS_ON_FB "Pin_Number:R1 Page:Discretes,Safing_Logic";
CM_ SG_ 1554 LOW_RES_AMPLIFIER_FLT "Pin_Number:M16 Page:Discretes,Resolver";
CM_ SG_ 1554 OIL_PMP_RLY_FB "Pin_Number:Y16 Page:Discretes";
CM_ SG_ 1554 LOW_PWM_BUFFER_FB "Pin_Number:E9 Page:Discretes,Safing_Logic";
CM_ SG_ 1554 LOW_PPAWL_FLT "Pin_Number:A16 Page:Discretes,PPAWL";
CM_ SG_ 1554 LOW_PPAWL_MTR_OC_LATCH "Pin_Number:B5 Page:Discretes,PPAWL";
CM_ SG_ 1554 CRASH_IN_MAIN_MICRO "Pin_Number:K4 Page:Discretes";
CM_ SG_ 1554 LOW_DSAT_TOP_FLT_FB "Pin_Number:E8 Page:Discretes,Safing_Logic";
CM_ SG_ 1554 LOW_UVLO_TOP_FLT_FB "Pin_Number:D8 Page:Discretes,Safing_Logic";
CM_ SG_ 1554 LOW_DSAT_BOT_FLT_FB "Pin_Number:E10 Page:Discretes,Safing_Logic";
CM_ SG_ 1554 LOW_UVLO_BOT_FLT_FB "Pin_Number:F2 Page:Discretes,Safing_Logic";
CM_ SG_ 1554 LOW_PHASE_UVW_OC_FLT_FB "Pin_Number:D6 Page:Discretes,Safing_Logic";
CM_ SG_ 1554 LOW_HVDC_OV_FLT_FB "Pin_Number:D7 Page:Discretes,Safing_Logic";
CM_ SG_ 1554 LOW_OC_W_FLT "Pin_Number:L17 Page:Discretes,Safing_Logic";
CM_ SG_ 1554 LOW_OC_V_FLT "Pin_Number:L16 Page:Discretes,Safing_Logic";
CM_ SG_ 1554 LOW_OC_U_FLT "Pin_Number:M17 Page:Discretes,Safing_Logic";
CM_ SG_ 1283 TLF35584_ERR_Disable "Page:Discretes";
CM_ SG_ 1283 CAN_INH_Update "Page:Discretes";
CM_ SG_ 1283 UVW_PWM_Dead_Time "Page:Pulse_OUT";
CM_ SG_ 1283 TLF35584_Tran_State "Page:Discretes";
CM_ SG_ 1283 TLF35584_State_Update "Page:Discretes";
CM_ SG_ 1283 PPAWL_Frame_Time "Page:PPAWL";
CM_ SG_ 1283 eLOCKER_Time "Page:E-Locker";
CM_ SG_ 1283 eLOCKER_PWM_Freq "Page:E-Locker";
CM_ SG_ 1283 eLOCKER_PWM_Duty "Page:E-Locker";
CM_ SG_ 1283 eLOCKER_PWM_Seq_Start "Page:E-Locker";
CM_ SG_ 1283 eLOCKER_PWM_Stop "Page:E-Locker";
CM_ SG_ 1283 eLOCKER_PWM_Update "Page:E-Locker";
CM_ SG_ 1283 PPAWL_Current_Limit_Update "Page:PPAWL";
CM_ SG_ 1283 PPAWL_PWM_Update "Page:PPAWL";
CM_ SG_ 1283 PPAWL_Current_Limit "Page:PPAWL";
CM_ SG_ 1283 FD16_INH_DISABLE "Page:Discretes";
CM_ SG_ 1283 FD5_INH_DISABLE "Page:Discretes";
CM_ SG_ 1283 DIS_SBC_WWD_TRIG "Page:Discretes";
CM_ SG_ 1283 SEND_BAD_ANSWER "Page:Discretes";
CM_ SG_ 1283 UVWPWM_Duty_Freq_Update "Page:Pulse_OUT";
CM_ SG_ 1283 PWM_Duty_Freq_Update "Page:Pulse_OUT";
CM_ SG_ 1283 PWM_W_Duty "Page:Pulse_OUT";
CM_ SG_ 1283 PWM_V_Duty "Page:Pulse_OUT";
CM_ SG_ 1283 PWM_U_Duty "Page:Pulse_OUT";
CM_ SG_ 1283 UVW_PWM_Freq "Page:Pulse_OUT";
CM_ SG_ 1283 HVIL_PWM_SEND_Freq "Page:Pulse_OUT";
CM_ SG_ 1283 HVIL_PWM_SEND_Duty "Page:Pulse_OUT";
CM_ SG_ 1283 PPAWL_MTR_CTRL1_Freq "Page:Pulse_OUT,PPAWL";
CM_ SG_ 1283 PPAWL_MTR_CTRL1_Duty "Page:Pulse_OUT,PPAWL";
CM_ SG_ 1283 PinOut_Update "Page:Discretes";
CM_ SG_ 1283 UVW_PWM_Polarity "Page:Pulse_OUT";
CM_ SG_ 1283 Reset_Motor_Faults "Page:Discretes";
CM_ SG_ 1283 LOW_ACT_DISCHARGE "Pin_Number:Y19 Page:Discretes";
CM_ SG_ 1283 KP_ALIVE_MP "Pin_Number:K20 Page:Discretes";
CM_ SG_ 1283 LOW_MTR_SPEED_STAT "Pin_Number:F19 Page:Discretes,Safing_Logic";
CM_ SG_ 1283 LOW_3PS_MAIN_MICRO "Pin_Number:G20 Page:Discretes,Safing_Logic";
CM_ SG_ 1283 MTR_TEMP_SEL "Pin_Number:B20 Page:Discretes";
CM_ SG_ 1283 INST_TRIGGER_MAIN_MICRO "Pin_Number:E7 Page:Discretes";
CM_ SG_ 1283 LOW_HVOV_PHOC_LATCH_CLR "Pin_Number:A3 Page:Discretes,Safing_Logic";
CM_ SG_ 1283 OIL_PMP_RLY_CTRL "Pin_Number:A9 Page:Discretes";
CM_ SG_ 1283 SBC_WD_TRIG "Pin_Number:J17 Page:Discretes";
CM_ SG_ 1283 eLOCKER_EN "Pin_Number:D12 Page:Discretes,E-Locker";
CM_ SG_ 1283 HVIL_RTN_SW "Pin_Number:F5 Page:Discretes";
CM_ SG_ 1283 PWM_EN "Pin_Number:B10 Page:Discretes,Safing_Logic";
CM_ SG_ 1283 LOW_RST_PPAWL_MTR_OC_FLT "Pin_Number:K17 Page:Discretes,PPAWL";
CM_ SG_ 1283 PPAWL_MTR_EN "Pin_Number:D13 Page:Discretes,PPAWL";
CM_ SG_ 1283 PPAWL_MTR_CTRL2 "Pin_Number:A8 Page:Discretes,PPAWL";
CM_ SG_ 1283 GS_ENL_U "Pin_Number:G19 Page:Discretes";
CM_ SG_ 1283 GS_ENL_V "Pin_Number:D10 Page:Discretes";
CM_ SG_ 1283 GS_ENL_W "Pin_Number:R16 Page:Discretes";
CM_ SG_ 1283 GS_ENH_U "Pin_Number:Y18 Page:Discretes";
CM_ SG_ 1283 GS_ENH_V "Pin_Number:N17 Page:Discretes";
CM_ SG_ 1283 GS_ENH_W "Pin_Number:T19 Page:Discretes";
CM_ SG_ 1283 LOW_NXP_ACT_DISCH "Pin_Number:PTA3 Page:NXP";
CM_ SG_ 1283 LOW_F_RESET_NXP "Pin_Number:PTA7 Page:NXP,Safing_Logic";
CM_ SG_ 1283 SPD_HW_3PS_I_O "Pin_Number:PTD5 Page:NXP,Safing_Logic";
CM_ SG_ 1283 INST_TRIGGER "Pin_Number:PTC3 Page:NXP";
CM_ SG_ 1553 E_STOP_MAIN_MICRO_Dir "Page:Safing_Logic";
CM_ SG_ 1553 DSAT_BOT_FLT_FB_Dir "Page:Safing_Logic";
CM_ SG_ 1553 DSAT_TOP_FLT_FB_Dir "Page:Safing_Logic";
CM_ SG_ 1553 UVLO_BOT_FLT_FB_Dir "Page:Safing_Logic";
CM_ SG_ 1553 UVLO_TOP_FLT_FB_Dir "Page:Safing_Logic";
CM_ SG_ 1553 HVDC_OV_FLT_FB_Dir "Page:Safing_Logic";
CM_ SG_ 1553 PHASE_UVW_OC_FLT_Dir "Page:Safing_Logic";
CM_ SG_ 1553 OC_W_FLT_Dir "Page:Safing_Logic";
CM_ SG_ 1553 OC_V_FLT_Dir "Page:Safing_Logic";
CM_ SG_ 1553 OC_U_FLT_Dir "Page:Safing_Logic";
CM_ SG_ 1553 Safing_Logic_Test_Frame_PHASE_UVW_OC_FLT "Page:Safing_Logic";
CM_ SG_ 1553 Safing_Logic_Test_Frame_OUT_EN "Page:Safing_Logic";
CM_ SG_ 1553 Safing_Logic_Test_Frame_FSENB "Page:Safing_Logic";
CM_ SG_ 1553 Safing_Logic_Test_Frame_FSSTATE_TOP "Page:Safing_Logic";
CM_ SG_ 1553 Safing_Logic_Test_Frame_FSSTATE_BOT "Page:Safing_Logic";
CM_ SG_ 1553 Safing_Logic_Test_Frame_PWM_BUFFER "Page:Safing_Logic";
CM_ SG_ 1553 Safing_Logic_Test_Frame_FORCE_LOWERS_ON "Page:Safing_Logic";
CM_ SG_ 1553 Safing_Logic_Test_Frame_FORCE_UPPERS_ON "Page:Safing_Logic";
CM_ SG_ 1553 Safing_Logic_Test_Frame_Row "Page:Safing_Logic";
CM_ SG_ 1553 Safing_Logic_Test_Frame_Index "Page:Safing_Logic";
CM_ SG_ 1553 Safing_Logic_Test_Frame_Header "Page:Safing_Logic";
CM_ SG_ 1553 Safing_Logic_Test_Error_info "Page:Safing_Logic";
CM_ SG_ 1553 Safing_Logic_Test_Error_RowCnt "Page:Safing_Logic";
CM_ SG_ 1553 Safing_Logic_Test_Current_Row "Page:Safing_Logic";
CM_ SG_ 1553 Safing_Logic_Test_Status "Page:Safing_Logic";
CM_ SG_ 1553 LIN_Receive_Data7 "Page:LIN";
CM_ SG_ 1553 LIN_Receive_Data6 "Page:LIN";
CM_ SG_ 1553 LIN_Receive_Data5 "Page:LIN";
CM_ SG_ 1553 LIN_Receive_Data4 "Page:LIN";
CM_ SG_ 1553 LIN_Receive_Data3 "Page:LIN";
CM_ SG_ 1553 LIN_Receive_Data2 "Page:LIN";
CM_ SG_ 1553 LIN_Receive_Data1 "Page:LIN";
CM_ SG_ 1553 LIN_Receive_Data0 "Page:LIN";
CM_ SG_ 1553 SPEED_FW_Duty "Pin_Number:PTC2 Page:NXP";
CM_ SG_ 1553 CRT_V_SPEED_Duty "Pin_Number:PTE8 Page:NXP";
CM_ SG_ 1553 LOW_NXP_ACT_DISCH_State "Pin_Number:PTA3 Page:NXP";
CM_ SG_ 1553 LOW_F_RESET_NXP_State "Pin_Number:PTA7 Page:NXP,Safing_Logic";
CM_ SG_ 1553 SPD_HW_3PS_I_O_State "Pin_Number:PTD5 Page:NXP,Safing_Logic";
CM_ SG_ 1553 INST_TRIGGER_State "Pin_Number:PTC3 Page:NXP";
CM_ SG_ 1553 SPEED_FW_Freq "Pin_Number:PTC2 Page:NXP";
CM_ SG_ 1553 CRT_V_SPEED_Freq "Pin_Number:PTE8 Page:NXP";
CM_ SG_ 1553 HVDC_SENSE1_NXP_AI "Pin_Number:PTA0 Conversion_mode:0 Factor:0.18780517578125 Page:NXP";
CM_ SG_ 1553 VI_5V_SAFING_AI "Pin_Number:PTC1 Conversion_mode:0 Factor:0.00244140625 Page:NXP";
CM_ SG_ 1553 LOW_SAFESTATE2_NXP "Pin_Number:PTA2 Page:NXP,E-Locker,Safing_Logic";
CM_ SG_ 1553 LOW_SAFESTATE_NXP "Pin_Number:PTD2 Page:NXP,E-Locker";
CM_ SG_ 1553 CRASH_IN_NXP "Pin_Number:PTC8 Page:NXP";
CM_ SG_ 1553 LOW_HVDC_OV_FLT "Pin_Number:PTB5 Page:NXP";
CM_ SG_ 1553 RXD_CAN "Pin_Number:PTE4 Page:NXP";
CM_ SG_ 1553 LOW_SAFESTATE1_NXP "Pin_Number:PTE5 Page:NXP,E-Locker,Safing_Logic";
CM_ BO_ 1552 "旋变相关信号发送";
CM_ SG_ 1552 PPAWL_SPI_Current_Baudrate "Page:SPI";
CM_ SG_ 1552 CANFD_5_SPI_Current_Baudrate "Page:SPI";
CM_ SG_ 1552 CANFD_16_SPI_Current_Baudrate "Page:SPI";
CM_ SG_ 1552 FLASH_SPI_Current_Baudrate "Page:SPI";
CM_ SG_ 1552 SBC_SPI_Current_Baudrate "Page:SPI";
CM_ SG_ 1552 BOT_W_GDIC_SPI_Current_Baudrate "Page:SPI";
CM_ SG_ 1552 BOT_V_GDIC_SPI_Current_Baudrate "Page:SPI";
CM_ SG_ 1552 BOT_U_GDIC_SPI_Current_Baudrate "Page:SPI";
CM_ SG_ 1552 TOP_W_GDIC_SPI_Current_Baudrate "Page:SPI";
CM_ SG_ 1552 TOP_V_GDIC_SPI_Current_Baudrate "Page:SPI";
CM_ SG_ 1552 TOP_U_GDIC_SPI_Current_Baudrate "Page:SPI";
CM_ SG_ 1552 TLF35584_Current_State "Page:Discretes,E-Locker";
CM_ SG_ 1552 PPAWL_ENGMT_SNSR_WED_Freq "Page:PPAWL";
CM_ SG_ 1552 PPAWL_ENGMT_SNSR_WED_Duty "Page:PPAWL";
CM_ SG_ 1552 DRV8705_CSA_CTRL_Read_Data "Page:PPAWL Address:0xD";
CM_ SG_ 1552 DRV8705_UVOV_CTRL_Read_Data "Page:PPAWL Address:0xC";
CM_ SG_ 1552 DRV8705_OLSC_CTRL_Read_Data "Page:PPAWL Address:0xB";
CM_ SG_ 1552 DRV8705_VDS_CTRL_2_Read_Data "Page:PPAWL Address:0xA";
CM_ SG_ 1552 DRV8705_VDS_CTRL_1_Read_Data "Page:PPAWL Address:0x9";
CM_ SG_ 1552 DRV8705_DRV_CTRL_3_Read_Data "Page:PPAWL Address:0x8";
CM_ SG_ 1552 DRV8705_DRV_CTRL_2_Read_Data "Page:PPAWL Address:0x7";
CM_ SG_ 1552 DRV8705_DRV_CTRL_1_Read_Data "Page:PPAWL Address:0x6";
CM_ SG_ 1552 DRV8705_BRG_CTRL_Read_Data "Page:PPAWL Address:0x5";
CM_ SG_ 1552 DRV8705_IC_CTRL_Read_Data "Page:PPAWL Address:0x4";
CM_ SG_ 1552 DRV8705_IC_STAT_2_Read_Data "Page:PPAWL Address:0x2";
CM_ SG_ 1552 DRV8705_VGS_VDS_STAT_Read_Data "Page:PPAWL Address:0x1";
CM_ SG_ 1552 DRV8705_IC_STAT_1_Read_Data "Page:PPAWL Address:0x0";
CM_ SG_ 1552 PPAWL_MTR_WED_POS_uC_SENT_Data5 "Page:PPAWL";
CM_ SG_ 1552 PPAWL_MTR_WED_POS_uC_SENT_Data4 "Page:PPAWL";
CM_ SG_ 1552 PPAWL_MTR_WED_POS_uC_SENT_Data3 "Page:PPAWL";
CM_ SG_ 1552 PPAWL_MTR_WED_POS_uC_SENT_Data2 "Page:PPAWL";
CM_ SG_ 1552 PPAWL_MTR_WED_POS_uC_SENT_Data1 "Page:PPAWL";
CM_ SG_ 1552 PPAWL_MTR_WED_POS_uC_SENT_Data0 "Page:PPAWL";
CM_ SG_ 1552 POS1_eLOCKER_uC_SENT_Data5 "Page:E-Locker";
CM_ SG_ 1552 POS1_eLOCKER_uC_SENT_Data4 "Page:E-Locker";
CM_ SG_ 1552 POS1_eLOCKER_uC_SENT_Data3 "Page:E-Locker";
CM_ SG_ 1552 POS1_eLOCKER_uC_SENT_Data2 "Page:E-Locker";
CM_ SG_ 1552 POS1_eLOCKER_uC_SENT_Data1 "Page:E-Locker";
CM_ SG_ 1552 POS1_eLOCKER_uC_SENT_Data0 "Page:E-Locker";
CM_ SG_ 1552 eLOCKER_LS_VSENSE_Duty "Page:E-Locker";
CM_ SG_ 1552 eLOCKER_LS_VSENSE_Freq "Page:E-Locker";
CM_ SG_ 1552 EXC_HI_DIAG_FREQ_Duty "Page:Resolver";
CM_ SG_ 1552 EXC_HI_DIAG_FREQ_Freq "Page:Resolver";
CM_ SG_ 1552 EXC_LO_DIAG_FREQ_Duty "Page:Resolver";
CM_ SG_ 1552 EXC_LO_DIAG_FREQ_Freq "Page:Resolver";
CM_ SG_ 1552 MotClb_Spd_rpm_Flt "Page:Resolver";
CM_ SG_ 1552 Rotor_Position "Page:Resolver";
CM_ SG_ 1552 RED_DSADC_RES_COS "Page:Analog,Resolver GroupName:Resolver";
CM_ SG_ 1552 RED_DSADC_RES_SIN "Page:Analog,Resolver GroupName:Resolver";
CM_ SG_ 1552 DSADC_RES_COS "Page:Analog,Resolver GroupName:Resolver";
CM_ SG_ 1552 DSADC_RES_SIN "Page:Analog,Resolver GroupName:Resolver";
CM_ SG_ 1552 EXC_LO_DIAG_AI "Pin_Number:G2 A/D_Channel:P00.1 Conversion_mode:0 Factor:0.001220703125 Page:Analog,Resolver GroupName:Resolver";
CM_ SG_ 1552 EXC_HI_DIAG_AI "Pin_Number:L4 A/D_Channel:AN43 Conversion_mode:0 Factor:0.001220703125 Page:Analog,Resolver GroupName:Resolver";
CM_ SG_ 1552 COS_LO_DIAG_AI "Pin_Number:P5 A/D_Channel:AN34 Conversion_mode:0 Factor:0.001220703125 Page:Analog,Resolver GroupName:Resolver";
CM_ SG_ 1552 SIN_LO_DIAG_AI "Pin_Number:U2 A/D_Channel:AN28 Conversion_mode:0 Factor:0.001220703125 Page:Analog,Resolver GroupName:Resolver";
CM_ BO_ 1563 "ADC采样值发送报文";
CM_ SG_ 1563 eLOCKER_LS_ISENSE_AI "Pin_Number:N2 A/D_Channel:AN45 Conversion_mode:0 Factor:0.00244140625 Page:Analog,E-Locker GroupName:E-Locker";
CM_ SG_ 1563 eLOCKER_HS_VSENSE_AI "Pin_Number:N1 A/D_Channel:AN44 Conversion_mode:0 Factor:0.00732421875 Page:Analog,E-Locker GroupName:E-Locker";
CM_ SG_ 1563 eLOCKER_HS_ISENSE_AI "Pin_Number:T5 A/D_Channel:AN22 Conversion_mode:0 Factor:0.002380466312402 Page:Analog,E-Locker GroupName:E-Locker";
CM_ SG_ 1563 eLOCKER_LS_VSENSE_AI "Pin_Number:W13 A/D_Channel:P33.6 Conversion_mode:0 Factor:0.00732421875 Page:Analog,E-Locker GroupName:E-Locker";
CM_ SG_ 1563 PPAWL_MTR_CURRENT_SENSE_AI "Pin_Number:R2 A/D_Channel:AN35 Conversion_mode:0 Factor:0.00778228820625 Offset:-3.915625 Page:Analog,PPAWL GroupName:PPAWL";
CM_ SG_ 1563 PPAWL_MTR_PWR_AI "Pin_Number:U7 A/D_Channel:AN9 Conversion_mode:0 Factor:0.0093587239583 Page:Analog,PPAWL GroupName:PPAWL";
CM_ SG_ 1563 ACT_DIS_FET_HEALTH_AI "Pin_Number:Y10 A/D_Channel:P33.1 Conversion_mode:0 Factor:0.001220703125 Page:Analog GroupName:Others";
CM_ SG_ 1563 VI_5V_COMM_AI "Pin_Number:U11 A/D_Channel:P34.1 Conversion_mode:0 Factor:0.00244140625 Page:Analog GroupName:Power_Supply";
CM_ SG_ 1563 AC_BB_TEMP_AI "Pin_Number:F4 A/D_Channel:P02.11 Conversion_mode:1 Table:3 Page:Analog GroupName:Temperature";
CM_ SG_ 1563 DC_BB_TEMP_AI "Pin_Number:K5 A/D_Channel:P00.10 Conversion_mode:1 Table:3 Page:Analog GroupName:Temperature";
CM_ SG_ 1563 GDB_TEMP_AI "Pin_Number:K2 A/D_Channel:P00.9 Conversion_mode:1 Table:5 Page:Analog GroupName:Temperature";
CM_ SG_ 1563 VI_5VA_AI "Pin_Number:J4 A/D_Channel:P00.6 Conversion_mode:0 Factor:0.00244140625 Page:Analog GroupName:Power_Supply";
CM_ SG_ 1563 HV_ISOLATION_NEG_AI "Pin_Number:J1 A/D_Channel:P00.4 Conversion_mode:0 Factor:0.0070068359375 Page:Analog GroupName:Others";
CM_ SG_ 1563 HV_ISOLATION_POS_AI "Pin_Number:H2 A/D_Channel:P00.3 Conversion_mode:0 Factor:0.0070068359375 Page:Analog GroupName:Others";
CM_ SG_ 1563 VI_15V_SAFETY_BOT_AI "Pin_Number:M2 A/D_Channel:AN47 Conversion_mode:0 Factor:0.0070263671875 Page:Analog GroupName:Power_Supply";
CM_ SG_ 1563 VI_15V_SAFETY_TOP_AI "Pin_Number:M1 A/D_Channel:AN46 Conversion_mode:0 Factor:0.0070263671875 Page:Analog GroupName:Power_Supply";
CM_ SG_ 1563 VI_5V_OUT_AI "Pin_Number:L5 A/D_Channel:AN42 Conversion_mode:0 Factor:0.00244140625 Page:Analog GroupName:Power_Supply";
CM_ SG_ 1563 VI_5V_CURRENT_SENSE_AI "Pin_Number:M4 A/D_Channel:AN41 Conversion_mode:0 Factor:0.00244140625 Page:Analog GroupName:Power_Supply";
CM_ SG_ 1563 VBATT2_AI "Pin_Number:M5 A/D_Channel:AN40 Conversion_mode:0 Factor:0.00625 Page:Analog GroupName:Power_Supply";
CM_ SG_ 1563 VI_5V_GDIC_TOP_AI "Pin_Number:P4 A/D_Channel:AN32 Conversion_mode:0 Factor:0.00244140625 Page:Analog GroupName:Power_Supply";
CM_ SG_ 1563 VBATT1_AI "Pin_Number:T4 A/D_Channel:AN30 Conversion_mode:0 Factor:0.00625 Page:Analog GroupName:Power_Supply";
CM_ SG_ 1563 MTR_TEMP_AI "Pin_Number:U1 A/D_Channel:AN29 Conversion_mode:1 Table:1 Page:Analog GroupName:Temperature";
CM_ SG_ 1563 VI_18V_FLYBACK_EPS_AI "Pin_Number:W3 A/D_Channel:AN19 Conversion_mode:0 Factor:0.0070263671875 Page:Analog GroupName:Power_Supply";
CM_ SG_ 1563 VI_5V_GDIC_BOT_AI "Pin_Number:W4 A/D_Channel:AN18 Conversion_mode:0 Factor:0.00244140625 Page:Analog GroupName:Power_Supply";
CM_ SG_ 1563 VI_16V6_AI "Pin_Number:U5 A/D_Channel:AN17 Conversion_mode:0 Factor:0.0070263671875 Page:Analog GroupName:Power_Supply";
CM_ SG_ 1563 VI_1V3_AI "Pin_Number:W5 A/D_Channel:AN16 Conversion_mode:0 Factor:0.001220703125 Page:Analog GroupName:Power_Supply";
CM_ SG_ 1563 VI_3V3_FLASH_AI "Pin_Number:W6 A/D_Channel:AN14 Conversion_mode:0 Factor:0.001220703125 Page:Analog GroupName:Power_Supply";
CM_ SG_ 1563 AD_Temp_Coolant "Pin_Number:W6 A/D_Channel:AN13 Conversion_mode:1 Table:3 Page:Analog GroupName:Temperature";
CM_ SG_ 1563 EMC_TEMP_AI "Pin_Number:T7 A/D_Channel:AN12 Conversion_mode:1 Table:4 Page:Analog GroupName:Temperature";
CM_ SG_ 1563 CB_PCB_TEMP_AI "Pin_Number:Y8 A/D_Channel:AN10 Conversion_mode:1 Table:5 Page:Analog GroupName:Temperature";
CM_ SG_ 1563 VI_2V5_AI "Pin_Number:W8 A/D_Channel:AN8 Conversion_mode:0 Factor:0.001220703125 Page:Analog GroupName:Power_Supply";
CM_ SG_ 1563 VI_5V_AI "Pin_Number:T9 A/D_Channel:AN4 Conversion_mode:0 Factor:0.00244140625 Page:Analog GroupName:Power_Supply";
CM_ SG_ 1563 HVDC_CURRENT_SENSE_AI "Pin_Number:W7 A/D_Channel:AN11 Conversion_mode:0 Factor:0.6103515625 Offset:-1250 Page:Analog GroupName:UVW&HVDC";
CM_ SG_ 1563 RED_W_CURRENT_SENSE_AI "Pin_Number:W10 A/D_Channel:P33.0 Conversion_mode:0 Factor:0.6103515625 Offset:-1250 Page:Analog GroupName:UVW&HVDC";
CM_ SG_ 1563 RED_V_CURRENT_SENSE_AI "Pin_Number:J2 A/D_Channel:P00.5 Conversion_mode:0 Factor:0.6103515625 Offset:-1250 Page:Analog GroupName:UVW&HVDC";
CM_ SG_ 1563 RED_U_CURRENT_SENSE_AI "Pin_Number:P1 A/D_Channel:AN39 Conversion_mode:0 Factor:0.6103515625 Offset:-1250 Page:Analog GroupName:UVW&HVDC";
CM_ SG_ 1563 HVDC_SENSE_MAIN_MICRO_AI "Pin_Number:R4 A/D_Channel:AN31 Conversion_mode:0 Factor:0.18780517578125 Page:Analog GroupName:UVW&HVDC";
CM_ SG_ 1563 W_CURRENT_SENSE_AI "Pin_Number:R5 A/D_Channel:AN23 Conversion_mode:0 Factor:0.6103515625 Offset:-1250 Page:Analog GroupName:UVW&HVDC";
CM_ SG_ 1563 V_CURRENT_SENSE_AI "Pin_Number:T6 A/D_Channel:AN15 Conversion_mode:0 Factor:0.6103515625 Offset:-1250 Page:Analog GroupName:UVW&HVDC";
CM_ SG_ 1563 U_CURRENT_SENSE_AI "Pin_Number:U8 A/D_Channel:AN7 Conversion_mode:0 Factor:0.6103515625 Offset:-1250 Page:Analog GroupName:UVW&HVDC";
BA_DEF_ BO_  "CANFD_BRS" ENUM  "0","1";
BA_DEF_  "DBName" STRING ;
BA_DEF_  "BusType" STRING ;
BA_DEF_ BO_  "VFrameFormat" ENUM  "StandardCAN","ExtendedCAN","reserved","reserved","reserved","reserved","reserved","reserved","reserved","reserved","reserved","reserved","reserved","reserved","StandardCAN_FD","ExtendedCAN_FD";
BA_DEF_DEF_  "CANFD_BRS" "1";
BA_DEF_DEF_  "DBName" "";
BA_DEF_DEF_  "BusType" "";
BA_DEF_DEF_  "VFrameFormat" "StandardCAN";
BA_ "BusType" "CAN FD";
BA_ "DBName" "Erad5_GUI_DEVCAN";
BA_ "VFrameFormat" BO_ 1558 14;
BA_ "VFrameFormat" BO_ 1282 14;
BA_ "VFrameFormat" BO_ 1281 14;
BA_ "VFrameFormat" BO_ 1562 14;
BA_ "VFrameFormat" BO_ 1561 14;
BA_ "VFrameFormat" BO_ 1560 14;
BA_ "VFrameFormat" BO_ 1559 14;
BA_ "VFrameFormat" BO_ 1557 14;
BA_ "VFrameFormat" BO_ 1556 14;
BA_ "VFrameFormat" BO_ 1555 14;
BA_ "VFrameFormat" BO_ 1554 14;
BA_ "VFrameFormat" BO_ 1283 14;
BA_ "VFrameFormat" BO_ 1553 14;
BA_ "VFrameFormat" BO_ 1552 14;
BA_ "VFrameFormat" BO_ 1563 14;
VAL_ 1282 PPAWL_SPI_Select_Baudrate 11 "50" 10 "40" 9 "25" 8 "20" 7 "10" 6 "8" 5 "5" 4 "4" 3 "2.5" 2 "0.5" 1 "1" 0 "2" ;
VAL_ 1282 CANFD_5_SPI_Select_Baudrate 11 "50" 10 "40" 9 "25" 8 "20" 7 "10" 6 "8" 5 "5" 4 "4" 3 "2.5" 2 "0.5" 1 "1" 0 "2" ;
VAL_ 1282 CANFD_16_SPI_Select_Baudrate 11 "50" 10 "40" 9 "25" 8 "20" 7 "10" 6 "8" 5 "5" 4 "4" 3 "2.5" 2 "0.5" 1 "1" 0 "2" ;
VAL_ 1282 FLASH_SPI_Select_Baudrate 11 "50" 10 "40" 9 "25" 8 "20" 7 "10" 6 "8" 5 "5" 4 "4" 3 "2.5" 2 "0.5" 1 "1" 0 "2" ;
VAL_ 1282 SBC_SPI_Select_Baudrate 11 "50" 10 "40" 9 "25" 8 "20" 7 "10" 6 "8" 5 "5" 4 "4" 3 "2.5" 2 "0.5" 1 "1" 0 "2" ;
VAL_ 1282 BOT_W_GDIC_SPI_Select_Baudrate 11 "50" 10 "40" 9 "25" 8 "20" 7 "10" 6 "8" 5 "5" 4 "4" 3 "2.5" 2 "0.5" 1 "1" 0 "2" ;
VAL_ 1282 BOT_V_GDIC_SPI_Select_Baudrate 11 "50" 10 "40" 9 "25" 8 "20" 7 "10" 6 "8" 5 "5" 4 "4" 3 "2.5" 2 "0.5" 1 "1" 0 "2" ;
VAL_ 1282 BOT_U_GDIC_SPI_Select_Baudrate 11 "50" 10 "40" 9 "25" 8 "20" 7 "10" 6 "8" 5 "5" 4 "4" 3 "2.5" 2 "0.5" 1 "1" 0 "2" ;
VAL_ 1282 TOP_W_GDIC_SPI_Select_Baudrate 11 "50" 10 "40" 9 "25" 8 "20" 7 "10" 6 "8" 5 "5" 4 "4" 3 "2.5" 2 "0.5" 1 "1" 0 "2" ;
VAL_ 1282 TOP_V_GDIC_SPI_Select_Baudrate 11 "50" 10 "40" 9 "25" 8 "20" 7 "10" 6 "8" 5 "5" 4 "4" 3 "2.5" 2 "0.5" 1 "1" 0 "2" ;
VAL_ 1282 TOP_U_GDIC_SPI_Select_Baudrate 11 "50" 10 "40" 9 "25" 8 "20" 7 "10" 6 "8" 5 "5" 4 "4" 3 "2.5" 2 "0.5" 1 "1" 0 "2" ;
VAL_ 1281 BOT_W_AMUX_SEL 5 "Die temperature" 4 "Power device temperature" 3 "VEE" 2 "VCC" 1 "AMUXIN" 0 "DESAT" ;
VAL_ 1281 BOT_V_AMUX_SEL 5 "Die temperature" 4 "Power device temperature" 3 "VEE" 2 "VCC" 1 "AMUXIN" 0 "DESAT" ;
VAL_ 1281 BOT_U_AMUX_SEL 5 "Die temperature" 4 "Power device temperature" 3 "VEE" 2 "VCC" 1 "AMUXIN" 0 "DESAT" ;
VAL_ 1281 TOP_W_AMUX_SEL 5 "Die temperature" 4 "Power device temperature" 3 "VEE" 2 "VCC" 1 "AMUXIN" 0 "DESAT" ;
VAL_ 1281 TOP_V_AMUX_SEL 5 "Die temperature" 4 "Power device temperature" 3 "VEE" 2 "VCC" 1 "AMUXIN" 0 "DESAT" ;
VAL_ 1281 TOP_U_AMUX_SEL 5 "Die temperature" 4 "Power device temperature" 3 "VEE" 2 "VCC" 1 "AMUXIN" 0 "DESAT" ;
VAL_ 1281 BOT_W_AOUT_SELECT 4 "VEE" 3 "VCC" 2 "AMUXIN" 1 "DESAT" 0 "NONE" ;
VAL_ 1281 BOT_V_AOUT_SELECT 4 "VEE" 3 "VCC" 2 "AMUXIN" 1 "DESAT" 0 "NONE" ;
VAL_ 1281 BOT_U_AOUT_SELECT 4 "VEE" 3 "VCC" 2 "AMUXIN" 1 "DESAT" 0 "NONE" ;
VAL_ 1281 TOP_W_AOUT_SELECT 4 "VEE" 3 "VCC" 2 "AMUXIN" 1 "DESAT" 0 "NONE" ;
VAL_ 1281 TOP_V_AOUT_SELECT 4 "VEE" 3 "VCC" 2 "AMUXIN" 1 "DESAT" 0 "NONE" ;
VAL_ 1281 TOP_U_AOUT_SELECT 4 "VEE" 3 "VCC" 2 "AMUXIN" 1 "DESAT" 0 "NONE" ;
VAL_ 1281 BOT_W_Register_Write_Index 4 "STATCON4" 3 "STATUS3" 2 "STATUS2" 1 "STATUS1" 0 "NONE" ;
VAL_ 1281 BOT_V_Register_Write_Index 4 "STATCON4" 3 "STATUS3" 2 "STATUS2" 1 "STATUS1" 0 "NONE" ;
VAL_ 1281 BOT_U_Register_Write_Index 4 "STATCON4" 3 "STATUS3" 2 "STATUS2" 1 "STATUS1" 0 "NONE" ;
VAL_ 1281 TOP_W_Register_Write_Index 4 "STATCON4" 3 "STATUS3" 2 "STATUS2" 1 "STATUS1" 0 "NONE" ;
VAL_ 1281 TOP_V_Register_Write_Index 4 "STATCON4" 3 "STATUS3" 2 "STATUS2" 1 "STATUS1" 0 "NONE" ;
VAL_ 1281 TOP_U_Register_Write_Index 4 "STATCON4" 3 "STATUS3" 2 "STATUS2" 1 "STATUS1" 0 "NONE" ;
VAL_ 1283 TLF35584_Tran_State 7 "RESERVED" 6 "RESERVED" 5 "WAKE" 4 "STANDBY" 3 "SLEEP" 2 "NORMAL" 1 "INIT" 0 "NONE" ;
VAL_ 1552 PPAWL_SPI_Current_Baudrate 11 "50" 10 "40" 9 "25" 8 "20" 7 "10" 6 "8" 5 "5" 4 "4" 3 "2.5" 2 "0.5" 1 "1" 0 "2" ;
VAL_ 1552 CANFD_5_SPI_Current_Baudrate 11 "50" 10 "40" 9 "25" 8 "20" 7 "10" 6 "8" 5 "5" 4 "4" 3 "2.5" 2 "0.5" 1 "1" 0 "2" ;
VAL_ 1552 CANFD_16_SPI_Current_Baudrate 11 "50" 10 "40" 9 "25" 8 "20" 7 "10" 6 "8" 5 "5" 4 "4" 3 "2.5" 2 "0.5" 1 "1" 0 "2" ;
VAL_ 1552 FLASH_SPI_Current_Baudrate 11 "50" 10 "40" 9 "25" 8 "20" 7 "10" 6 "8" 5 "5" 4 "4" 3 "2.5" 2 "0.5" 1 "1" 0 "2" ;
VAL_ 1552 SBC_SPI_Current_Baudrate 11 "50" 10 "40" 9 "25" 8 "20" 7 "10" 6 "8" 5 "5" 4 "4" 3 "2.5" 2 "0.5" 1 "1" 0 "2" ;
VAL_ 1552 BOT_W_GDIC_SPI_Current_Baudrate 11 "50" 10 "40" 9 "25" 8 "20" 7 "10" 6 "8" 5 "5" 4 "4" 3 "2.5" 2 "0.5" 1 "1" 0 "2" ;
VAL_ 1552 BOT_V_GDIC_SPI_Current_Baudrate 11 "50" 10 "40" 9 "25" 8 "20" 7 "10" 6 "8" 5 "5" 4 "4" 3 "2.5" 2 "0.5" 1 "1" 0 "2" ;
VAL_ 1552 BOT_U_GDIC_SPI_Current_Baudrate 11 "50" 10 "40" 9 "25" 8 "20" 7 "10" 6 "8" 5 "5" 4 "4" 3 "2.5" 2 "0.5" 1 "1" 0 "2" ;
VAL_ 1552 TOP_W_GDIC_SPI_Current_Baudrate 11 "50" 10 "40" 9 "25" 8 "20" 7 "10" 6 "8" 5 "5" 4 "4" 3 "2.5" 2 "0.5" 1 "1" 0 "2" ;
VAL_ 1552 TOP_V_GDIC_SPI_Current_Baudrate 11 "50" 10 "40" 9 "25" 8 "20" 7 "10" 6 "8" 5 "5" 4 "4" 3 "2.5" 2 "0.5" 1 "1" 0 "2" ;
VAL_ 1552 TOP_U_GDIC_SPI_Current_Baudrate 11 "50" 10 "40" 9 "25" 8 "20" 7 "10" 6 "8" 5 "5" 4 "4" 3 "2.5" 2 "0.5" 1 "1" 0 "2" ;
VAL_ 1552 TLF35584_Current_State 7 "RESERVED" 6 "RESERVED" 5 "WAKE" 4 "STANDBY" 3 "SLEEP" 2 "NORMAL" 1 "INIT" 0 "NONE" ;
